/*
 * SPDX-FileCopyrightText: 2026 Espressif Systems (Shanghai) CO LTD
 *
 * SPDX-License-Identifier: Apache-2.0
 *
 * rig_active.inc - generated from scene.json v1 by gui_designer.html
 */

#pragma once

#include "widget/gfx_sm_scene.h"

static const gfx_sm_meta_t s_rig_meta = {
    .version   = GFX_SM_SCENE_SCHEMA_VERSION,
    .viewbox_x = 0,
    .viewbox_y = 0,
    .viewbox_w = 1136,
    .viewbox_h = 960,
};

static const gfx_sm_layout_t s_rig_layout = {
    .stroke_width    = 5,
    .mirror_x        = 0,
    .ground_y        = 960,
    .timer_period_ms = 33,
    .damping_div     = 4,
};

static const char *const s_rig_joint_names[] = {
    "ind2_gr_0_sh_0_0", /* 0 */
    "ind2_gr_0_sh_0_1", /* 1 */
    "ind2_gr_0_sh_0_2", /* 2 */
    "ind2_gr_0_sh_0_3", /* 3 */
    "ind2_gr_0_sh_0_4", /* 4 */
    "ind2_gr_0_sh_0_5", /* 5 */
    "ind2_gr_0_sh_0_6", /* 6 */
    "ind2_gr_0_sh_0_7", /* 7 */
    "ind2_gr_0_sh_0_8", /* 8 */
    "ind2_gr_0_sh_0_9", /* 9 */
    "ind2_gr_0_sh_0_10", /* 10 */
    "ind2_gr_0_sh_0_11", /* 11 */
    "ind2_gr_0_sh_0_12", /* 12 */
    "ind2_gr_0_sh_0_13", /* 13 */
    "ind2_gr_0_sh_0_14", /* 14 */
    "ind2_gr_0_sh_0_15", /* 15 */
    "ind2_gr_0_sh_0_16", /* 16 */
    "ind2_gr_0_sh_0_17", /* 17 */
    "ind2_gr_0_sh_0_18", /* 18 */
    "ind2_gr_0_sh_0_19", /* 19 */
    "ind2_gr_0_sh_0_20", /* 20 */
    "ind2_gr_0_sh_0_21", /* 21 */
    "ind2_gr_0_sh_0_22", /* 22 */
    "ind2_gr_0_sh_0_23", /* 23 */
    "ind2_gr_0_sh_0_24", /* 24 */
    "ind2_gr_0_sh_0_25", /* 25 */
    "ind2_gr_0_sh_0_26", /* 26 */
    "ind2_gr_0_sh_0_27", /* 27 */
    "ind3_gr_0_sh_0_0", /* 28 */
    "ind3_gr_0_sh_0_1", /* 29 */
    "ind3_gr_0_sh_0_2", /* 30 */
    "ind3_gr_0_sh_0_3", /* 31 */
    "ind3_gr_0_sh_0_4", /* 32 */
    "ind3_gr_0_sh_0_5", /* 33 */
    "ind3_gr_0_sh_0_6", /* 34 */
    "ind3_gr_0_sh_0_7", /* 35 */
    "ind3_gr_0_sh_0_8", /* 36 */
    "ind3_gr_0_sh_0_9", /* 37 */
    "ind3_gr_0_sh_0_10", /* 38 */
    "ind3_gr_0_sh_0_11", /* 39 */
    "ind3_gr_0_sh_0_12", /* 40 */
    "ind3_gr_0_sh_0_13", /* 41 */
    "ind3_gr_0_sh_0_14", /* 42 */
    "ind3_gr_0_sh_0_15", /* 43 */
    "ind3_gr_0_sh_0_16", /* 44 */
    "ind3_gr_0_sh_0_17", /* 45 */
    "ind3_gr_0_sh_0_18", /* 46 */
    "ind3_gr_0_sh_0_19", /* 47 */
    "ind3_gr_0_sh_0_20", /* 48 */
    "ind3_gr_0_sh_0_21", /* 49 */
    "ind3_gr_0_sh_0_22", /* 50 */
    "ind3_gr_0_sh_0_23", /* 51 */
    "ind3_gr_0_sh_0_24", /* 52 */
    "ind3_gr_0_sh_0_25", /* 53 */
    "ind3_gr_0_sh_0_26", /* 54 */
    "ind3_gr_0_sh_0_27", /* 55 */
    "ind4_gr_0_sh_0_0", /* 56 */
    "ind4_gr_0_sh_0_1", /* 57 */
    "ind4_gr_0_sh_0_2", /* 58 */
    "ind4_gr_0_sh_0_3", /* 59 */
    "ind4_gr_0_sh_0_4", /* 60 */
    "ind4_gr_0_sh_0_5", /* 61 */
    "ind4_gr_0_sh_0_6", /* 62 */
    "ind4_gr_0_sh_0_7", /* 63 */
    "ind4_gr_0_sh_0_8", /* 64 */
    "ind4_gr_0_sh_0_9", /* 65 */
    "ind4_gr_0_sh_0_10", /* 66 */
    "ind4_gr_0_sh_0_11", /* 67 */
    "ind4_gr_0_sh_0_12", /* 68 */
    "ind4_gr_0_sh_0_13", /* 69 */
    "ind4_gr_0_sh_0_14", /* 70 */
    "ind4_gr_0_sh_0_15", /* 71 */
    "ind4_gr_0_sh_0_16", /* 72 */
    "ind4_gr_0_sh_0_17", /* 73 */
    "ind4_gr_0_sh_0_18", /* 74 */
    "ind4_gr_0_sh_0_19", /* 75 */
    "ind4_gr_0_sh_0_20", /* 76 */
    "ind4_gr_0_sh_0_21", /* 77 */
    "ind4_gr_0_sh_0_22", /* 78 */
    "ind4_gr_0_sh_0_23", /* 79 */
    "ind4_gr_0_sh_0_24", /* 80 */
    "ind4_gr_0_sh_0_25", /* 81 */
    "ind4_gr_0_sh_0_26", /* 82 */
    "ind4_gr_0_sh_0_27", /* 83 */
    "ind5_gr_0_sh_0_0", /* 84 */
    "ind5_gr_0_sh_0_1", /* 85 */
    "ind5_gr_0_sh_0_2", /* 86 */
    "ind5_gr_0_sh_0_3", /* 87 */
    "ind5_gr_0_sh_0_4", /* 88 */
    "ind5_gr_0_sh_0_5", /* 89 */
    "ind5_gr_0_sh_0_6", /* 90 */
    "ind5_gr_0_sh_0_7", /* 91 */
    "ind5_gr_0_sh_0_8", /* 92 */
    "ind5_gr_0_sh_0_9", /* 93 */
    "ind5_gr_0_sh_0_10", /* 94 */
    "ind5_gr_0_sh_0_11", /* 95 */
    "ind5_gr_0_sh_0_12", /* 96 */
    "ind5_gr_0_sh_0_13", /* 97 */
    "ind5_gr_0_sh_0_14", /* 98 */
    "ind5_gr_0_sh_0_15", /* 99 */
    "ind6_gr_0_sh_0_0", /* 100 */
    "ind6_gr_0_sh_0_1", /* 101 */
    "ind6_gr_0_sh_0_2", /* 102 */
    "ind6_gr_0_sh_0_3", /* 103 */
    "ind6_gr_0_sh_0_4", /* 104 */
    "ind6_gr_0_sh_0_5", /* 105 */
    "ind6_gr_0_sh_0_6", /* 106 */
    "ind6_gr_0_sh_0_7", /* 107 */
    "ind6_gr_0_sh_0_8", /* 108 */
    "ind6_gr_0_sh_0_9", /* 109 */
    "ind6_gr_0_sh_0_10", /* 110 */
    "ind6_gr_0_sh_0_11", /* 111 */
    "ind6_gr_0_sh_0_12", /* 112 */
    "ind6_gr_0_sh_0_13", /* 113 */
    "ind6_gr_0_sh_0_14", /* 114 */
    "ind6_gr_0_sh_0_15", /* 115 */
    "ind7_gr_0_sh_0_0", /* 116 */
    "ind7_gr_0_sh_0_1", /* 117 */
    "ind7_gr_0_sh_0_2", /* 118 */
    "ind7_gr_0_sh_0_3", /* 119 */
    "ind7_gr_0_sh_0_4", /* 120 */
    "ind7_gr_0_sh_0_5", /* 121 */
    "ind7_gr_0_sh_0_6", /* 122 */
    "ind7_gr_0_sh_0_7", /* 123 */
    "ind7_gr_0_sh_0_8", /* 124 */
    "ind7_gr_0_sh_0_9", /* 125 */
    "ind7_gr_0_sh_0_10", /* 126 */
    "ind7_gr_0_sh_0_11", /* 127 */
    "ind7_gr_0_sh_0_12", /* 128 */
    "ind7_gr_0_sh_0_13", /* 129 */
    "ind7_gr_0_sh_0_14", /* 130 */
    "ind7_gr_0_sh_0_15", /* 131 */
    "ind8_gr_0_sh_0_0", /* 132 */
    "ind8_gr_0_sh_0_1", /* 133 */
    "ind8_gr_0_sh_0_2", /* 134 */
    "ind8_gr_0_sh_0_3", /* 135 */
    "ind8_gr_0_sh_0_4", /* 136 */
    "ind8_gr_0_sh_0_5", /* 137 */
    "ind8_gr_0_sh_0_6", /* 138 */
    "ind8_gr_0_sh_0_7", /* 139 */
    "ind8_gr_0_sh_0_8", /* 140 */
    "ind8_gr_0_sh_0_9", /* 141 */
    "ind8_gr_0_sh_0_10", /* 142 */
    "ind8_gr_0_sh_0_11", /* 143 */
    "ind8_gr_0_sh_0_12", /* 144 */
    "ind8_gr_0_sh_0_13", /* 145 */
    "ind8_gr_0_sh_0_14", /* 146 */
    "ind8_gr_0_sh_0_15", /* 147 */
    "ind8_gr_0_sh_0_16", /* 148 */
    "ind8_gr_0_sh_0_17", /* 149 */
    "ind8_gr_0_sh_0_18", /* 150 */
    "ind8_gr_0_sh_0_19", /* 151 */
    "ind8_gr_0_sh_0_20", /* 152 */
    "ind8_gr_0_sh_0_21", /* 153 */
    "ind8_gr_0_sh_0_22", /* 154 */
    "ind8_gr_0_sh_0_23", /* 155 */
    "ind8_gr_0_sh_0_24", /* 156 */
    "ind8_gr_0_sh_0_25", /* 157 */
    "ind8_gr_0_sh_0_26", /* 158 */
    "ind8_gr_0_sh_0_27", /* 159 */
    "ind9_gr_0_sh_0_0", /* 160 */
    "ind9_gr_0_sh_0_1", /* 161 */
    "ind9_gr_0_sh_0_2", /* 162 */
    "ind9_gr_0_sh_0_3", /* 163 */
    "ind9_gr_0_sh_0_4", /* 164 */
    "ind9_gr_0_sh_0_5", /* 165 */
    "ind9_gr_0_sh_0_6", /* 166 */
    "ind9_gr_0_sh_0_7", /* 167 */
    "ind9_gr_0_sh_0_8", /* 168 */
    "ind9_gr_0_sh_0_9", /* 169 */
    "ind9_gr_0_sh_0_10", /* 170 */
    "ind9_gr_0_sh_0_11", /* 171 */
    "ind9_gr_0_sh_0_12", /* 172 */
    "ind9_gr_0_sh_0_13", /* 173 */
    "ind9_gr_0_sh_0_14", /* 174 */
    "ind9_gr_0_sh_0_15", /* 175 */
    "ind9_gr_0_sh_0_16", /* 176 */
    "ind9_gr_0_sh_0_17", /* 177 */
    "ind9_gr_0_sh_0_18", /* 178 */
    "ind9_gr_0_sh_0_19", /* 179 */
    "ind9_gr_0_sh_0_20", /* 180 */
    "ind9_gr_0_sh_0_21", /* 181 */
    "ind9_gr_0_sh_0_22", /* 182 */
    "ind9_gr_0_sh_0_23", /* 183 */
    "ind9_gr_0_sh_0_24", /* 184 */
    "ind9_gr_0_sh_0_25", /* 185 */
    "ind9_gr_0_sh_0_26", /* 186 */
    "ind9_gr_0_sh_0_27", /* 187 */
    "ind9_gr_0_sh_0_28", /* 188 */
    "ind9_gr_0_sh_0_29", /* 189 */
    "ind9_gr_0_sh_0_30", /* 190 */
    "ind9_gr_0_sh_0_31", /* 191 */
    "ind9_gr_0_sh_0_32", /* 192 */
    "ind9_gr_0_sh_0_33", /* 193 */
    "ind10_gr_0_sh_0_0", /* 194 */
    "ind10_gr_0_sh_0_1", /* 195 */
    "ind10_gr_0_sh_0_2", /* 196 */
    "ind10_gr_0_sh_0_3", /* 197 */
    "ind10_gr_0_sh_0_4", /* 198 */
    "ind10_gr_0_sh_0_5", /* 199 */
    "ind10_gr_0_sh_0_6", /* 200 */
    "ind10_gr_0_sh_0_7", /* 201 */
    "ind10_gr_0_sh_0_8", /* 202 */
    "ind10_gr_0_sh_0_9", /* 203 */
    "ind10_gr_0_sh_0_10", /* 204 */
    "ind10_gr_0_sh_0_11", /* 205 */
    "ind10_gr_0_sh_0_12", /* 206 */
    "ind10_gr_0_sh_0_13", /* 207 */
    "ind10_gr_0_sh_0_14", /* 208 */
    "ind10_gr_0_sh_0_15", /* 209 */
    "ind10_gr_0_sh_0_16", /* 210 */
    "ind10_gr_0_sh_0_17", /* 211 */
    "ind10_gr_0_sh_0_18", /* 212 */
    "ind10_gr_0_sh_0_19", /* 213 */
    "ind10_gr_0_sh_0_20", /* 214 */
    "ind10_gr_0_sh_0_21", /* 215 */
    "ind10_gr_0_sh_0_22", /* 216 */
    "ind10_gr_0_sh_0_23", /* 217 */
    "ind10_gr_0_sh_0_24", /* 218 */
    "ind10_gr_0_sh_0_25", /* 219 */
    "ind10_gr_0_sh_0_26", /* 220 */
    "ind10_gr_0_sh_0_27", /* 221 */
    "ind10_gr_0_sh_0_28", /* 222 */
    "ind10_gr_0_sh_0_29", /* 223 */
    "ind10_gr_0_sh_0_30", /* 224 */
    "ind10_gr_0_sh_0_31", /* 225 */
    "ind10_gr_0_sh_0_32", /* 226 */
    "ind10_gr_0_sh_0_33", /* 227 */
    "ind11_gr_0_sh_0_0", /* 228 */
    "ind11_gr_0_sh_0_1", /* 229 */
    "ind11_gr_0_sh_0_2", /* 230 */
    "ind11_gr_0_sh_0_3", /* 231 */
    "ind11_gr_0_sh_0_4", /* 232 */
    "ind11_gr_0_sh_0_5", /* 233 */
    "ind11_gr_0_sh_0_6", /* 234 */
    "ind11_gr_0_sh_0_7", /* 235 */
    "ind11_gr_0_sh_0_8", /* 236 */
    "ind11_gr_0_sh_0_9", /* 237 */
    "ind11_gr_0_sh_0_10", /* 238 */
    "ind11_gr_0_sh_0_11", /* 239 */
    "ind11_gr_0_sh_0_12", /* 240 */
    "ind11_gr_0_sh_0_13", /* 241 */
    "ind11_gr_0_sh_0_14", /* 242 */
    "ind11_gr_0_sh_0_15", /* 243 */
    "ind11_gr_0_sh_0_16", /* 244 */
    "ind11_gr_0_sh_0_17", /* 245 */
    "ind11_gr_0_sh_0_18", /* 246 */
    "ind11_gr_0_sh_0_19", /* 247 */
    "ind11_gr_0_sh_0_20", /* 248 */
    "ind11_gr_0_sh_0_21", /* 249 */
    "ind11_gr_0_sh_0_22", /* 250 */
    "ind11_gr_0_sh_0_23", /* 251 */
    "ind11_gr_0_sh_0_24", /* 252 */
    "ind11_gr_0_sh_0_25", /* 253 */
    "ind11_gr_0_sh_0_26", /* 254 */
    "ind11_gr_0_sh_0_27", /* 255 */
    "ind11_gr_0_sh_0_28", /* 256 */
    "ind11_gr_0_sh_0_29", /* 257 */
    "ind11_gr_0_sh_0_30", /* 258 */
    "ind12_gr_0_sh_0_0", /* 259 */
    "ind12_gr_0_sh_0_1", /* 260 */
    "ind12_gr_0_sh_0_2", /* 261 */
    "ind12_gr_0_sh_0_3", /* 262 */
    "ind12_gr_0_sh_0_4", /* 263 */
    "ind12_gr_0_sh_0_5", /* 264 */
    "ind12_gr_0_sh_0_6", /* 265 */
    "ind12_gr_0_sh_0_7", /* 266 */
    "ind12_gr_0_sh_0_8", /* 267 */
    "ind12_gr_0_sh_0_9", /* 268 */
    "ind12_gr_0_sh_0_10", /* 269 */
    "ind12_gr_0_sh_0_11", /* 270 */
    "ind12_gr_0_sh_0_12", /* 271 */
    "ind12_gr_0_sh_0_13", /* 272 */
    "ind12_gr_0_sh_0_14", /* 273 */
    "ind12_gr_0_sh_0_15", /* 274 */
    "ind12_gr_0_sh_0_16", /* 275 */
    "ind12_gr_0_sh_0_17", /* 276 */
    "ind12_gr_0_sh_0_18", /* 277 */
    "ind12_gr_0_sh_0_19", /* 278 */
    "ind12_gr_0_sh_0_20", /* 279 */
    "ind12_gr_0_sh_0_21", /* 280 */
    "ind12_gr_0_sh_0_22", /* 281 */
    "ind12_gr_0_sh_0_23", /* 282 */
    "ind12_gr_0_sh_0_24", /* 283 */
    "ind12_gr_0_sh_0_25", /* 284 */
    "ind12_gr_0_sh_0_26", /* 285 */
    "ind12_gr_0_sh_0_27", /* 286 */
    "ind12_gr_0_sh_0_28", /* 287 */
    "ind12_gr_0_sh_0_29", /* 288 */
    "ind12_gr_0_sh_0_30", /* 289 */
    "ind12_gr_0_sh_0_31", /* 290 */
    "ind12_gr_0_sh_0_32", /* 291 */
    "ind12_gr_0_sh_0_33", /* 292 */
    "ind13_gr_0_sh_0_0", /* 293 */
    "ind13_gr_0_sh_0_1", /* 294 */
    "ind13_gr_0_sh_0_2", /* 295 */
    "ind13_gr_0_sh_0_3", /* 296 */
    "ind13_gr_0_sh_0_4", /* 297 */
    "ind13_gr_0_sh_0_5", /* 298 */
    "ind13_gr_0_sh_0_6", /* 299 */
    "ind14_gr_0_sh_0_0", /* 300 */
    "ind14_gr_0_sh_0_1", /* 301 */
    "ind14_gr_0_sh_0_2", /* 302 */
    "ind14_gr_0_sh_0_3", /* 303 */
    "ind14_gr_0_sh_0_4", /* 304 */
    "ind14_gr_0_sh_0_5", /* 305 */
    "ind14_gr_0_sh_0_6", /* 306 */
    "ind14_gr_0_sh_0_7", /* 307 */
    "ind14_gr_0_sh_0_8", /* 308 */
    "ind14_gr_0_sh_0_9", /* 309 */
    "ind14_gr_0_sh_0_10", /* 310 */
    "ind14_gr_0_sh_0_11", /* 311 */
    "ind14_gr_0_sh_0_12", /* 312 */
    "ind14_gr_0_sh_0_13", /* 313 */
    "ind14_gr_0_sh_0_14", /* 314 */
    "ind14_gr_0_sh_0_15", /* 315 */
    "ind14_gr_0_sh_0_16", /* 316 */
    "ind14_gr_0_sh_0_17", /* 317 */
    "ind14_gr_0_sh_0_18", /* 318 */
    "ind14_gr_0_sh_0_19", /* 319 */
    "ind14_gr_0_sh_0_20", /* 320 */
    "ind14_gr_0_sh_0_21", /* 321 */
    "ind14_gr_0_sh_0_22", /* 322 */
    "ind14_gr_0_sh_0_23", /* 323 */
    "ind14_gr_0_sh_0_24", /* 324 */
    "ind14_gr_0_sh_0_25", /* 325 */
    "ind14_gr_0_sh_0_26", /* 326 */
    "ind14_gr_0_sh_0_27", /* 327 */
    "ind14_gr_0_sh_0_28", /* 328 */
    "ind14_gr_0_sh_0_29", /* 329 */
    "ind14_gr_0_sh_0_30", /* 330 */
    "ind14_gr_0_sh_0_31", /* 331 */
    "ind14_gr_0_sh_0_32", /* 332 */
    "ind14_gr_0_sh_0_33", /* 333 */
    "ind15_gr_0_sh_0_0", /* 334 */
    "ind15_gr_0_sh_0_1", /* 335 */
    "ind15_gr_0_sh_0_2", /* 336 */
    "ind15_gr_0_sh_0_3", /* 337 */
    "ind15_gr_0_sh_0_4", /* 338 */
    "ind15_gr_0_sh_0_5", /* 339 */
    "ind15_gr_0_sh_0_6", /* 340 */
};

static const int16_t s_rig_p00[] = { 539, 374, 547, 374, 551, 381, 553, 385, 556, 390, 557, 398, 557, 405, 557, 412, 556, 418, 552, 424, 549, 429, 544, 433, 538, 433, 531, 433, 526, 426, 523, 422, 521, 418, 519, 412, 519, 405, 519, 398, 520, 395, 521, 390, 523, 385, 529, 374, 539, 374, 539, 374, 539, 374, 539, 374, 466, 374, 474, 374, 478, 381, 480, 385, 483, 390, 484, 398, 484, 405, 484, 412, 483, 418, 479, 424, 476, 429, 471, 433, 465, 433, 458, 433, 453, 426, 450, 422, 448, 418, 446, 412, 446, 405, 446, 398, 447, 395, 448, 390, 450, 385, 456, 374, 466, 374, 466, 374, 466, 374, 466, 374, 467, 365, 479, 365, 485, 374, 488, 380, 492, 386, 494, 398, 494, 407, 494, 416, 491, 425, 487, 433, 482, 440, 475, 446, 465, 446, 456, 446, 447, 436, 444, 430, 441, 425, 438, 416, 438, 407, 438, 397, 439, 393, 441, 386, 443, 379, 453, 365, 467, 365, 467, 365, 467, 365, 467, 365, 644, 569, 651, 569, 657, 575, 656, 582, 656, 590, 651, 595, 644, 595, 637, 595, 631, 590, 631, 582, 632, 574, 639, 569, 644, 569, 644, 569, 644, 569, 644, 569, 667, 540, 673, 540, 679, 545, 679, 552, 679, 560, 673, 565, 666, 565, 659, 565, 654, 560, 654, 552, 654, 544, 661, 540, 667, 540, 667, 540, 667, 540, 667, 540, 679, 507, 685, 508, 691, 513, 691, 520, 691, 528, 685, 533, 678, 533, 671, 533, 666, 528, 666, 520, 666, 512, 673, 507, 679, 507, 679, 507, 679, 507, 679, 507, 537, 361, 584, 361, 608, 382, 627, 400, 648, 422, 658, 458, 657, 486, 657, 507, 645, 542, 630, 557, 616, 571, 594, 599, 538, 600, 482, 601, 446, 561, 435, 540, 423, 518, 417, 494, 420, 464, 424, 435, 440, 408, 461, 390, 481, 373, 507, 361, 537, 361, 537, 361, 537, 361, 537, 361, 696, 297, 695, 294, 694, 291, 695, 288, 697, 284, 714, 255, 718, 249, 721, 244, 728, 239, 737, 244, 745, 249, 782, 293, 792, 306, 801, 319, 820, 348, 822, 363, 823, 377, 814, 384, 807, 385, 799, 386, 773, 387, 769, 387, 764, 387, 760, 388, 758, 383, 756, 377, 751, 363, 733, 338, 717, 317, 697, 302, 696, 297, 696, 297, 696, 297, 696, 297, 601, 355, 610, 350, 629, 339, 633, 337, 637, 334, 645, 333, 650, 338, 654, 342, 667, 354, 680, 370, 692, 386, 707, 410, 707, 417, 707, 425, 703, 427, 699, 431, 695, 435, 675, 458, 673, 459, 671, 460, 670, 461, 670, 454, 670, 448, 666, 428, 650, 400, 633, 372, 602, 361, 601, 359, 600, 357, 601, 356, 601, 355, 601, 355, 601, 355, 601, 355, 653, 328, 653, 326, 654, 325, 655, 324, 657, 322, 676, 313, 684, 310, 692, 308, 693, 307, 710, 324, 727, 342, 741, 365, 746, 374, 750, 383, 748, 389, 746, 391, 743, 394, 726, 409, 724, 411, 721, 414, 717, 416, 715, 411, 713, 407, 706, 390, 687, 365, 669, 341, 653, 331, 653, 328, 653, 328, 653, 328, 653, 328, 543, 635, 536, 640, 521, 651, 511, 659, 498, 670, 493, 673, 488, 671, 483, 670, 479, 663, 476, 640, 472, 618, 482, 596, 505, 579, 528, 562, 565, 564, 586, 583, 608, 601, 614, 629, 608, 654, 601, 679, 581, 697, 556, 701, 532, 706, 517, 699, 512, 696, 508, 692, 506, 686, 509, 681, 512, 678, 533, 649, 543, 635, 543, 635, 543, 635, 543, 635, 541, 364, 540, 334, 550, 320, 563, 311, 573, 303, 592, 297, 600, 295, 381, 523, 374, 526, 356, 532, 344, 538, 329, 544, 323, 546, 319, 543, 315, 540, 313, 533, 315, 511, 318, 488, 333, 470, 359, 459, 386, 448, 420, 460, 436, 484, 452, 507, 451, 535, 439, 558, 426, 580, 402, 592, 377, 590, 353, 588, 340, 578, 336, 573, 333, 568, 333, 562, 337, 559, 341, 556, 368, 534, 381, 523, 381, 523, 381, 523, 381, 523, 466, 364, 465, 334, 474, 320, 487, 311, 498, 303, 516, 297, 524, 295 }; /* pose_1_std_active_frame1 */
static const int16_t s_rig_p01[] = { 539, 374, 547, 374, 551, 381, 553, 385, 556, 390, 557, 398, 557, 405, 557, 412, 556, 418, 552, 424, 549, 429, 544, 433, 538, 433, 531, 433, 526, 426, 523, 422, 521, 418, 519, 412, 519, 405, 519, 398, 520, 395, 521, 390, 523, 385, 529, 374, 539, 374, 539, 374, 539, 374, 539, 374, 466, 374, 474, 374, 478, 381, 480, 385, 483, 390, 484, 398, 484, 405, 484, 412, 483, 418, 479, 424, 476, 429, 471, 433, 465, 433, 458, 433, 453, 426, 450, 422, 448, 418, 446, 412, 446, 405, 446, 398, 447, 395, 448, 390, 450, 385, 456, 374, 466, 374, 466, 374, 466, 374, 466, 374, 467, 365, 479, 365, 485, 374, 488, 380, 492, 386, 494, 398, 494, 407, 494, 416, 491, 425, 487, 433, 482, 440, 475, 446, 465, 446, 456, 446, 447, 436, 444, 430, 441, 425, 438, 416, 438, 407, 438, 397, 439, 393, 441, 386, 443, 379, 453, 365, 467, 365, 467, 365, 467, 365, 467, 365, 655, 555, 661, 555, 668, 559, 669, 566, 670, 574, 665, 580, 658, 581, 651, 582, 645, 577, 644, 570, 643, 562, 649, 556, 655, 555, 655, 555, 655, 555, 655, 555, 672, 523, 679, 522, 685, 526, 686, 533, 687, 541, 683, 547, 676, 548, 669, 549, 663, 545, 662, 537, 661, 529, 667, 523, 672, 523, 672, 523, 672, 523, 672, 523, 679, 489, 685, 488, 692, 492, 693, 500, 694, 507, 689, 513, 682, 514, 675, 515, 669, 511, 668, 503, 667, 495, 673, 490, 679, 489, 679, 489, 679, 489, 679, 489, 537, 361, 584, 361, 608, 382, 627, 400, 648, 422, 658, 458, 657, 486, 657, 507, 645, 542, 630, 557, 616, 571, 594, 599, 538, 600, 482, 601, 446, 561, 435, 540, 423, 518, 417, 494, 420, 464, 424, 435, 440, 408, 461, 390, 481, 373, 507, 361, 537, 361, 537, 361, 537, 361, 537, 361, 659, 276, 657, 274, 655, 271, 656, 268, 656, 264, 661, 230, 663, 224, 664, 218, 669, 211, 679, 212, 688, 213, 738, 242, 752, 251, 766, 259, 794, 280, 800, 292, 807, 305, 800, 315, 794, 319, 788, 323, 764, 333, 760, 334, 755, 336, 752, 339, 748, 334, 744, 329, 734, 318, 708, 302, 686, 288, 662, 280, 659, 276, 659, 276, 659, 276, 659, 276, 588, 355, 596, 349, 614, 337, 617, 334, 622, 331, 630, 329, 634, 333, 639, 337, 653, 348, 667, 363, 680, 378, 697, 401, 698, 408, 698, 415, 695, 418, 691, 422, 688, 426, 669, 451, 668, 453, 666, 454, 665, 454, 664, 448, 664, 441, 658, 422, 639, 395, 620, 369, 589, 360, 587, 358, 586, 357, 587, 355, 588, 355, 588, 355, 588, 355, 588, 355, 633, 321, 633, 320, 633, 318, 634, 317, 635, 315, 652, 301, 659, 297, 666, 293, 666, 291, 687, 304, 708, 317, 727, 337, 734, 344, 740, 352, 740, 358, 738, 361, 736, 364, 724, 383, 722, 385, 720, 388, 716, 392, 713, 388, 710, 384, 700, 369, 675, 350, 651, 330, 634, 325, 633, 321, 633, 321, 633, 321, 633, 321, 538, 586, 536, 579, 529, 561, 524, 549, 518, 533, 516, 528, 519, 524, 522, 519, 530, 517, 552, 520, 574, 523, 593, 538, 603, 565, 613, 592, 601, 627, 577, 642, 553, 658, 524, 656, 502, 643, 480, 630, 468, 605, 471, 581, 474, 556, 484, 544, 488, 540, 493, 537, 500, 537, 503, 541, 506, 545, 528, 573, 538, 586, 538, 586, 538, 586, 538, 586, 541, 364, 540, 334, 550, 320, 563, 311, 573, 303, 592, 297, 600, 295, 366, 456, 365, 448, 362, 429, 359, 416, 356, 400, 355, 394, 359, 391, 362, 387, 371, 387, 392, 394, 413, 400, 428, 419, 433, 447, 439, 475, 420, 507, 394, 518, 368, 529, 340, 522, 321, 505, 301, 488, 295, 462, 302, 439, 309, 415, 321, 404, 326, 402, 331, 399, 338, 400, 340, 406, 342, 410, 359, 441, 366, 456, 366, 456, 366, 456, 366, 456, 466, 364, 465, 334, 474, 320, 487, 311, 498, 303, 516, 297, 524, 295 }; /* pose_2_std_active_frame2 */

#define S_RIG_POSE(arr) { .coords = (arr) }

static const gfx_sm_pose_t s_rig_poses[] = {
    S_RIG_POSE(s_rig_p00),  S_RIG_POSE(s_rig_p01),
};

static const gfx_sm_segment_t s_rig_segments[] = {
    /* ind2_gr_0_sh_0 */ { .kind = GFX_SM_SEG_BEZIER_LOOP, .joint_a = 0, .joint_count = 28, .stroke_width = 5 },
    /* ind3_gr_0_sh_0 */ { .kind = GFX_SM_SEG_BEZIER_LOOP, .joint_a = 28, .joint_count = 28, .stroke_width = 5 },
    /* ind4_gr_0_sh_0 */ { .kind = GFX_SM_SEG_BEZIER_LOOP, .joint_a = 56, .joint_count = 28, .stroke_width = 5 },
    /* ind5_gr_0_sh_0 */ { .kind = GFX_SM_SEG_BEZIER_LOOP, .joint_a = 84, .joint_count = 16, .stroke_width = 5 },
    /* ind6_gr_0_sh_0 */ { .kind = GFX_SM_SEG_BEZIER_LOOP, .joint_a = 100, .joint_count = 16, .stroke_width = 5 },
    /* ind7_gr_0_sh_0 */ { .kind = GFX_SM_SEG_BEZIER_LOOP, .joint_a = 116, .joint_count = 16, .stroke_width = 5 },
    /* ind8_gr_0_sh_0 */ { .kind = GFX_SM_SEG_BEZIER_LOOP, .joint_a = 132, .joint_count = 28, .stroke_width = 5 },
    /* ind9_gr_0_sh_0 */ { .kind = GFX_SM_SEG_BEZIER_LOOP, .joint_a = 160, .joint_count = 34, .stroke_width = 5 },
    /* ind10_gr_0_sh_0 */ { .kind = GFX_SM_SEG_BEZIER_LOOP, .joint_a = 194, .joint_count = 34, .stroke_width = 5 },
    /* ind11_gr_0_sh_0 */ { .kind = GFX_SM_SEG_BEZIER_LOOP, .joint_a = 228, .joint_count = 31, .stroke_width = 5 },
    /* ind12_gr_0_sh_0 */ { .kind = GFX_SM_SEG_BEZIER_LOOP, .joint_a = 259, .joint_count = 34, .stroke_width = 5 },
    /* ind13_gr_0_sh_0 */ { .kind = GFX_SM_SEG_BEZIER_STRIP, .joint_a = 293, .joint_count = 7, .stroke_width = 5 },
    /* ind14_gr_0_sh_0 */ { .kind = GFX_SM_SEG_BEZIER_LOOP, .joint_a = 300, .joint_count = 34, .stroke_width = 5 },
    /* ind15_gr_0_sh_0 */ { .kind = GFX_SM_SEG_BEZIER_STRIP, .joint_a = 334, .joint_count = 7, .stroke_width = 5 },
};

#define STEP(p, h, f, i) { .pose_index = (p), .hold_ticks = (h), .interp = (i), .facing = (f) }

static const gfx_sm_clip_step_t s_rig_steps_active[] = {
    STEP(0, 30, 1, GFX_SM_INTERP_DAMPED),
    STEP(1, 100, 1, GFX_SM_INTERP_DAMPED),
};

#define CLIP(n, cn, arr, lp) { .name = (n), .name_cn = (cn), .steps = (arr), .step_count = (uint8_t)(sizeof(arr) / sizeof((arr)[0])), .loop = (lp) }

static const gfx_sm_clip_t s_rig_clips[] = {
    CLIP("active", "动作", s_rig_steps_active, true),
};

static const uint16_t s_rig_sequence[] = { 0 };

static const gfx_sm_asset_t s_rig_scene_asset = {
    .meta           = &s_rig_meta,
    .joint_names    = s_rig_joint_names,
    .joint_count    = (uint16_t)(sizeof(s_rig_joint_names) / sizeof(s_rig_joint_names[0])),
    .segments       = s_rig_segments,
    .segment_count  = (uint8_t)(sizeof(s_rig_segments) / sizeof(s_rig_segments[0])),
    .poses          = s_rig_poses,
    .pose_count     = (uint16_t)(sizeof(s_rig_poses) / sizeof(s_rig_poses[0])),
    .clips          = s_rig_clips,
    .clip_count     = (uint16_t)(sizeof(s_rig_clips) / sizeof(s_rig_clips[0])),
    .sequence       = s_rig_sequence,
    .sequence_count = (uint16_t)(sizeof(s_rig_sequence) / sizeof(s_rig_sequence[0])),
    .layout         = &s_rig_layout,
};