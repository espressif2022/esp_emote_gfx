/* Auto-generated from face_stickman.html */
#pragma once
#include "widget/gfx_stickman_emote.h"

static const gfx_parametric_export_meta_t s_stickman_export_meta = {
    .version = 3,
    .design_viewbox_x = 0,
    .design_viewbox_y = 0,
    .design_viewbox_w = 200,
    .design_viewbox_h = 300,
    .export_width = 360,
    .export_height = 360,
    .export_scale = 1.200000f,
    .export_offset_x = 60,
    .export_offset_y = 0,
};

static const gfx_stickman_layout_t s_stickman_layout = {
    .head_radius = 20,
    .stroke_width = 4,
    .mirror_x = 100,
    .ground_y = 238,
    .timer_period_ms = 33,
    .damping_div = 4,
};

static const gfx_stickman_pose_t s_stickman_poses[] = {
    {
        .head_center = { 100, 50 },
        .neck = { 100, 70 },
        .shoulder = { 100, 100 },
        .hip = { 100, 160 },
        .elbow_l = { 82, 118 },
        .hand_l = { 66, 138 },
        .elbow_r = { 118, 118 },
        .hand_r = { 134, 138 },
        .knee_l = { 86, 186 },
        .foot_l = { 72, 214 },
        .knee_r = { 114, 186 },
        .foot_r = { 128, 214 },
    },
    {
        .head_center = { 102, 50 },
        .neck = { 101, 70 },
        .shoulder = { 100, 100 },
        .hip = { 98, 160 },
        .elbow_l = { 90, 108 },
        .hand_l = { 82, 90 },
        .elbow_r = { 114, 120 },
        .hand_r = { 126, 142 },
        .knee_l = { 84, 184 },
        .foot_l = { 70, 214 },
        .knee_r = { 112, 182 },
        .foot_r = { 132, 198 },
    },
    {
        .head_center = { 98, 50 },
        .neck = { 99, 70 },
        .shoulder = { 100, 100 },
        .hip = { 102, 160 },
        .elbow_l = { 86, 120 },
        .hand_l = { 74, 142 },
        .elbow_r = { 110, 108 },
        .hand_r = { 118, 90 },
        .knee_l = { 88, 182 },
        .foot_l = { 68, 198 },
        .knee_r = { 116, 184 },
        .foot_r = { 130, 214 },
    },
    {
        .head_center = { 112, 48 },
        .neck = { 106, 68 },
        .shoulder = { 102, 94 },
        .hip = { 88, 154 },
        .elbow_l = { 86, 96 },
        .hand_l = { 78, 72 },
        .elbow_r = { 114, 112 },
        .hand_r = { 130, 136 },
        .knee_l = { 72, 180 },
        .foot_l = { 54, 210 },
        .knee_r = { 116, 172 },
        .foot_r = { 142, 190 },
    },
    {
        .head_center = { 114, 50 },
        .neck = { 108, 68 },
        .shoulder = { 104, 94 },
        .hip = { 90, 154 },
        .elbow_l = { 110, 110 },
        .hand_l = { 126, 136 },
        .elbow_r = { 82, 96 },
        .hand_r = { 74, 72 },
        .knee_l = { 106, 172 },
        .foot_l = { 138, 190 },
        .knee_r = { 74, 180 },
        .foot_r = { 54, 210 },
    },
    {
        .head_center = { 100, 44 },
        .neck = { 100, 64 },
        .shoulder = { 100, 94 },
        .hip = { 100, 146 },
        .elbow_l = { 78, 70 },
        .hand_l = { 60, 46 },
        .elbow_r = { 122, 70 },
        .hand_r = { 140, 46 },
        .knee_l = { 84, 172 },
        .foot_l = { 68, 194 },
        .knee_r = { 116, 172 },
        .foot_r = { 132, 194 },
    },
    {
        .head_center = { 98, 50 },
        .neck = { 98, 70 },
        .shoulder = { 98, 100 },
        .hip = { 98, 160 },
        .elbow_l = { 84, 118 },
        .hand_l = { 72, 140 },
        .elbow_r = { 116, 82 },
        .hand_r = { 112, 48 },
        .knee_l = { 88, 186 },
        .foot_l = { 76, 214 },
        .knee_r = { 110, 186 },
        .foot_r = { 122, 214 },
    },
    {
        .head_center = { 100, 64 },
        .neck = { 100, 84 },
        .shoulder = { 100, 120 },
        .hip = { 100, 176 },
        .elbow_l = { 78, 106 },
        .hand_l = { 90, 78 },
        .elbow_r = { 122, 106 },
        .hand_r = { 110, 78 },
        .knee_l = { 74, 206 },
        .foot_l = { 92, 224 },
        .knee_r = { 126, 206 },
        .foot_r = { 108, 224 },
    },
    {
        .head_center = { 100, 60 },
        .neck = { 100, 80 },
        .shoulder = { 100, 108 },
        .hip = { 100, 166 },
        .elbow_l = { 86, 124 },
        .hand_l = { 74, 146 },
        .elbow_r = { 114, 124 },
        .hand_r = { 126, 146 },
        .knee_l = { 78, 194 },
        .foot_l = { 92, 216 },
        .knee_r = { 122, 194 },
        .foot_r = { 108, 216 },
    },
    {
        .head_center = { 100, 52 },
        .neck = { 100, 72 },
        .shoulder = { 100, 102 },
        .hip = { 100, 162 },
        .elbow_l = { 74, 88 },
        .hand_l = { 90, 58 },
        .elbow_r = { 126, 88 },
        .hand_r = { 110, 58 },
        .knee_l = { 86, 188 },
        .foot_l = { 72, 214 },
        .knee_r = { 114, 188 },
        .foot_r = { 128, 214 },
    },
    {
        .head_center = { 100, 48 },
        .neck = { 100, 68 },
        .shoulder = { 100, 98 },
        .hip = { 100, 158 },
        .elbow_l = { 82, 78 },
        .hand_l = { 64, 52 },
        .elbow_r = { 118, 78 },
        .hand_r = { 136, 52 },
        .knee_l = { 84, 184 },
        .foot_l = { 70, 212 },
        .knee_r = { 116, 184 },
        .foot_r = { 130, 212 },
    },
    {
        .head_center = { 96, 50 },
        .neck = { 97, 70 },
        .shoulder = { 98, 100 },
        .hip = { 94, 160 },
        .elbow_l = { 84, 116 },
        .hand_l = { 74, 138 },
        .elbow_r = { 126, 100 },
        .hand_r = { 154, 96 },
        .knee_l = { 84, 186 },
        .foot_l = { 72, 214 },
        .knee_r = { 110, 184 },
        .foot_r = { 126, 212 },
    },
    {
        .head_center = { 100, 50 },
        .neck = { 100, 70 },
        .shoulder = { 100, 100 },
        .hip = { 100, 160 },
        .elbow_l = { 84, 110 },
        .hand_l = { 92, 136 },
        .elbow_r = { 116, 110 },
        .hand_r = { 108, 136 },
        .knee_l = { 82, 186 },
        .foot_l = { 66, 214 },
        .knee_r = { 118, 186 },
        .foot_r = { 134, 214 },
    },
    {
        .head_center = { 100, 50 },
        .neck = { 100, 70 },
        .shoulder = { 100, 100 },
        .hip = { 100, 160 },
        .elbow_l = { 84, 118 },
        .hand_l = { 72, 140 },
        .elbow_r = { 118, 88 },
        .hand_r = { 106, 60 },
        .knee_l = { 86, 186 },
        .foot_l = { 72, 214 },
        .knee_r = { 114, 186 },
        .foot_r = { 128, 214 },
    },
    {
        .head_center = { 98, 54 },
        .neck = { 99, 74 },
        .shoulder = { 100, 104 },
        .hip = { 96, 164 },
        .elbow_l = { 84, 108 },
        .hand_l = { 92, 92 },
        .elbow_r = { 116, 110 },
        .hand_r = { 126, 94 },
        .knee_l = { 84, 190 },
        .foot_l = { 72, 218 },
        .knee_r = { 112, 186 },
        .foot_r = { 126, 210 },
    },
    {
        .head_center = { 100, 52 },
        .neck = { 100, 72 },
        .shoulder = { 100, 102 },
        .hip = { 96, 160 },
        .elbow_l = { 84, 106 },
        .hand_l = { 70, 118 },
        .elbow_r = { 118, 110 },
        .hand_r = { 132, 126 },
        .knee_l = { 88, 188 },
        .foot_l = { 80, 216 },
        .knee_r = { 120, 166 },
        .foot_r = { 150, 166 },
    },
    {
        .head_center = { 100, 46 },
        .neck = { 100, 66 },
        .shoulder = { 100, 96 },
        .hip = { 100, 158 },
        .elbow_l = { 78, 96 },
        .hand_l = { 56, 96 },
        .elbow_r = { 122, 96 },
        .hand_r = { 144, 96 },
        .knee_l = { 86, 184 },
        .foot_l = { 72, 212 },
        .knee_r = { 114, 184 },
        .foot_r = { 128, 212 },
    },
    {
        .head_center = { 102, 50 },
        .neck = { 102, 70 },
        .shoulder = { 100, 100 },
        .hip = { 100, 160 },
        .elbow_l = { 84, 112 },
        .hand_l = { 92, 136 },
        .elbow_r = { 116, 92 },
        .hand_r = { 104, 74 },
        .knee_l = { 86, 186 },
        .foot_l = { 72, 214 },
        .knee_r = { 114, 186 },
        .foot_r = { 128, 214 },
    },
    {
        .head_center = { 108, 54 },
        .neck = { 106, 74 },
        .shoulder = { 102, 104 },
        .hip = { 94, 164 },
        .elbow_l = { 90, 124 },
        .hand_l = { 86, 146 },
        .elbow_r = { 104, 120 },
        .hand_r = { 100, 144 },
        .knee_l = { 92, 188 },
        .foot_l = { 88, 214 },
        .knee_r = { 112, 190 },
        .foot_r = { 114, 220 },
    },
    {
        .head_center = { 100, 48 },
        .neck = { 100, 68 },
        .shoulder = { 100, 98 },
        .hip = { 98, 160 },
        .elbow_l = { 84, 86 },
        .hand_l = { 78, 54 },
        .elbow_r = { 116, 76 },
        .hand_r = { 118, 38 },
        .knee_l = { 86, 186 },
        .foot_l = { 72, 214 },
        .knee_r = { 114, 186 },
        .foot_r = { 128, 214 },
    },
    {
        .head_center = { 104, 50 },
        .neck = { 104, 70 },
        .shoulder = { 102, 100 },
        .hip = { 100, 160 },
        .elbow_l = { 86, 108 },
        .hand_l = { 68, 108 },
        .elbow_r = { 118, 118 },
        .hand_r = { 132, 134 },
        .knee_l = { 90, 188 },
        .foot_l = { 76, 214 },
        .knee_r = { 118, 178 },
        .foot_r = { 134, 198 },
    },
    {
        .head_center = { 100, 48 },
        .neck = { 100, 68 },
        .shoulder = { 100, 96 },
        .hip = { 98, 158 },
        .elbow_l = { 80, 96 },
        .hand_l = { 56, 96 },
        .elbow_r = { 118, 88 },
        .hand_r = { 136, 72 },
        .knee_l = { 88, 184 },
        .foot_l = { 76, 212 },
        .knee_r = { 122, 166 },
        .foot_r = { 140, 190 },
    },
    {
        .head_center = { 98, 50 },
        .neck = { 98, 70 },
        .shoulder = { 98, 100 },
        .hip = { 92, 160 },
        .elbow_l = { 80, 116 },
        .hand_l = { 62, 120 },
        .elbow_r = { 122, 94 },
        .hand_r = { 146, 80 },
        .knee_l = { 80, 186 },
        .foot_l = { 62, 214 },
        .knee_r = { 118, 174 },
        .foot_r = { 146, 190 },
    },
    {
        .head_center = { 100, 52 },
        .neck = { 100, 72 },
        .shoulder = { 100, 104 },
        .hip = { 100, 162 },
        .elbow_l = { 86, 100 },
        .hand_l = { 78, 84 },
        .elbow_r = { 114, 100 },
        .hand_r = { 122, 84 },
        .knee_l = { 84, 188 },
        .foot_l = { 70, 214 },
        .knee_r = { 116, 188 },
        .foot_r = { 130, 214 },
    }
};

static const gfx_stickman_action_t s_stickman_actions[] = {
    { "00 calm", "00 平静", "calm", 0, 1, 1, 1, 6 },
    { "01 walk_r_s1", "01 走右 1", "walk_r", 1, 1, 2, 1, 7 },
    { "02 walk_r_s2", "02 走右 2", "walk_r", 2, 2, 2, 1, 7 },
    { "03 walk_l_s1", "03 走左 1", "walk_l", 1, 1, 2, -1, 7 },
    { "04 walk_l_s2", "04 走左 2", "walk_l", 2, 2, 2, -1, 7 },
    { "05 run_r_s1", "05 跑右 1", "run_r", 3, 1, 2, 1, 7 },
    { "06 run_r_s2", "06 跑右 2", "run_r", 4, 2, 2, 1, 7 },
    { "07 run_l_s1", "07 跑左 1", "run_l", 3, 1, 2, -1, 7 },
    { "08 run_l_s2", "08 跑左 2", "run_l", 4, 2, 2, -1, 7 },
    { "09 jump", "09 跳跃", "jump", 5, 1, 1, 1, 8 },
    { "10 wave", "10 挥手", "wave", 6, 1, 1, 1, 7 },
    { "11 deep_squat_hold_head", "11 深蹲抱头", "deep_squat_hold_head", 7, 1, 1, 1, 9 },
    { "12 half_squat", "12 半蹲", "half_squat", 8, 1, 1, 1, 7 },
    { "13 hands_on_head", "13 抱头", "hands_on_head", 9, 1, 1, 1, 7 },
    { "14 cheer", "14 欢呼", "cheer", 10, 1, 1, 1, 7 },
    { "15 point_r", "15 指向右", "point_r", 11, 1, 1, 1, 6 },
    { "16 akimbo", "16 叉腰", "akimbo", 12, 1, 1, 1, 6 },
    { "17 salute", "17 敬礼", "salute", 13, 1, 1, 1, 6 },
    { "18 guard", "18 警戒", "guard", 14, 1, 1, 1, 7 },
    { "19 kick_r", "19 右踢", "kick_r", 15, 1, 1, 1, 7 },
    { "20 stretch", "20 展臂", "stretch", 16, 1, 1, 1, 6 },
    { "21 thinking", "21 思考", "thinking", 17, 1, 1, 1, 6 },
    { "22 slouch", "22 沮丧", "slouch", 18, 1, 1, 1, 7 },
    { "23 reach_up", "23 上探", "reach_up", 19, 1, 1, 1, 6 },
    { "24 strut", "24 神气走", "strut", 20, 1, 1, 1, 7 },
    { "25 balance", "25 单脚平衡", "balance", 21, 1, 1, 1, 7 },
    { "26 lunge", "26 弓步冲", "lunge", 22, 1, 1, 1, 7 },
    { "27 shrug", "27 摊手", "shrug", 23, 1, 1, 1, 6 }
};

static const uint16_t s_stickman_sequence[] = {
    0,
    1,
    2,
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    26,
    27
};

static const gfx_stickman_export_t s_stickman_export = {
    .meta = &s_stickman_export_meta,
    .layout = &s_stickman_layout,
    .poses = s_stickman_poses,
    .pose_count = sizeof(s_stickman_poses) / sizeof(s_stickman_poses[0]),
    .actions = s_stickman_actions,
    .action_count = sizeof(s_stickman_actions) / sizeof(s_stickman_actions[0]),
    .sequence = s_stickman_sequence,
    .sequence_count = sizeof(s_stickman_sequence) / sizeof(s_stickman_sequence[0]),
};
