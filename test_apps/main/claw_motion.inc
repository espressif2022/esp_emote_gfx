/*
 * SPDX-FileCopyrightText: 2026 Espressif Systems (Shanghai) CO LTD
 *
 * SPDX-License-Identifier: Apache-2.0
 *
 * claw_motion.inc
 *
 * Generated Motion Scene Asset.
 * Source: scene.json v1 / gui_designer.html
 *
 * This asset contains:
 * - Public motion action IDs
 * - Scene metadata and layout hints
 * - Control point names
 * - Pose keyframes
 * - Visual parts
 * - Color palette
 * - Motion action timelines
 * - Runtime asset bundle
 */

#pragma once

#include "widget/gfx_motion_scene.h"

/* Public Motion Action IDs */
typedef enum {
    CLAW_MOTION_ACTION_POS_MOVE = 0,
    CLAW_MOTION_ACTION_POS_DOWN = 1,
    CLAW_MOTION_ACTION_POS_THINKING = 2,
    CLAW_MOTION_ACTION_POS_HAPPY = 3,
    CLAW_MOTION_ACTION_COUNT = 4,
} claw_motion_action_id_t;

/* Scene Metadata */
static const gfx_motion_meta_t claw_motion_meta = {
    .version   = GFX_MOTION_SCENE_SCHEMA_VERSION,
    .viewbox_x = 0,
    .viewbox_y = 0,
    .viewbox_w = 1136,
    .viewbox_h = 960,
};

/* Layout Hints */
static const gfx_motion_layout_t claw_motion_layout = {
    .stroke_width    = 5,
    .mirror_x        = 0,
    .ground_y        = 960,
    .timer_period_ms = 33,
    .damping_div     = 4,
};

/* Control Point Names */
static const char *const claw_motion_joint_names[] = {
    "ind15_gr_0_sh_0_0", /* 0 */
    "ind15_gr_0_sh_0_1", /* 1 */
    "ind15_gr_0_sh_0_2", /* 2 */
    "ind15_gr_0_sh_0_3", /* 3 */
    "ind15_gr_0_sh_0_4", /* 4 */
    "ind15_gr_0_sh_0_5", /* 5 */
    "ind15_gr_0_sh_0_6", /* 6 */
    "ind14_gr_0_sh_0_0", /* 7 */
    "ind14_gr_0_sh_0_1", /* 8 */
    "ind14_gr_0_sh_0_2", /* 9 */
    "ind14_gr_0_sh_0_3", /* 10 */
    "ind14_gr_0_sh_0_4", /* 11 */
    "ind14_gr_0_sh_0_5", /* 12 */
    "ind14_gr_0_sh_0_6", /* 13 */
    "ind14_gr_0_sh_0_7", /* 14 */
    "ind14_gr_0_sh_0_8", /* 15 */
    "ind14_gr_0_sh_0_9", /* 16 */
    "ind14_gr_0_sh_0_10", /* 17 */
    "ind14_gr_0_sh_0_11", /* 18 */
    "ind14_gr_0_sh_0_12", /* 19 */
    "ind14_gr_0_sh_0_13", /* 20 */
    "ind14_gr_0_sh_0_14", /* 21 */
    "ind14_gr_0_sh_0_15", /* 22 */
    "ind14_gr_0_sh_0_16", /* 23 */
    "ind14_gr_0_sh_0_17", /* 24 */
    "ind14_gr_0_sh_0_18", /* 25 */
    "ind14_gr_0_sh_0_19", /* 26 */
    "ind14_gr_0_sh_0_20", /* 27 */
    "ind14_gr_0_sh_0_21", /* 28 */
    "ind14_gr_0_sh_0_22", /* 29 */
    "ind14_gr_0_sh_0_23", /* 30 */
    "ind14_gr_0_sh_0_24", /* 31 */
    "ind14_gr_0_sh_0_25", /* 32 */
    "ind14_gr_0_sh_0_26", /* 33 */
    "ind14_gr_0_sh_0_27", /* 34 */
    "ind14_gr_0_sh_0_28", /* 35 */
    "ind14_gr_0_sh_0_29", /* 36 */
    "ind14_gr_0_sh_0_30", /* 37 */
    "ind14_gr_0_sh_0_31", /* 38 */
    "ind14_gr_0_sh_0_32", /* 39 */
    "ind14_gr_0_sh_0_33", /* 40 */
    "ind13_gr_0_sh_0_0", /* 41 */
    "ind13_gr_0_sh_0_1", /* 42 */
    "ind13_gr_0_sh_0_2", /* 43 */
    "ind13_gr_0_sh_0_3", /* 44 */
    "ind13_gr_0_sh_0_4", /* 45 */
    "ind13_gr_0_sh_0_5", /* 46 */
    "ind13_gr_0_sh_0_6", /* 47 */
    "ind8_gr_0_sh_0_stroke_0", /* 48 */
    "ind8_gr_0_sh_0_stroke_1", /* 49 */
    "ind8_gr_0_sh_0_stroke_2", /* 50 */
    "ind8_gr_0_sh_0_stroke_3", /* 51 */
    "ind8_gr_0_sh_0_stroke_4", /* 52 */
    "ind8_gr_0_sh_0_stroke_5", /* 53 */
    "ind8_gr_0_sh_0_stroke_6", /* 54 */
    "ind8_gr_0_sh_0_stroke_7", /* 55 */
    "ind8_gr_0_sh_0_stroke_8", /* 56 */
    "ind8_gr_0_sh_0_stroke_9", /* 57 */
    "ind8_gr_0_sh_0_stroke_10", /* 58 */
    "ind8_gr_0_sh_0_stroke_11", /* 59 */
    "ind8_gr_0_sh_0_stroke_12", /* 60 */
    "ind8_gr_0_sh_0_stroke_13", /* 61 */
    "ind8_gr_0_sh_0_stroke_14", /* 62 */
    "ind8_gr_0_sh_0_stroke_15", /* 63 */
    "ind8_gr_0_sh_0_stroke_16", /* 64 */
    "ind8_gr_0_sh_0_stroke_17", /* 65 */
    "ind8_gr_0_sh_0_stroke_18", /* 66 */
    "ind8_gr_0_sh_0_stroke_19", /* 67 */
    "ind8_gr_0_sh_0_stroke_20", /* 68 */
    "ind8_gr_0_sh_0_stroke_21", /* 69 */
    "ind8_gr_0_sh_0_stroke_22", /* 70 */
    "ind8_gr_0_sh_0_stroke_23", /* 71 */
    "ind8_gr_0_sh_0_stroke_24", /* 72 */
    "ind8_gr_0_sh_0_stroke_25", /* 73 */
    "ind8_gr_0_sh_0_stroke_26", /* 74 */
    "ind8_gr_0_sh_0_stroke_27", /* 75 */
    "ind12_gr_0_sh_0_stroke_0", /* 76 */
    "ind12_gr_0_sh_0_stroke_1", /* 77 */
    "ind12_gr_0_sh_0_stroke_2", /* 78 */
    "ind12_gr_0_sh_0_stroke_3", /* 79 */
    "ind12_gr_0_sh_0_stroke_4", /* 80 */
    "ind12_gr_0_sh_0_stroke_5", /* 81 */
    "ind12_gr_0_sh_0_stroke_6", /* 82 */
    "ind12_gr_0_sh_0_stroke_7", /* 83 */
    "ind12_gr_0_sh_0_stroke_8", /* 84 */
    "ind12_gr_0_sh_0_stroke_9", /* 85 */
    "ind12_gr_0_sh_0_stroke_10", /* 86 */
    "ind12_gr_0_sh_0_stroke_11", /* 87 */
    "ind12_gr_0_sh_0_stroke_12", /* 88 */
    "ind12_gr_0_sh_0_stroke_13", /* 89 */
    "ind12_gr_0_sh_0_stroke_14", /* 90 */
    "ind12_gr_0_sh_0_stroke_15", /* 91 */
    "ind12_gr_0_sh_0_stroke_16", /* 92 */
    "ind12_gr_0_sh_0_stroke_17", /* 93 */
    "ind12_gr_0_sh_0_stroke_18", /* 94 */
    "ind12_gr_0_sh_0_stroke_19", /* 95 */
    "ind12_gr_0_sh_0_stroke_20", /* 96 */
    "ind12_gr_0_sh_0_stroke_21", /* 97 */
    "ind12_gr_0_sh_0_stroke_22", /* 98 */
    "ind12_gr_0_sh_0_stroke_23", /* 99 */
    "ind12_gr_0_sh_0_stroke_24", /* 100 */
    "ind12_gr_0_sh_0_stroke_25", /* 101 */
    "ind12_gr_0_sh_0_stroke_26", /* 102 */
    "ind12_gr_0_sh_0_stroke_27", /* 103 */
    "ind12_gr_0_sh_0_stroke_28", /* 104 */
    "ind12_gr_0_sh_0_stroke_29", /* 105 */
    "ind12_gr_0_sh_0_stroke_30", /* 106 */
    "ind12_gr_0_sh_0_stroke_31", /* 107 */
    "ind12_gr_0_sh_0_stroke_32", /* 108 */
    "ind12_gr_0_sh_0_stroke_33", /* 109 */
    "ind11_gr_0_sh_0_0", /* 110 */
    "ind11_gr_0_sh_0_1", /* 111 */
    "ind11_gr_0_sh_0_2", /* 112 */
    "ind11_gr_0_sh_0_3", /* 113 */
    "ind11_gr_0_sh_0_4", /* 114 */
    "ind11_gr_0_sh_0_5", /* 115 */
    "ind11_gr_0_sh_0_6", /* 116 */
    "ind11_gr_0_sh_0_7", /* 117 */
    "ind11_gr_0_sh_0_8", /* 118 */
    "ind11_gr_0_sh_0_9", /* 119 */
    "ind11_gr_0_sh_0_10", /* 120 */
    "ind11_gr_0_sh_0_11", /* 121 */
    "ind11_gr_0_sh_0_12", /* 122 */
    "ind11_gr_0_sh_0_13", /* 123 */
    "ind11_gr_0_sh_0_14", /* 124 */
    "ind11_gr_0_sh_0_15", /* 125 */
    "ind11_gr_0_sh_0_16", /* 126 */
    "ind11_gr_0_sh_0_17", /* 127 */
    "ind11_gr_0_sh_0_18", /* 128 */
    "ind11_gr_0_sh_0_19", /* 129 */
    "ind11_gr_0_sh_0_20", /* 130 */
    "ind11_gr_0_sh_0_21", /* 131 */
    "ind11_gr_0_sh_0_22", /* 132 */
    "ind11_gr_0_sh_0_23", /* 133 */
    "ind11_gr_0_sh_0_24", /* 134 */
    "ind11_gr_0_sh_0_25", /* 135 */
    "ind11_gr_0_sh_0_26", /* 136 */
    "ind11_gr_0_sh_0_27", /* 137 */
    "ind11_gr_0_sh_0_28", /* 138 */
    "ind11_gr_0_sh_0_29", /* 139 */
    "ind11_gr_0_sh_0_30", /* 140 */
    "ind10_gr_0_sh_0_0", /* 141 */
    "ind10_gr_0_sh_0_1", /* 142 */
    "ind10_gr_0_sh_0_2", /* 143 */
    "ind10_gr_0_sh_0_3", /* 144 */
    "ind10_gr_0_sh_0_4", /* 145 */
    "ind10_gr_0_sh_0_5", /* 146 */
    "ind10_gr_0_sh_0_6", /* 147 */
    "ind10_gr_0_sh_0_7", /* 148 */
    "ind10_gr_0_sh_0_8", /* 149 */
    "ind10_gr_0_sh_0_9", /* 150 */
    "ind10_gr_0_sh_0_10", /* 151 */
    "ind10_gr_0_sh_0_11", /* 152 */
    "ind10_gr_0_sh_0_12", /* 153 */
    "ind10_gr_0_sh_0_13", /* 154 */
    "ind10_gr_0_sh_0_14", /* 155 */
    "ind10_gr_0_sh_0_15", /* 156 */
    "ind10_gr_0_sh_0_16", /* 157 */
    "ind10_gr_0_sh_0_17", /* 158 */
    "ind10_gr_0_sh_0_18", /* 159 */
    "ind10_gr_0_sh_0_19", /* 160 */
    "ind10_gr_0_sh_0_20", /* 161 */
    "ind10_gr_0_sh_0_21", /* 162 */
    "ind10_gr_0_sh_0_22", /* 163 */
    "ind10_gr_0_sh_0_23", /* 164 */
    "ind10_gr_0_sh_0_24", /* 165 */
    "ind10_gr_0_sh_0_25", /* 166 */
    "ind10_gr_0_sh_0_26", /* 167 */
    "ind10_gr_0_sh_0_27", /* 168 */
    "ind10_gr_0_sh_0_28", /* 169 */
    "ind10_gr_0_sh_0_29", /* 170 */
    "ind10_gr_0_sh_0_30", /* 171 */
    "ind10_gr_0_sh_0_31", /* 172 */
    "ind10_gr_0_sh_0_32", /* 173 */
    "ind10_gr_0_sh_0_33", /* 174 */
    "ind9_gr_0_sh_0_0", /* 175 */
    "ind9_gr_0_sh_0_1", /* 176 */
    "ind9_gr_0_sh_0_2", /* 177 */
    "ind9_gr_0_sh_0_3", /* 178 */
    "ind9_gr_0_sh_0_4", /* 179 */
    "ind9_gr_0_sh_0_5", /* 180 */
    "ind9_gr_0_sh_0_6", /* 181 */
    "ind9_gr_0_sh_0_7", /* 182 */
    "ind9_gr_0_sh_0_8", /* 183 */
    "ind9_gr_0_sh_0_9", /* 184 */
    "ind9_gr_0_sh_0_10", /* 185 */
    "ind9_gr_0_sh_0_11", /* 186 */
    "ind9_gr_0_sh_0_12", /* 187 */
    "ind9_gr_0_sh_0_13", /* 188 */
    "ind9_gr_0_sh_0_14", /* 189 */
    "ind9_gr_0_sh_0_15", /* 190 */
    "ind9_gr_0_sh_0_16", /* 191 */
    "ind9_gr_0_sh_0_17", /* 192 */
    "ind9_gr_0_sh_0_18", /* 193 */
    "ind9_gr_0_sh_0_19", /* 194 */
    "ind9_gr_0_sh_0_20", /* 195 */
    "ind9_gr_0_sh_0_21", /* 196 */
    "ind9_gr_0_sh_0_22", /* 197 */
    "ind9_gr_0_sh_0_23", /* 198 */
    "ind9_gr_0_sh_0_24", /* 199 */
    "ind9_gr_0_sh_0_25", /* 200 */
    "ind9_gr_0_sh_0_26", /* 201 */
    "ind9_gr_0_sh_0_27", /* 202 */
    "ind9_gr_0_sh_0_28", /* 203 */
    "ind9_gr_0_sh_0_29", /* 204 */
    "ind9_gr_0_sh_0_30", /* 205 */
    "ind9_gr_0_sh_0_31", /* 206 */
    "ind9_gr_0_sh_0_32", /* 207 */
    "ind9_gr_0_sh_0_33", /* 208 */
    "ind7_gr_0_sh_0_0", /* 209 */
    "ind7_gr_0_sh_0_1", /* 210 */
    "ind7_gr_0_sh_0_2", /* 211 */
    "ind7_gr_0_sh_0_3", /* 212 */
    "ind7_gr_0_sh_0_4", /* 213 */
    "ind7_gr_0_sh_0_5", /* 214 */
    "ind7_gr_0_sh_0_6", /* 215 */
    "ind7_gr_0_sh_0_7", /* 216 */
    "ind7_gr_0_sh_0_8", /* 217 */
    "ind7_gr_0_sh_0_9", /* 218 */
    "ind7_gr_0_sh_0_10", /* 219 */
    "ind7_gr_0_sh_0_11", /* 220 */
    "ind7_gr_0_sh_0_12", /* 221 */
    "ind7_gr_0_sh_0_13", /* 222 */
    "ind7_gr_0_sh_0_14", /* 223 */
    "ind7_gr_0_sh_0_15", /* 224 */
    "ind6_gr_0_sh_0_0", /* 225 */
    "ind6_gr_0_sh_0_1", /* 226 */
    "ind6_gr_0_sh_0_2", /* 227 */
    "ind6_gr_0_sh_0_3", /* 228 */
    "ind6_gr_0_sh_0_4", /* 229 */
    "ind6_gr_0_sh_0_5", /* 230 */
    "ind6_gr_0_sh_0_6", /* 231 */
    "ind6_gr_0_sh_0_7", /* 232 */
    "ind6_gr_0_sh_0_8", /* 233 */
    "ind6_gr_0_sh_0_9", /* 234 */
    "ind6_gr_0_sh_0_10", /* 235 */
    "ind6_gr_0_sh_0_11", /* 236 */
    "ind6_gr_0_sh_0_12", /* 237 */
    "ind6_gr_0_sh_0_13", /* 238 */
    "ind6_gr_0_sh_0_14", /* 239 */
    "ind6_gr_0_sh_0_15", /* 240 */
    "ind5_gr_0_sh_0_0", /* 241 */
    "ind5_gr_0_sh_0_1", /* 242 */
    "ind5_gr_0_sh_0_2", /* 243 */
    "ind5_gr_0_sh_0_3", /* 244 */
    "ind5_gr_0_sh_0_4", /* 245 */
    "ind5_gr_0_sh_0_5", /* 246 */
    "ind5_gr_0_sh_0_6", /* 247 */
    "ind5_gr_0_sh_0_7", /* 248 */
    "ind5_gr_0_sh_0_8", /* 249 */
    "ind5_gr_0_sh_0_9", /* 250 */
    "ind5_gr_0_sh_0_10", /* 251 */
    "ind5_gr_0_sh_0_11", /* 252 */
    "ind5_gr_0_sh_0_12", /* 253 */
    "ind5_gr_0_sh_0_13", /* 254 */
    "ind5_gr_0_sh_0_14", /* 255 */
    "ind5_gr_0_sh_0_15", /* 256 */
    "ind4_gr_0_sh_0_0", /* 257 */
    "ind4_gr_0_sh_0_1", /* 258 */
    "ind4_gr_0_sh_0_2", /* 259 */
    "ind4_gr_0_sh_0_3", /* 260 */
    "ind4_gr_0_sh_0_4", /* 261 */
    "ind4_gr_0_sh_0_5", /* 262 */
    "ind4_gr_0_sh_0_6", /* 263 */
    "ind4_gr_0_sh_0_7", /* 264 */
    "ind4_gr_0_sh_0_8", /* 265 */
    "ind4_gr_0_sh_0_9", /* 266 */
    "ind4_gr_0_sh_0_10", /* 267 */
    "ind4_gr_0_sh_0_11", /* 268 */
    "ind4_gr_0_sh_0_12", /* 269 */
    "ind4_gr_0_sh_0_13", /* 270 */
    "ind4_gr_0_sh_0_14", /* 271 */
    "ind4_gr_0_sh_0_15", /* 272 */
    "ind4_gr_0_sh_0_16", /* 273 */
    "ind4_gr_0_sh_0_17", /* 274 */
    "ind4_gr_0_sh_0_18", /* 275 */
    "ind4_gr_0_sh_0_19", /* 276 */
    "ind4_gr_0_sh_0_20", /* 277 */
    "ind4_gr_0_sh_0_21", /* 278 */
    "ind4_gr_0_sh_0_22", /* 279 */
    "ind4_gr_0_sh_0_23", /* 280 */
    "ind4_gr_0_sh_0_24", /* 281 */
    "ind4_gr_0_sh_0_25", /* 282 */
    "ind4_gr_0_sh_0_26", /* 283 */
    "ind4_gr_0_sh_0_27", /* 284 */
    "lottielab_com_gr_0_sh_0_0", /* 285 */
    "lottielab_com_gr_0_sh_0_1", /* 286 */
    "lottielab_com_gr_0_sh_0_2", /* 287 */
    "lottielab_com_gr_0_sh_0_3", /* 288 */
    "lottielab_com_gr_0_sh_0_4", /* 289 */
    "lottielab_com_gr_0_sh_0_5", /* 290 */
    "lottielab_com_gr_0_sh_0_6", /* 291 */
    "lottielab_com_gr_0_sh_0_7", /* 292 */
    "lottielab_com_gr_0_sh_0_8", /* 293 */
    "lottielab_com_gr_0_sh_0_9", /* 294 */
    "lottielab_com_gr_0_sh_0_10", /* 295 */
    "lottielab_com_gr_0_sh_0_11", /* 296 */
    "lottielab_com_gr_0_sh_0_12", /* 297 */
    "lottielab_com_gr_0_sh_0_13", /* 298 */
    "lottielab_com_gr_0_sh_0_14", /* 299 */
    "lottielab_com_gr_0_sh_0_15", /* 300 */
    "lottielab_com_gr_0_sh_0_16", /* 301 */
    "lottielab_com_gr_0_sh_0_17", /* 302 */
    "lottielab_com_gr_0_sh_0_18", /* 303 */
    "lottielab_com_gr_0_sh_0_19", /* 304 */
    "lottielab_com_gr_0_sh_0_20", /* 305 */
    "lottielab_com_gr_0_sh_0_21", /* 306 */
    "lottielab_com_gr_0_sh_0_22", /* 307 */
    "lottielab_com_gr_0_sh_0_23", /* 308 */
    "lottielab_com_gr_0_sh_0_24", /* 309 */
    "lottielab_com_gr_0_sh_0_25", /* 310 */
    "lottielab_com_gr_0_sh_0_26", /* 311 */
    "lottielab_com_gr_0_sh_0_27", /* 312 */
    "ind3_gr_0_sh_0_fill_0", /* 313 */
    "ind3_gr_0_sh_0_fill_1", /* 314 */
    "ind3_gr_0_sh_0_fill_2", /* 315 */
    "ind3_gr_0_sh_0_fill_3", /* 316 */
    "ind3_gr_0_sh_0_fill_4", /* 317 */
    "ind3_gr_0_sh_0_fill_5", /* 318 */
    "ind3_gr_0_sh_0_fill_6", /* 319 */
    "ind3_gr_0_sh_0_fill_7", /* 320 */
    "ind3_gr_0_sh_0_fill_8", /* 321 */
    "ind3_gr_0_sh_0_fill_9", /* 322 */
    "ind3_gr_0_sh_0_fill_10", /* 323 */
    "ind3_gr_0_sh_0_fill_11", /* 324 */
    "ind3_gr_0_sh_0_fill_12", /* 325 */
    "ind3_gr_0_sh_0_fill_13", /* 326 */
    "ind3_gr_0_sh_0_fill_14", /* 327 */
    "ind3_gr_0_sh_0_fill_15", /* 328 */
    "ind3_gr_0_sh_0_fill_16", /* 329 */
    "ind3_gr_0_sh_0_fill_17", /* 330 */
    "ind3_gr_0_sh_0_fill_18", /* 331 */
    "ind3_gr_0_sh_0_fill_19", /* 332 */
    "ind3_gr_0_sh_0_fill_20", /* 333 */
    "ind3_gr_0_sh_0_fill_21", /* 334 */
    "ind3_gr_0_sh_0_fill_22", /* 335 */
    "ind3_gr_0_sh_0_fill_23", /* 336 */
    "ind3_gr_0_sh_0_fill_24", /* 337 */
    "ind3_gr_0_sh_0_fill_25", /* 338 */
    "ind3_gr_0_sh_0_fill_26", /* 339 */
    "ind3_gr_0_sh_0_fill_27", /* 340 */
    "ind2_gr_0_sh_0_fill_0", /* 341 */
    "ind2_gr_0_sh_0_fill_1", /* 342 */
    "ind2_gr_0_sh_0_fill_2", /* 343 */
    "ind2_gr_0_sh_0_fill_3", /* 344 */
    "ind2_gr_0_sh_0_fill_4", /* 345 */
    "ind2_gr_0_sh_0_fill_5", /* 346 */
    "ind2_gr_0_sh_0_fill_6", /* 347 */
    "ind2_gr_0_sh_0_fill_7", /* 348 */
    "ind2_gr_0_sh_0_fill_8", /* 349 */
    "ind2_gr_0_sh_0_fill_9", /* 350 */
    "ind2_gr_0_sh_0_fill_10", /* 351 */
    "ind2_gr_0_sh_0_fill_11", /* 352 */
    "ind2_gr_0_sh_0_fill_12", /* 353 */
    "ind2_gr_0_sh_0_fill_13", /* 354 */
    "ind2_gr_0_sh_0_fill_14", /* 355 */
    "ind2_gr_0_sh_0_fill_15", /* 356 */
    "ind2_gr_0_sh_0_fill_16", /* 357 */
    "ind2_gr_0_sh_0_fill_17", /* 358 */
    "ind2_gr_0_sh_0_fill_18", /* 359 */
    "ind2_gr_0_sh_0_fill_19", /* 360 */
    "ind2_gr_0_sh_0_fill_20", /* 361 */
    "ind2_gr_0_sh_0_fill_21", /* 362 */
    "ind2_gr_0_sh_0_fill_22", /* 363 */
    "ind2_gr_0_sh_0_fill_23", /* 364 */
    "ind2_gr_0_sh_0_fill_24", /* 365 */
    "ind2_gr_0_sh_0_fill_25", /* 366 */
    "ind2_gr_0_sh_0_fill_26", /* 367 */
    "ind2_gr_0_sh_0_fill_27", /* 368 */
};

/* Pose Keyframes */
static const int16_t claw_motion_p00[] = { /* pose_1_down */
    475, 361, 476, 331, 470, 317, 458, 310, 446, 303, 426, 320, 428, 342, 395, 537, 390, 544, 379, 560, 372, 573, 364, 588, 360, 593, 355, 593, 349, 593, 343, 588,
    331, 568, 319, 548, 320, 522, 336, 497, 352, 471, 388, 459, 416, 469, 445, 479, 462, 504, 465, 530, 468, 557, 455, 582, 433, 596, 411, 609, 394, 609, 388, 608,
    382, 606, 378, 600, 380, 595, 381, 590, 390, 554, 395, 537, 395, 537, 395, 537, 395, 537, 547, 361, 550, 324, 545, 307, 532, 304, 519, 300, 506, 322, 507, 336,
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    547, 408,
};
static const int16_t claw_motion_p01[] = { /* pose_2_happy */
    475, 361, 473, 329, 484, 314, 498, 304, 509, 296, 529, 289, 538, 287, 364, 425, 365, 430, 376, 465, 382, 482, 382, 482, 382, 482, 382, 482, 382, 473, 383, 454,
    382, 440, 381, 422, 382, 416, 386, 413, 391, 410, 399, 411, 420, 422, 440, 433, 453, 455, 453, 485, 453, 515, 428, 545, 399, 551, 370, 557, 342, 545, 325, 524,
    308, 503, 306, 475, 318, 452, 330, 429, 344, 420, 350, 418, 356, 416, 362, 419, 364, 425, 547, 361, 546, 329, 556, 314, 570, 304, 582, 296, 602, 290, 610, 287,
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    548, 400,
};
static const int16_t claw_motion_p02[] = { /* pose_3_idle */
    475, 361, 473, 329, 484, 314, 498, 304, 509, 296, 529, 289, 538, 287, 379, 514, 379, 514, 379, 514, 379, 514, 371, 516, 352, 523, 340, 529, 323, 536, 318, 538,
    313, 535, 309, 532, 307, 524, 309, 501, 312, 477, 328, 458, 356, 446, 383, 435, 420, 447, 437, 472, 454, 497, 452, 527, 439, 550, 426, 574, 400, 586, 375, 584,
    349, 582, 335, 571, 331, 566, 328, 562, 328, 555, 332, 551, 336, 548, 365, 525, 379, 514, 547, 361, 546, 329, 556, 314, 570, 304, 582, 296, 602, 290, 610, 287,
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    548, 371,
};
static const int16_t claw_motion_p03[] = { /* pose_4_move */
    475, 361, 473, 329, 484, 314, 498, 304, 509, 296, 529, 289, 538, 287, 349, 496, 349, 496, 349, 496, 349, 496, 341, 495, 321, 494, 307, 494, 290, 493, 284, 493,
    281, 488, 278, 484, 280, 475, 292, 455, 304, 435, 326, 424, 356, 425, 386, 427, 414, 453, 419, 482, 424, 512, 411, 539, 389, 554, 367, 570, 339, 571, 316, 558,
    294, 545, 286, 530, 284, 524, 283, 518, 286, 512, 292, 511, 297, 510, 332, 500, 349, 496, 547, 361, 546, 329, 556, 314, 570, 304, 582, 296, 602, 290, 610, 287,
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    548, 371,
};
static const int16_t claw_motion_p04[] = { /* pose_5_thinking */
    475, 362, 474, 329, 475, 319, 475, 309, 475, 299, 475, 279, 475, 272, 384, 555, 387, 572, 388, 578, 384, 582, 380, 585, 371, 586, 349, 577, 328, 569, 312, 549,
    308, 519, 304, 489, 325, 457, 353, 447, 381, 437, 410, 445, 430, 464, 449, 483, 455, 510, 446, 535, 438, 559, 424, 570, 419, 572, 413, 575, 406, 573, 404, 567,
    402, 563, 387, 530, 379, 513, 379, 513, 379, 513, 379, 513, 380, 522, 382, 541, 384, 555, 547, 361, 547, 330, 547, 327, 547, 311, 547, 295, 548, 285, 547, 272,
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    548, 397,
};
static const int16_t claw_motion_p05[] = { /* pose_6_move1 */
    475, 361, 473, 329, 484, 314, 498, 304, 509, 296, 529, 289, 538, 287, 379, 514, 379, 514, 379, 514, 379, 514, 371, 516, 352, 523, 340, 529, 323, 536, 318, 538,
    313, 535, 309, 532, 307, 524, 309, 501, 312, 477, 328, 458, 356, 446, 383, 435, 420, 447, 437, 472, 454, 497, 452, 527, 439, 550, 426, 574, 400, 586, 375, 584,
    349, 582, 335, 571, 331, 566, 328, 562, 328, 555, 332, 551, 336, 548, 365, 525, 379, 514, 547, 361, 546, 329, 556, 314, 570, 304, 582, 296, 602, 290, 610, 287,
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    548, 371,
};
static const int16_t claw_motion_p06[] = { /* pose_7_move2 */
    475, 361, 473, 329, 484, 314, 498, 304, 509, 296, 529, 289, 538, 287, 364, 505, 364, 505, 364, 505, 364, 505, 356, 506, 336, 509, 322, 511, 305, 515, 299, 516,
    296, 512, 292, 508, 292, 499, 299, 477, 307, 455, 326, 439, 356, 434, 385, 429, 418, 449, 430, 477, 441, 504, 433, 533, 415, 553, 397, 574, 370, 580, 345, 573,
    320, 565, 309, 552, 307, 546, 304, 541, 305, 534, 311, 532, 315, 529, 348, 513, 364, 505, 547, 361, 546, 329, 556, 314, 570, 304, 582, 296, 602, 290, 610, 287,
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    548, 371,
};
static const int16_t claw_motion_p07[] = { /* pose_8_move3 */
    475, 361, 473, 329, 484, 314, 498, 304, 509, 296, 529, 289, 538, 287, 349, 496, 349, 496, 349, 496, 349, 496, 341, 495, 321, 494, 307, 494, 290, 493, 284, 493,
    281, 488, 278, 484, 280, 475, 292, 455, 304, 435, 326, 424, 356, 425, 386, 427, 414, 453, 419, 482, 424, 512, 411, 539, 389, 554, 367, 570, 339, 571, 316, 558,
    294, 545, 286, 530, 284, 524, 283, 518, 286, 512, 292, 511, 297, 510, 332, 500, 349, 496, 547, 361, 546, 329, 556, 314, 570, 304, 582, 296, 602, 290, 610, 287,
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    548, 371,
};

#define CLAW_MOTION_POSE(arr) { .coords = (arr) }

static const gfx_motion_pose_t claw_motion_poses[] = {
    CLAW_MOTION_POSE(claw_motion_p00),  CLAW_MOTION_POSE(claw_motion_p01),  CLAW_MOTION_POSE(claw_motion_p02),
    CLAW_MOTION_POSE(claw_motion_p03),  CLAW_MOTION_POSE(claw_motion_p04),  CLAW_MOTION_POSE(claw_motion_p05),
    CLAW_MOTION_POSE(claw_motion_p06),  CLAW_MOTION_POSE(claw_motion_p07),
};

/* Visual Parts */
static const gfx_motion_segment_t claw_motion_segments[] = {
    /* ind15_gr_0_sh_0 */ { .kind = GFX_MOTION_SEG_BEZIER_STRIP, .joint_a = 0, .joint_count = 7, .color_idx = 1 },
    /* ind14_gr_0_sh_0 */ { .kind = GFX_MOTION_SEG_BEZIER_FILL, .joint_a = 7, .joint_count = 34, .color_idx = 5 },
    /* ind13_gr_0_sh_0 */ { .kind = GFX_MOTION_SEG_BEZIER_STRIP, .joint_a = 41, .joint_count = 7, .color_idx = 1 },
    /* ind8_gr_0_sh_0_stroke */ { .kind = GFX_MOTION_SEG_BEZIER_FILL, .joint_a = 48, .joint_count = 28, .color_idx = 1 },
    /* ind12_gr_0_sh_0_stroke */ { .kind = GFX_MOTION_SEG_BEZIER_FILL, .joint_a = 76, .joint_count = 34, .color_idx = 5 },
    /* ind11_gr_0_sh_0 */ { .kind = GFX_MOTION_SEG_BEZIER_FILL, .joint_a = 110, .joint_count = 31, .color_idx = 1 },
    /* ind10_gr_0_sh_0 */ { .kind = GFX_MOTION_SEG_BEZIER_FILL, .joint_a = 141, .joint_count = 34, .color_idx = 1 },
    /* ind9_gr_0_sh_0 */ { .kind = GFX_MOTION_SEG_BEZIER_FILL, .joint_a = 175, .joint_count = 34, .color_idx = 1 },
    /* ind7_gr_0_sh_0 */ { .kind = GFX_MOTION_SEG_BEZIER_FILL, .joint_a = 209, .joint_count = 16, .color_idx = 1 },
    /* ind6_gr_0_sh_0 */ { .kind = GFX_MOTION_SEG_BEZIER_FILL, .joint_a = 225, .joint_count = 16, .color_idx = 1 },
    /* ind5_gr_0_sh_0 */ { .kind = GFX_MOTION_SEG_BEZIER_FILL, .joint_a = 241, .joint_count = 16, .color_idx = 1 },
    /* ind4_gr_0_sh_0 */ { .kind = GFX_MOTION_SEG_BEZIER_FILL, .joint_a = 257, .joint_count = 28, .color_idx = 2 },
    /* lottielab_com_gr_0_sh_0 */ { .kind = GFX_MOTION_SEG_BEZIER_FILL, .joint_a = 285, .joint_count = 28, .color_idx = 3 },
    /* ind3_gr_0_sh_0_fill */ { .kind = GFX_MOTION_SEG_BEZIER_FILL, .joint_a = 313, .joint_count = 28, .color_idx = 4 },
    /* ind2_gr_0_sh_0_fill */ { .kind = GFX_MOTION_SEG_BEZIER_FILL, .joint_a = 341, .joint_count = 28, .color_idx = 4 },
};

/* Color Palette */
static const uint32_t claw_motion_color_palette[] = { 0xFF4D2B, 0xF5F0F0, 0xF9F6F5, 0x221814, 0xE43F22 };

/* Motion Action Timelines */
#define CLAW_MOTION_STEP(p, h, f, i) { .pose_index = (p), .hold_ticks = (h), .interp = (i), .facing = (f) }

static const gfx_motion_action_step_t claw_motion_steps_pos_move[] = {
    CLAW_MOTION_STEP(3, 8, 1, GFX_MOTION_INTERP_DAMPED),
    CLAW_MOTION_STEP(5, 8, 1, GFX_MOTION_INTERP_DAMPED),
    CLAW_MOTION_STEP(6, 8, 1, GFX_MOTION_INTERP_DAMPED),
    CLAW_MOTION_STEP(7, 6, 1, GFX_MOTION_INTERP_DAMPED),
};
static const gfx_motion_action_step_t claw_motion_steps_pos_down[] = {
    CLAW_MOTION_STEP(2, 10, 1, GFX_MOTION_INTERP_DAMPED),
    CLAW_MOTION_STEP(0, 100, 1, GFX_MOTION_INTERP_DAMPED),
};
static const gfx_motion_action_step_t claw_motion_steps_pos_thinking[] = {
    CLAW_MOTION_STEP(2, 10, 1, GFX_MOTION_INTERP_DAMPED),
    CLAW_MOTION_STEP(4, 100, 1, GFX_MOTION_INTERP_DAMPED),
};
static const gfx_motion_action_step_t claw_motion_steps_pos_happy[] = {
    CLAW_MOTION_STEP(2, 10, 1, GFX_MOTION_INTERP_DAMPED),
    CLAW_MOTION_STEP(1, 100, 1, GFX_MOTION_INTERP_DAMPED),
};

#define CLAW_MOTION_ACTION(arr, lp) { .steps = (arr), .step_count = (uint8_t)(sizeof(arr) / sizeof((arr)[0])), .loop = (lp) }

static const gfx_motion_action_t claw_motion_actions[] = {
    /* pos_move */ CLAW_MOTION_ACTION(claw_motion_steps_pos_move, true),
    /* pos_down */ CLAW_MOTION_ACTION(claw_motion_steps_pos_down, true),
    /* pos_thinking */ CLAW_MOTION_ACTION(claw_motion_steps_pos_thinking, true),
    /* pos_happy */ CLAW_MOTION_ACTION(claw_motion_steps_pos_happy, true),
};

/* Default Playback Sequence */
static const uint16_t claw_motion_sequence[] = { 0, 1, 2, 3 };

/* Runtime Asset Bundle */
static const gfx_motion_asset_t claw_motion_scene_asset = {
    .meta           = &claw_motion_meta,
    .joint_names    = claw_motion_joint_names,
    .joint_count    = (uint16_t)(sizeof(claw_motion_joint_names) / sizeof(claw_motion_joint_names[0])),
    .segments       = claw_motion_segments,
    .segment_count  = (uint8_t)(sizeof(claw_motion_segments) / sizeof(claw_motion_segments[0])),
    .poses          = claw_motion_poses,
    .pose_count     = (uint16_t)(sizeof(claw_motion_poses) / sizeof(claw_motion_poses[0])),
    .actions        = claw_motion_actions,
    .action_count   = (uint16_t)(sizeof(claw_motion_actions) / sizeof(claw_motion_actions[0])),
    .sequence       = claw_motion_sequence,
    .sequence_count = (uint16_t)(sizeof(claw_motion_sequence) / sizeof(claw_motion_sequence[0])),
    .layout         = &claw_motion_layout,
    .color_palette  = claw_motion_color_palette,
    .color_palette_count = (uint8_t)(sizeof(claw_motion_color_palette) / sizeof(claw_motion_color_palette[0])),
};

#undef CLAW_MOTION_POSE
#undef CLAW_MOTION_STEP
#undef CLAW_MOTION_ACTION
