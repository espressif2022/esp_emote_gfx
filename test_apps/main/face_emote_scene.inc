/*
 * SPDX-FileCopyrightText: 2026 Espressif Systems (Shanghai) CO LTD
 *
 * SPDX-License-Identifier: Apache-2.0
 *
 * face_emote_scene.inc — facial expression scene in the unified gfx_sm_scene format.
 *
 * Format version: GFX_SM_SCENE_SCHEMA_VERSION (2)
 *
 * Joints are BÉZIER CONTROL POINTS in design space (viewbox 200×200, centred at 0,0).
 * Segments encode the rendering primitive for each joint group:
 *
 *   Segment  Joints         Kind           Notes
 *   ───────  ─────────────  ─────────────  ──────────────
 *   mouth    0-6  (7 pts)   BEZIER_LOOP    solid colour
 *   eye_l    7-13 (7 pts)   BEZIER_FILL    solid colour
 *   eye_r    14-20 (7 pts)  BEZIER_FILL    solid colour
 *   brow_l   21-24 (4 pts)  BEZIER_STRIP   solid colour
 *   brow_r   25-28 (4 pts)  BEZIER_STRIP   solid colour
 *
 * Joint index table (0-based, 29 joints):
 *   0-6    mouth  (7 cubic Bézier ctrl pts)
 *   7-13   eye_l  (7 cubic Bézier ctrl pts, two-half fill)
 *   14-20  eye_r  (7 cubic Bézier ctrl pts, two-half fill)
 *   21-24  brow_l (4 cubic Bézier ctrl pts)
 *   25-28  brow_r (4 cubic Bézier ctrl pts)
 *
 * Pose data is pre-computed from face_emote_expr_assets.inc.
 * The stickman fireman scene uses the SAME gfx_sm_asset_t format.
 */

#pragma once

#include "widget/gfx_sm_scene.h"

/* ------------------------------------------------------------------ */
/*  Metadata                                                           */
/* ------------------------------------------------------------------ */

static const gfx_sm_meta_t s_fe_meta = {
    .version   = GFX_SM_SCENE_SCHEMA_VERSION,
    .viewbox_x = -100,
    .viewbox_y = -80,
    .viewbox_w =  200,
    .viewbox_h =  200,
};

/* ------------------------------------------------------------------ */
/*  Layout / rendering hints                                           */
/* ------------------------------------------------------------------ */

static const gfx_sm_layout_t s_fe_layout = {
    .stroke_width    =  6,
    .mirror_x        =  0,
    .ground_y        =  80,
    .timer_period_ms =  33,
    .damping_div     =   4,
};

/* ------------------------------------------------------------------ */
/*  Joint names                                                        */
/* ------------------------------------------------------------------ */

static const char *const s_fe_joint_names[] = {
    "mouth_0",   /* 0 */
    "mouth_1",   /* 1 */
    "mouth_2",   /* 2 */
    "mouth_3",   /* 3 */
    "mouth_4",   /* 4 */
    "mouth_5",   /* 5 */
    "mouth_6",   /* 6 */
    "eye_l_0",   /* 7 */
    "eye_l_1",   /* 8 */
    "eye_l_2",   /* 9 */
    "eye_l_3",   /* 10 */
    "eye_l_4",   /* 11 */
    "eye_l_5",   /* 12 */
    "eye_l_6",   /* 13 */
    "eye_r_0",   /* 14 */
    "eye_r_1",   /* 15 */
    "eye_r_2",   /* 16 */
    "eye_r_3",   /* 17 */
    "eye_r_4",   /* 18 */
    "eye_r_5",   /* 19 */
    "eye_r_6",   /* 20 */
    "brow_l_0",  /* 21 */
    "brow_l_1",  /* 22 */
    "brow_l_2",  /* 23 */
    "brow_l_3",  /* 24 */
    "brow_r_0",  /* 25 */
    "brow_r_1",  /* 26 */
    "brow_r_2",  /* 27 */
    "brow_r_3",  /* 28 */
};

/* ------------------------------------------------------------------ */
/*  Poses — flat coord arrays [x0,y0, x1,y1, …] for 29 joints         */
/* ------------------------------------------------------------------ */

static const int16_t s_fe_p00[] = { -28, 25, -14, 24, 14, 24, 28, 25, 14, 26, -14, 26, -28, 25, -51, -8, -43, -24, -27, -24, -19, -8, -27, 8, -43, 8, -51, -8, 51, -8, 43, 8, 27, 8, 19, -8, 27, -24, 43, -24, 51, -8, -51, -32, -40, -38, -30, -38, -19, -32, 19, -32, 30, -38, 40, -38, 51, -32 };  /* neutral */
static const int16_t s_fe_p01[] = { -27, 25, -14, 22, 14, 22, 27, 25, 14, 28, -14, 28, -27, 25, -51, -8, -43, -24, -27, -24, -19, -8, -27, 8, -43, 8, -51, -8, 51, -8, 43, 8, 27, 8, 19, -8, 27, -24, 43, -24, 51, -8, -51, -32, -40, -38, -30, -38, -19, -32, 19, -32, 30, -38, 40, -38, 51, -32 };  /* look up */
static const int16_t s_fe_p02[] = { -28, 25, -14, 24, 14, 24, 28, 25, 14, 26, -14, 26, -28, 25, -51, -8, -43, -24, -27, -24, -19, -8, -27, 8, -43, 8, -51, -8, 51, -8, 43, 8, 27, 8, 19, -8, 27, -24, 43, -24, 51, -8, -51, -32, -40, -38, -30, -38, -19, -32, 19, -32, 30, -38, 40, -38, 51, -32 };  /* look down */
static const int16_t s_fe_p03[] = { -28, 25, -14, 25, 14, 25, 28, 25, 15, 27, -15, 27, -28, 25, -51, -8, -43, -24, -27, -24, -19, -8, -27, 7, -43, 7, -51, -8, 51, -8, 43, 7, 27, 7, 19, -8, 27, -24, 43, -24, 51, -8, -51, -32, -40, -38, -30, -38, -19, -32, 19, -32, 30, -38, 40, -38, 51, -32 };  /* look left */
static const int16_t s_fe_p04[] = { -28, 25, -14, 25, 14, 25, 28, 25, 15, 27, -15, 27, -28, 25, -51, -8, -43, -24, -27, -24, -19, -8, -27, 7, -43, 7, -51, -8, 51, -8, 43, 7, 27, 7, 19, -8, 27, -24, 43, -24, 51, -8, -51, -32, -40, -38, -30, -38, -19, -32, 19, -32, 30, -38, 40, -38, 51, -32 };  /* look right */
static const int16_t s_fe_p05[] = { -28, 28, -14, 20, 14, 20, 28, 28, 14, 23, -14, 23, -28, 28, -51, -8, -43, -22, -27, -24, -19, -8, -27, 7, -43, 7, -51, -8, 51, -8, 43, 7, 27, 7, 19, -8, 27, -24, 43, -22, 51, -8, -51, -32, -40, -38, -30, -37, -19, -32, 19, -32, 30, -37, 40, -38, 51, -32 };  /* side-eye */
static const int16_t s_fe_p06[] = { -30, 24, -14, 29, 14, 29, 30, 24, 17, 33, -17, 33, -30, 24, -51, -7, -43, -22, -27, -22, -19, -7, -27, 3, -43, 3, -51, -7, 51, -7, 43, 3, 27, 3, 19, -7, 27, -22, 43, -22, 51, -7, -51, -32, -40, -38, -30, -38, -19, -32, 19, -32, 30, -38, 40, -38, 51, -32 };  /* daydream */
static const int16_t s_fe_p07[] = { -31, 23, -13, 33, 13, 33, 31, 23, 20, 41, -20, 41, -31, 23, -51, -6, -43, -21, -27, -21, -19, -6, -27, -2, -43, -2, -51, -6, 51, -6, 43, -2, 27, -2, 19, -6, 27, -21, 43, -21, 51, -6, -51, -31, -40, -38, -30, -38, -19, -32, 19, -32, 30, -38, 40, -38, 51, -31 };  /* soft smile */
static const int16_t s_fe_p08[] = { -34, 20, -12, 43, 12, 43, 34, 20, 26, 55, -26, 55, -34, 20, -51, -4, -43, -18, -27, -18, -19, -4, -27, -12, -43, -12, -51, -4, 51, -4, 43, -12, 27, -12, 19, -4, 27, -18, 43, -18, 51, -4, -51, -30, -40, -37, -30, -37, -19, -33, 19, -33, 30, -37, 40, -37, 51, -30 };  /* smile */
static const int16_t s_fe_p09[] = { -34, 10, -12, 13, 12, 13, 34, 10, 34, 65, -34, 65, -34, 10, -51, -4, -43, -16, -27, -16, -19, -4, -27, -12, -43, -12, -51, -4, 51, -4, 43, -12, 27, -12, 19, -4, 27, -16, 43, -16, 51, -4, -51, -33, -40, -40, -30, -40, -19, -33, 19, -33, 30, -40, 40, -40, 51, -33 };  /* happy */
static const int16_t s_fe_p10[] = { -37, 7, -11, 23, 11, 23, 37, 7, 40, 79, -40, 79, -37, 7, -51, -2, -43, -13, -27, -13, -19, -2, -27, -22, -43, -22, -51, -2, 51, -2, 43, -22, 27, -22, 19, -2, 27, -13, 43, -13, 51, -2, -51, -32, -40, -40, -30, -40, -19, -34, 19, -34, 30, -40, 40, -40, 51, -32 };  /* grinning */
static const int16_t s_fe_p11[] = { -36, 6, -11, 21, 11, 21, 36, 6, 44, 95, -44, 95, -36, 6, -51, -1, -43, -12, -27, -12, -19, -1, -27, -27, -43, -27, -51, -1, 51, -1, 43, -27, 27, -27, 19, -1, 27, -12, 43, -12, 51, -1, -51, -33, -40, -41, -30, -41, -19, -35, 19, -35, 30, -41, 40, -41, 51, -33 };  /* big grin */
static const int16_t s_fe_p12[] = { -34, 18, -12, 37, 12, 37, 34, 18, 28, 57, -28, 57, -34, 18, -51, -4, -43, -18, -27, -18, -19, -4, -27, -12, -43, -12, -51, -4, 51, -4, 43, -12, 27, -12, 19, -4, 27, -18, 43, -18, 51, -4, -51, -31, -40, -38, -30, -38, -19, -33, 19, -33, 30, -38, 40, -38, 51, -31 };  /* loving */
static const int16_t s_fe_p13[] = { -31, 7, -11, 7, 11, 7, 31, 7, 42, 99, -42, 99, -31, 7, -50, -2, -43, -15, -27, -15, -20, -2, -27, -21, -43, -21, -50, -2, 50, -2, 43, -21, 27, -21, 20, -2, 27, -15, 43, -15, 50, -2, -50, -36, -40, -44, -30, -44, -20, -38, 20, -38, 30, -44, 40, -44, 50, -36 };  /* excited */
static const int16_t s_fe_p14[] = { -30, 9, -12, 3, 12, 3, 30, 9, 37, 84, -37, 84, -30, 9, -50, -3, -43, -17, -27, -17, -20, -3, -27, -14, -43, -14, -50, -3, 50, -3, 43, -14, 27, -14, 20, -3, 27, -17, 43, -17, 50, -3, -50, -36, -40, -43, -30, -43, -20, -36, 20, -36, 30, -43, 40, -43, 50, -36 };  /* laughing */
static const int16_t s_fe_p15[] = { -28, 22, -13, 25, 13, 25, 28, 22, 22, 54, -22, 54, -28, 22, -50, -6, -43, -22, -27, -22, -20, -6, -27, -2, -43, -2, -50, -6, 50, -6, 43, -2, 27, -2, 20, -6, 27, -22, 43, -22, 50, -6, -50, -33, -40, -40, -30, -40, -20, -35, 20, -35, 30, -40, 40, -40, 50, -33 };  /* amused */
static const int16_t s_fe_p16[] = { -30, 23, -13, 32, 13, 32, 30, 23, 19, 38, -19, 38, -30, 23, -51, -6, -43, -22, -27, -22, -19, -6, -27, 0, -43, 0, -51, -6, 51, -6, 43, 0, 27, 0, 19, -6, 27, -22, 43, -22, 51, -6, -51, -31, -40, -38, -30, -38, -19, -32, 19, -32, 30, -38, 40, -38, 51, -31 };  /* relaxed */
static const int16_t s_fe_p17[] = { -35, 15, -12, 33, 12, 33, 35, 15, 30, 62, -30, 62, -35, 15, -51, -4, -43, -17, -27, -17, -19, -4, -27, -14, -43, -14, -51, -4, 51, -4, 43, -14, 27, -14, 19, -4, 27, -17, 43, -17, 51, -4, -51, -31, -40, -38, -30, -38, -19, -33, 19, -33, 30, -38, 40, -38, 51, -31 };  /* blissful */
static const int16_t s_fe_p18[] = { -33, 21, -12, 29, 12, 29, 33, 21, 24, 45, -24, 45, -33, 21, -51, -6, -43, -18, -27, -19, -19, -4, -27, -7, -43, -7, -51, -6, 51, -6, 43, -7, 27, -7, 19, -4, 27, -19, 43, -18, 51, -6, -51, -32, -40, -38, -30, -36, -19, -31, 19, -31, 30, -36, 40, -38, 51, -32 };  /* proud */
static const int16_t s_fe_p19[] = { -32, 25, -12, 33, 12, 33, 32, 25, 21, 39, -21, 39, -32, 25, -51, -6, -43, -18, -27, -20, -19, -4, -27, -5, -43, -5, -51, -6, 51, -6, 43, -5, 27, -5, 19, -4, 27, -20, 43, -18, 51, -6, -51, -32, -40, -37, -30, -35, -19, -31, 19, -31, 30, -35, 40, -37, 51, -32 };  /* smug */
static const int16_t s_fe_p20[] = { -30, 37, -15, 0, 15, 0, 30, 37, 15, 15, -15, 15, -30, 37, -51, 0, -43, -20, -27, -24, -19, -12, -27, 6, -43, 8, -51, 0, 51, 0, 43, 8, 27, 6, 19, -12, 27, -24, 43, -20, 51, 0, -51, -28, -40, -37, -30, -41, -19, -40, 19, -40, 30, -41, 40, -37, 51, -28 };  /* sad */
static const int16_t s_fe_p21[] = { -30, 38, -15, -2, 15, -2, 30, 38, 15, 14, -15, 14, -30, 38, -51, 1, -43, -20, -27, -24, -19, -12, -27, 6, -43, 8, -51, 1, 51, 1, 43, 8, 27, 6, 19, -12, 27, -24, 43, -20, 51, 1, -51, -28, -40, -37, -30, -41, -19, -41, 19, -41, 30, -41, 40, -37, 51, -28 };  /* sorrowful */
static const int16_t s_fe_p22[] = { -30, 37, -15, 0, 15, 0, 30, 37, 15, 15, -15, 15, -30, 37, -51, 0, -43, -20, -27, -24, -19, -12, -27, 6, -43, 8, -51, 0, 51, 0, 43, 8, 27, 6, 19, -12, 27, -24, 43, -20, 51, 0, -51, -28, -40, -37, -30, -41, -19, -40, 19, -40, 30, -41, 40, -37, 51, -28 };  /* crying */
static const int16_t s_fe_p23[] = { -30, 39, -15, -5, 15, -5, 30, 39, 15, 13, -15, 13, -30, 39, -51, 2, -43, -19, -27, -24, -19, -13, -27, 6, -43, 8, -51, 2, 51, 2, 43, 8, 27, 6, 19, -13, 27, -24, 43, -19, 51, 2, -51, -27, -40, -37, -30, -42, -19, -42, 19, -42, 30, -42, 40, -37, 51, -27 };  /* sobbing */
static const int16_t s_fe_p24[] = { -30, 35, -15, 5, 15, 5, 30, 35, 15, 17, -15, 17, -30, 35, -51, -2, -43, -21, -27, -24, -19, -11, -27, 6, -43, 8, -51, -2, 51, -2, 43, 8, 27, 6, 19, -11, 27, -24, 43, -21, 51, -2, -51, -29, -40, -37, -30, -40, -19, -38, 19, -38, 30, -40, 40, -37, 51, -29 };  /* dejected */
static const int16_t s_fe_p25[] = { -31, 29, -14, 18, 14, 18, 31, 29, 18, 29, -18, 29, -31, 29, -51, -3, -43, -20, -27, -22, -19, -9, -27, 1, -43, 2, -51, -3, 51, -3, 43, 2, 27, 1, 19, -9, 27, -22, 43, -20, 51, -3, -51, -29, -40, -37, -30, -39, -19, -36, 19, -36, 30, -39, 40, -37, 51, -29 };  /* sympathetic */
static const int16_t s_fe_p26[] = { -30, 29, -14, 18, 14, 18, 30, 29, 17, 27, -17, 27, -30, 29, -51, -4, -43, -21, -27, -23, -19, -9, -27, 3, -43, 4, -51, -4, 51, -4, 43, 4, 27, 3, 19, -9, 27, -23, 43, -21, 51, -4, -51, -30, -40, -37, -30, -39, -19, -35, 19, -35, 30, -39, 40, -37, 51, -30 };  /* longing */
static const int16_t s_fe_p27[] = { -26, 36, -15, -8, 15, -8, 26, 36, 15, 26, -15, 26, -26, 36, -50, -1, -43, -22, -27, -26, -20, -12, -27, 8, -43, 10, -50, -1, 50, -1, 43, 10, 27, 8, 20, -12, 27, -26, 43, -22, 50, -1, -50, -31, -40, -40, -30, -43, -20, -42, 20, -42, 30, -43, 40, -40, 50, -31 };  /* tearful plea */
static const int16_t s_fe_p28[] = { -15, 25, -15, -10, 15, -10, 15, 25, 15, 60, -15, 60, -15, 25, -49, -8, -42, -30, -28, -30, -21, -8, -28, 14, -42, 14, -49, -8, 49, -8, 42, 14, 28, 14, 21, -8, 28, -30, 42, -30, 49, -8, -49, -40, -40, -47, -30, -47, -21, -40, 21, -40, 30, -47, 40, -47, 49, -40 };  /* wow */
static const int16_t s_fe_p29[] = { -12, 25, -15, -17, 15, -17, 12, 25, 15, 67, -15, 67, -12, 25, -49, -8, -42, -31, -28, -31, -21, -8, -28, 15, -42, 15, -49, -8, 49, -8, 42, 15, 28, 15, 21, -8, 28, -31, 42, -31, 49, -8, -49, -42, -40, -49, -30, -49, -21, -42, 21, -42, 30, -49, 40, -49, 49, -42 };  /* shocked */
static const int16_t s_fe_p30[] = { -16, 32, -16, -24, 16, -24, 16, 32, 16, 53, -16, 53, -16, 32, -49, -3, -42, -28, -28, -30, -21, -10, -28, 13, -42, 14, -49, -3, 49, -3, 42, 14, 28, 13, 21, -10, 28, -30, 42, -28, 49, -3, -49, -38, -40, -46, -30, -49, -21, -45, 21, -45, 30, -49, 40, -46, 49, -38 };  /* horrified */
static const int16_t s_fe_p31[] = { -16, 29, -15, -17, 15, -17, 16, 29, 15, 57, -15, 57, -16, 29, -49, -6, -42, -29, -28, -30, -21, -9, -28, 13, -42, 14, -49, -6, 49, -6, 42, 14, 28, 13, 21, -9, 28, -30, 42, -29, 49, -6, -49, -39, -40, -47, -30, -48, -21, -42, 21, -42, 30, -48, 40, -47, 49, -39 };  /* spooked */
static const int16_t s_fe_p32[] = { -17, 25, -15, -5, 15, -5, 17, 25, 16, 59, -16, 59, -17, 25, -49, -8, -42, -29, -28, -29, -21, -8, -28, 11, -42, 11, -49, -8, 49, -8, 42, 11, 28, 11, 21, -8, 28, -29, 42, -29, 49, -8, -49, -39, -40, -46, -30, -46, -21, -39, 21, -39, 30, -46, 40, -46, 49, -39 };  /* in awe */
static const int16_t s_fe_p33[] = { -18, 29, -15, -10, 15, -10, 18, 29, 15, 48, -15, 48, -18, 29, -49, -7, -42, -26, -28, -29, -21, -8, -28, 12, -42, 12, -49, -7, 49, -7, 42, 12, 28, 12, 21, -8, 28, -29, 42, -26, 49, -7, -49, -39, -40, -45, -30, -44, -21, -39, 21, -39, 30, -44, 40, -45, 49, -39 };  /* alarmed */
static const int16_t s_fe_p34[] = { -30, 35, -12, 15, 12, 15, 30, 35, 12, 10, -12, 10, -30, 35, -51, -10, -43, -16, -27, -24, -19, -2, -27, 4, -43, 4, -51, -10, 51, -10, 43, 4, 27, 4, 19, -2, 27, -24, 43, -16, 51, -10, -51, -37, -40, -37, -30, -29, -19, -26, 19, -26, 30, -29, 40, -37, 51, -37 };  /* angry */
static const int16_t s_fe_p35[] = { -30, 37, -12, 13, 12, 13, 30, 37, 12, 7, -12, 7, -30, 37, -51, -10, -43, -14, -27, -24, -19, -1, -27, 3, -43, 3, -51, -10, 51, -10, 43, 3, 27, 3, 19, -1, 27, -24, 43, -14, 51, -10, -51, -38, -40, -37, -30, -27, -19, -25, 19, -25, 30, -27, 40, -37, 51, -38 };  /* furious */
static const int16_t s_fe_p36[] = { -30, 33, -13, 14, 13, 14, 30, 33, 13, 14, -13, 14, -30, 33, -51, -8, -43, -18, -27, -24, -19, -5, -27, 5, -43, 6, -51, -8, 51, -8, 43, 6, 27, 5, 19, -5, 27, -24, 43, -18, 51, -8, -51, -34, -40, -37, -30, -33, -19, -30, 19, -30, 30, -33, 40, -37, 51, -34 };  /* displeased */
static const int16_t s_fe_p37[] = { -31, 29, -12, 24, 12, 24, 31, 29, 16, 25, -16, 25, -31, 29, -51, -8, -43, -17, -27, -22, -19, -3, -27, 0, -43, 0, -51, -8, 51, -8, 43, 0, 27, 0, 19, -3, 27, -22, 43, -17, 51, -8, -51, -34, -40, -37, -30, -32, -19, -29, 19, -29, 30, -32, 40, -37, 51, -34 };  /* contempt */
static const int16_t s_fe_p38[] = { -29, 31, -13, 17, 13, 17, 29, 31, 13, 18, -13, 18, -29, 31, -51, -8, -43, -20, -27, -24, -19, -6, -27, 6, -43, 6, -51, -8, 51, -8, 43, 6, 27, 6, 19, -6, 27, -24, 43, -20, 51, -8, -51, -33, -40, -37, -30, -35, -19, -31, 19, -31, 30, -35, 40, -37, 51, -33 };  /* suspicious */
static const int16_t s_fe_p39[] = { -29, 30, -14, 17, 14, 17, 29, 30, 14, 19, -14, 19, -29, 30, -51, -7, -43, -21, -27, -24, -19, -7, -27, 6, -43, 7, -51, -7, 51, -7, 43, 7, 27, 6, 19, -7, 27, -24, 43, -21, 51, -7, -51, -33, -40, -38, -30, -36, -19, -32, 19, -32, 30, -36, 40, -38, 51, -33 };  /* thinking */
static const int16_t s_fe_p40[] = { -28, 26, -14, 20, 14, 20, 28, 26, 15, 31, -15, 31, -28, 26, -51, -7, -43, -24, -27, -24, -19, -8, -27, 6, -43, 7, -51, -7, 51, -7, 43, 7, 27, 6, 19, -8, 27, -24, 43, -24, 51, -7, -51, -32, -40, -39, -30, -39, -19, -34, 19, -34, 30, -39, 40, -39, 51, -32 };  /* pondering */
static const int16_t s_fe_p41[] = { -26, 31, -14, 8, 14, 8, 26, 31, 14, 26, -14, 26, -26, 31, -51, -6, -43, -22, -27, -25, -19, -8, -27, 8, -43, 8, -51, -6, 51, -6, 43, 8, 27, 8, 19, -8, 27, -25, 43, -22, 51, -6, -51, -33, -40, -39, -30, -39, -19, -35, 19, -35, 30, -39, 40, -39, 51, -33 };  /* confused */
static const int16_t s_fe_p42[] = { -23, 24, -14, 11, 14, 11, 23, 24, 17, 49, -17, 49, -23, 24, -50, -7, -43, -26, -27, -26, -20, -7, -27, 7, -43, 7, -50, -7, 50, -7, 43, 7, 27, 7, 20, -7, 27, -26, 43, -26, 50, -7, -50, -36, -40, -42, -30, -42, -20, -36, 20, -36, 30, -42, 40, -42, 50, -36 };  /* curious */
static const int16_t s_fe_p43[] = { -32, 26, -13, 26, 13, 26, 32, 26, 20, 37, -20, 37, -32, 26, -51, -4, -43, -20, -27, -21, -19, -7, -27, -3, -43, -2, -51, -4, 51, -4, 43, -2, 27, -3, 19, -7, 27, -21, 43, -20, 51, -4, -51, -30, -40, -37, -30, -38, -19, -35, 19, -35, 30, -38, 40, -37, 51, -30 };  /* sheepish */
static const int16_t s_fe_p44[] = { -32, 26, -12, 31, 12, 31, 32, 26, 20, 36, -20, 36, -32, 26, -51, -6, -43, -18, -27, -21, -19, -4, -27, -4, -43, -4, -51, -6, 51, -6, 43, -4, 27, -4, 19, -4, 27, -21, 43, -18, 51, -6, -51, -33, -40, -37, -30, -34, -19, -30, 19, -30, 30, -34, 40, -37, 51, -33 };  /* mischievous */
static const int16_t s_fe_p45[] = { -30, 31, -13, 21, 13, 21, 30, 31, 14, 19, -14, 19, -30, 31, -51, -9, -43, -19, -27, -23, -19, -4, -27, 4, -43, 4, -51, -9, 51, -9, 43, 4, 27, 4, 19, -4, 27, -23, 43, -19, 51, -9, -51, -35, -40, -37, -30, -33, -19, -29, 19, -29, 30, -33, 40, -37, 51, -35 };  /* determined */
static const int16_t s_fe_p46[] = { -28, 27, -14, 16, 14, 16, 28, 27, 18, 38, -18, 38, -28, 27, -51, -4, -43, -22, -27, -23, -19, -8, -27, 3, -43, 3, -51, -4, 51, -4, 43, 3, 27, 3, 19, -8, 27, -23, 43, -22, 51, -4, -51, -32, -40, -39, -30, -40, -19, -36, 19, -36, 30, -40, 40, -39, 51, -32 };  /* nervous */
static const int16_t s_fe_p47[] = { -28, 25, -14, 20, 14, 20, 28, 25, 19, 42, -19, 42, -28, 25, -51, -5, -43, -22, -27, -23, -19, -7, -27, 1, -43, 1, -51, -5, 51, -5, 43, 1, 27, 1, 19, -7, 27, -23, 43, -22, 51, -5, -51, -32, -40, -39, -30, -40, -19, -36, 19, -36, 30, -40, 40, -39, 51, -32 };  /* embarrassed */
static const int16_t s_fe_p48[] = { -31, 20, -13, 26, 13, 26, 31, 20, 26, 58, -26, 58, -31, 20, -51, -4, -43, -19, -27, -20, -19, -5, -27, -8, -43, -8, -51, -4, 51, -4, 43, -8, 27, -8, 19, -5, 27, -20, 43, -19, 51, -4, -51, -32, -40, -39, -30, -40, -19, -35, 19, -35, 30, -40, 40, -39, 51, -32 };  /* flattered */

#define FE_POSE(arr) { .coords = (arr) }

static const gfx_sm_pose_t s_fe_poses[] = {
    FE_POSE(s_fe_p00),  FE_POSE(s_fe_p01),  FE_POSE(s_fe_p02),
    FE_POSE(s_fe_p03),  FE_POSE(s_fe_p04),  FE_POSE(s_fe_p05),
    FE_POSE(s_fe_p06),  FE_POSE(s_fe_p07),  FE_POSE(s_fe_p08),
    FE_POSE(s_fe_p09),  FE_POSE(s_fe_p10),  FE_POSE(s_fe_p11),
    FE_POSE(s_fe_p12),  FE_POSE(s_fe_p13),  FE_POSE(s_fe_p14),
    FE_POSE(s_fe_p15),  FE_POSE(s_fe_p16),  FE_POSE(s_fe_p17),
    FE_POSE(s_fe_p18),  FE_POSE(s_fe_p19),  FE_POSE(s_fe_p20),
    FE_POSE(s_fe_p21),  FE_POSE(s_fe_p22),  FE_POSE(s_fe_p23),
    FE_POSE(s_fe_p24),  FE_POSE(s_fe_p25),  FE_POSE(s_fe_p26),
    FE_POSE(s_fe_p27),  FE_POSE(s_fe_p28),  FE_POSE(s_fe_p29),
    FE_POSE(s_fe_p30),  FE_POSE(s_fe_p31),  FE_POSE(s_fe_p32),
    FE_POSE(s_fe_p33),  FE_POSE(s_fe_p34),  FE_POSE(s_fe_p35),
    FE_POSE(s_fe_p36),  FE_POSE(s_fe_p37),  FE_POSE(s_fe_p38),
    FE_POSE(s_fe_p39),  FE_POSE(s_fe_p40),  FE_POSE(s_fe_p41),
    FE_POSE(s_fe_p42),  FE_POSE(s_fe_p43),  FE_POSE(s_fe_p44),
    FE_POSE(s_fe_p45),  FE_POSE(s_fe_p46),  FE_POSE(s_fe_p47),
    FE_POSE(s_fe_p48),
};

/* ------------------------------------------------------------------ */
/*  Segment wiring                                                     */
/* ------------------------------------------------------------------ */

static const gfx_sm_segment_t s_fe_segments[] = {
    /* mouth  */ { .kind = GFX_SM_SEG_BEZIER_LOOP,  .joint_a =  0, .joint_count = 7, .stroke_width = 6 },
    /* eye_l  */ { .kind = GFX_SM_SEG_BEZIER_FILL,  .joint_a =  7, .joint_count = 7 },
    /* eye_r  */ { .kind = GFX_SM_SEG_BEZIER_FILL,  .joint_a = 14, .joint_count = 7 },
    /* brow_l */ { .kind = GFX_SM_SEG_BEZIER_STRIP, .joint_a = 21, .joint_count = 4, .stroke_width =  6 },
    /* brow_r */ { .kind = GFX_SM_SEG_BEZIER_STRIP, .joint_a = 25, .joint_count = 4, .stroke_width =  6 },
};

/* ------------------------------------------------------------------ */
/*  Clip step arrays                                                   */
/*  All face clips are single-step (one expression = one pose).        */
/*  Consolidate into one flat array; each clip points to &steps[N].    */
/* ------------------------------------------------------------------ */

#define STEP(p, h, f) { .pose_index = (p), .hold_ticks = (h), .interp = GFX_SM_INTERP_DAMPED, .facing = (f) }

static const gfx_sm_clip_step_t s_fe_steps[] = {
    STEP( 0, 60,  1),  /*  0: neutral */
    STEP( 1, 30,  1),  /*  1: look up */
    STEP( 2, 30,  1),  /*  2: look down */
    STEP( 3, 30,  1),  /*  3: look left */
    STEP( 4, 30,  1),  /*  4: look right */
    STEP( 5, 40,  1),  /*  5: side-eye */
    STEP( 6, 50,  1),  /*  6: daydream */
    STEP( 7, 30,  1),  /*  7: soft smile */
    STEP( 8, 30,  1),  /*  8: smile */
    STEP( 9, 30,  1),  /*  9: happy */
    STEP(10, 30,  1),  /* 10: grinning */
    STEP(11, 30,  1),  /* 11: big grin */
    STEP(12, 40,  1),  /* 12: loving */
    STEP(13, 25,  1),  /* 13: excited */
    STEP(14, 25,  1),  /* 14: laughing */
    STEP(15, 35,  1),  /* 15: amused */
    STEP(16, 45,  1),  /* 16: relaxed */
    STEP(17, 40,  1),  /* 17: blissful */
    STEP(18, 35,  1),  /* 18: proud */
    STEP(19, 40,  1),  /* 19: smug */
    STEP(20, 30,  1),  /* 20: sad */
    STEP(21, 30,  1),  /* 21: sorrowful */
    STEP(22, 30,  1),  /* 22: crying */
    STEP(23, 30,  1),  /* 23: sobbing */
    STEP(24, 35,  1),  /* 24: dejected */
    STEP(25, 35,  1),  /* 25: sympathetic */
    STEP(26, 35,  1),  /* 26: longing */
    STEP(27, 30,  1),  /* 27: tearful plea */
    STEP(28, 30,  1),  /* 28: wow */
    STEP(29, 25,  1),  /* 29: shocked */
    STEP(30, 25,  1),  /* 30: horrified */
    STEP(31, 25,  1),  /* 31: spooked */
    STEP(32, 35,  1),  /* 32: in awe */
    STEP(33, 30,  1),  /* 33: alarmed */
    STEP(34, 30,  1),  /* 34: angry */
    STEP(35, 25,  1),  /* 35: furious */
    STEP(36, 30,  1),  /* 36: displeased */
    STEP(37, 35,  1),  /* 37: contempt */
    STEP(38, 35,  1),  /* 38: suspicious */
    STEP(39, 35,  1),  /* 39: thinking */
    STEP(40, 35,  1),  /* 40: pondering */
    STEP(41, 35,  1),  /* 41: confused */
    STEP(42, 30,  1),  /* 42: curious */
    STEP(43, 40,  1),  /* 43: sheepish */
    STEP(44, 35,  1),  /* 44: mischievous */
    STEP(45, 35,  1),  /* 45: determined */
    STEP(46, 30,  1),  /* 46: nervous */
    STEP(47, 35,  1),  /* 47: embarrassed */
    STEP(48, 35,  1),  /* 48: flattered */
};

/* ------------------------------------------------------------------ */
/*  Clips                                                              */
/* ------------------------------------------------------------------ */

#define CLIP(n, cn, idx, lp) \
    { .name = (n), .name_cn = (cn), .steps = &s_fe_steps[(idx)], \
      .step_count = 1, .loop = (lp) }

static const gfx_sm_clip_t s_fe_clips[] = {
    CLIP("neutral",      "平静",       0, true),
    CLIP("look up",      "抬头看",     1, true),
    CLIP("look down",    "低头看",     2, true),
    CLIP("look left",    "向左看",     3, true),
    CLIP("look right",   "向右看",     4, true),
    CLIP("side-eye",     "斜视",       5, true),
    CLIP("daydream",     "发呆",       6, true),
    CLIP("soft smile",   "微笑",       7, true),
    CLIP("smile",        "灿烂微笑",   8, true),
    CLIP("happy",        "开心",       9, true),
    CLIP("grinning",     "咧嘴笑",    10, true),
    CLIP("big grin",     "大嘴笑",    11, true),
    CLIP("loving",       "爱慕",      12, true),
    CLIP("excited",      "激动",      13, true),
    CLIP("laughing",     "大笑",      14, true),
    CLIP("amused",       "忍俊不禁",  15, true),
    CLIP("relaxed",      "放松",      16, true),
    CLIP("blissful",     "陶醉",      17, true),
    CLIP("proud",        "骄傲",      18, true),
    CLIP("smug",         "自鸣得意",  19, true),
    CLIP("sad",          "难过",      20, true),
    CLIP("sorrowful",    "哀愁",      21, true),
    CLIP("crying",       "哭泣",      22, true),
    CLIP("sobbing",      "抽泣",      23, true),
    CLIP("dejected",     "沮丧",      24, true),
    CLIP("sympathetic",  "同情",      25, true),
    CLIP("longing",      "思念",      26, true),
    CLIP("tearful plea", "泪眼求饶",  27, true),
    CLIP("wow",          "哇",        28, true),
    CLIP("shocked",      "震惊",      29, true),
    CLIP("horrified",    "恐惧",      30, true),
    CLIP("spooked",      "受惊",      31, true),
    CLIP("in awe",       "敬畏",      32, true),
    CLIP("alarmed",      "警觉",      33, true),
    CLIP("angry",        "生气",      34, true),
    CLIP("furious",      "暴怒",      35, true),
    CLIP("displeased",   "不悦",      36, true),
    CLIP("contempt",     "鄙视",      37, true),
    CLIP("suspicious",   "起疑",      38, true),
    CLIP("thinking",     "思考",      39, true),
    CLIP("pondering",    "沉思",      40, true),
    CLIP("confused",     "困惑",      41, true),
    CLIP("curious",      "好奇",      42, true),
    CLIP("sheepish",     "装乖",      43, true),
    CLIP("mischievous",  "坏笑",      44, true),
    CLIP("determined",   "坚定",      45, true),
    CLIP("nervous",      "紧张",      46, true),
    CLIP("embarrassed",  "尴尬",      47, true),
    CLIP("flattered",    "受宠若惊",  48, true),
};

/* ------------------------------------------------------------------ */
/*  Default playback sequence — one entry per clip                     */
/* ------------------------------------------------------------------ */

static const uint16_t s_fe_sequence[] = {
     0,  1,  2,  3,  4,  5,  6,  7,  8,  9,
    10, 11, 12, 13, 14, 15, 16, 17, 18, 19,
    20, 21, 22, 23, 24, 25, 26, 27, 28, 29,
    30, 31, 32, 33, 34, 35, 36, 37, 38, 39,
    40, 41, 42, 43, 44, 45, 46, 47, 48,
};

/* ------------------------------------------------------------------ */
/*  Top-level asset                                                    */
/* ------------------------------------------------------------------ */

static const gfx_sm_asset_t s_fe_scene_asset = {
    .meta           = &s_fe_meta,
    .joint_names    = s_fe_joint_names,
    .joint_count    = (uint8_t)(sizeof(s_fe_joint_names) / sizeof(s_fe_joint_names[0])),
    .segments       = s_fe_segments,
    .segment_count  = (uint8_t)(sizeof(s_fe_segments) / sizeof(s_fe_segments[0])),
    .poses          = s_fe_poses,
    .pose_count     = (uint16_t)(sizeof(s_fe_poses) / sizeof(s_fe_poses[0])),
    .clips          = s_fe_clips,
    .clip_count     = (uint16_t)(sizeof(s_fe_clips) / sizeof(s_fe_clips[0])),
    .sequence       = s_fe_sequence,
    .sequence_count = (uint16_t)(sizeof(s_fe_sequence) / sizeof(s_fe_sequence[0])),
    .layout         = &s_fe_layout,
};
