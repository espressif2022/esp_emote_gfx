/*
 * SPDX-FileCopyrightText: 2024-2025 Espressif Systems (Shanghai) CO LTD
 *
 * SPDX-License-Identifier: Apache-2.0
 */

#pragma once

#include <stdint.h>

// Refined base geometries from face_expressions_vivid.html
static const face_mouth_kf_t s_ref_mouth[] = {
    /* [0] neutral */ { { -28,  0, -14, -1,  14, -1,  28,  0,  14,  1, -14,  1, -28,  0 } },
    /* [1] smile   */ { { -34, -5, -12, 18,  12, 18,  34, -5,  26, 30, -26, 30, -34, -5 } },
    /* [2] happy   */ { { -34,-15, -12,-12,  12,-12,  34,-15,  34, 40, -34, 40, -34,-15 } },
    /* [3] sad     */ { { -30, 12, -15,-25,  15,-25,  30, 12,  15,-10, -15,-10, -30, 12 } },
    /* [4] surprise */{ { -15,  0, -15,-35,  15,-35,  15,  0,  15, 35, -15, 35, -15,  0 } },
    /* [5] angry   */ { { -30, 10, -12,-10,  12,-10,  30, 10,  12,-15, -12,-15, -30, 10 } },
};

static const face_eye_kf_t s_ref_eye[] = {
    /* [0] neutral */ { { -16,  0,  -8,-16,   8,-16,  16,  0,   8, 16,  -8, 16, -16,  0 } },
    /* [1] smile   */ { { -16,  4,  -8,-10,   8,-10,  16,  4,   8, -4,  -8, -4, -16,  4 } },
    /* [2] happy   */ { { -16,  4,  -8, -8,   8, -8,  16,  4,   8, -4,  -8, -4, -16,  4 } },
    /* [3] sad     */ { { -16,  8,  -8,-12,   8,-16,  16, -4,   8, 14,  -8, 16, -16,  8 } },
    /* [4] surprise */{ { -14,  0,  -7,-22,   7,-22,  14,  0,   7, 22,  -7, 22, -14,  0 } },
    /* [5] angry   */ { { -16, -2,  -8, -8,   8,-16,  16,  6,   8, 12,  -8, 12, -16, -2 } },
};

static const face_brow_kf_t s_ref_brow[] = {
    /* [0] neutral */ { { -16,  0,  -5, -6,   5, -6,  16,  0 } },
    /* [1] smile   */ { { -16,  2,  -5, -5,   5, -5,  16, -1 } },
    /* [2] happy   */ { { -16, -1,  -5, -8,   5, -8,  16, -1 } },
    /* [3] sad     */ { { -16,  4,  -5, -5,   5, -9,  16, -8 } },
    /* [4] surprise */{ { -14, -8,  -5,-15,   5,-15,  14, -8 } },
    /* [5] angry   */ { { -16, -5,  -5, -5,   5,  3,  16,  6 } },
};

// Expanded bilingual expression sequence (54 entries)
static const face_emotion_t s_face_sequence[] = {
    /* Neutral & Gaze */
    { "neutral",      "平静",      0,   0,   0,   0,   0,   0,   0,  60U },
    { "look up",      "抬头看",    0,   0,   0,   5,   0,   0, -22,  30U },
    { "look down",    "低头看",    0,   0,   0,   0,   0,   0,  22,  30U },
    { "look left",    "向左看",    5,   0,   0,   0,   0, -22,   0,  30U },
    { "look right",   "向右看",    5,   0,   0,   0,   0,  22,   0,  30U },
    { "side-eye",     "斜视",      0,   0,  10,   0,  15, -35,   5,  40U },
    { "daydream",     "发呆",     25,   0,   0,   0,   0,  20, -18,  50U },

    /* Happy & Positive */
    { "soft smile",   "微笑",     50,   0,   0,   0,   0,   0,   0,  30U },
    { "smile",        "灿烂微笑", 100,   0,   0,   0,   0,   0,   0,  30U },
    { "happy",        "开心",      0, 100,   0,   0,   0,   0,   0,  30U },
    { "grinning",     "咧嘴笑",   50, 100,   0,   0,   0,   0,   0,  30U },
    { "big grin",     "大嘴笑",   80, 100,   0,  20,   0,   0,  -5,  30U },
    { "loving",       "爱慕",     80,  20,   0,   0,   0,   0, -20,  40U },
    { "excited",      "激动",     60, 100,   0,  50,   0,   0,  -8,  25U },
    { "laughing",     "大笑",     20, 100,   0,  40,   0,   0,   0,  25U },
    { "amused",       "忍俊不禁",  60,   0,   0,  30,   0,  10,   0,  35U },
    { "relaxed",      "放松",     40,   0,   0,   0,   0,   0,   8,  45U },
    { "blissful",     "陶醉",     70,  40,   0,   0,   0,   0, -12,  40U },
    { "proud",        "骄傲",     50,  20,   0,   0,  20,   0,  -5,  35U },
    { "smug",         "自鸣得意",  60,   0,   0,   0,  30,  25,   0,  40U },

    /* Sad & Distressed */
    { "sad",          "难过",      0,   0, 100,   0,   0,   0,  20,  30U },
    { "sorrowful",    "哀愁",      0,   0, 110,   0,   0,   0,  15,  30U },
    { "crying",       "哭泣",      0,   0, 100,   0,   0,   0,   0,  30U },
    { "sobbing",      "抽泣",      0,   0, 120,   0,   0,   0,   0,  30U },
    { "dejected",     "沮丧",      0,   0,  80,   0,   0, -15,  20,  35U },
    { "sympathetic",  "同情",     30,   0,  50,   0,   0,   0,  10,  35U },
    { "longing",      "思念",     20,   0,  40,   0,   0,  18, -10,  35U },
    { "tearful plea", "泪眼求饶",   0,   0,  90,  30,   0,   0,  12,  30U },

    /* Surprise & Fear */
    { "wow",          "哇",        0,   0,   0, 100,   0,   0, -25,  30U },
    { "shocked",      "震惊",      0,   0,   0, 120,   0,   0,   0,  25U },
    { "horrified",    "恐惧",      0,   0,  60, 100,   0,   0,   0,  25U },
    { "spooked",      "受惊",      0,   0,  30, 100,   0, -20, -10,  25U },
    { "in awe",       "敬畏",     10,   0,   0,  90,   0,   0, -18,  35U },
    { "alarmed",      "警觉",      0,   0,  20,  80,  20,  15,   5,  30U },

    /* Anger & Contempt */
    { "angry",        "生气",      0,   0,   0,   0, 100,   0,   0,  30U },
    { "furious",      "暴怒",      0,   0,   0,   0, 120,   0,   5,  25U },
    { "displeased",   "不悦",      0,   0,  20,   0,  60,   0,   0,  30U },
    { "contempt",     "鄙视",     30,   0,   0,   0,  60,  30,   0,  35U },
    { "suspicious",   "起疑",      0,   0,  15,   0,  40, -25,   8,  35U },

    /* Cognitive & Social */
    { "thinking",     "思考",      0,   0,  20,   0,  30,  20, -15,  35U },
    { "pondering",    "沉思",     10,   0,  10,  10,   0, -25, -20,  35U },
    { "confused",     "困惑",      0,   0,  30,  20,  20, -20,  10,  35U },
    { "curious",      "好奇",     20,   0,   0,  50,   0,  15, -15,  30U },
    { "sheepish",     "装乖",     50,   0,  30,   0,   0,  15,  15,  40U },
    { "mischievous",  "坏笑",     55,   0,   0,   0,  35,  20,   0,  35U },
    { "determined",   "坚定",     10,   0,   0,   0,  60,   0,  -8,  35U },
    { "nervous",      "紧张",     30,   0,  30,  20,   0,  -5,  12,  30U },
    { "embarrassed",  "尴尬",     40,   0,  20,  20,   0, -20,  18,  35U },
    { "flattered",    "受宠若惊",  70,  15,  10,  20,   0, -10, -10,  35U },
};
