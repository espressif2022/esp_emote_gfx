/*
 * SPDX-FileCopyrightText: 2026 Espressif Systems (Shanghai) CO LTD
 *
 * SPDX-License-Identifier: Apache-2.0
 */

#pragma once

#include "widget/gfx_dragon_emote.h"

// --- Base Geometry Points (Padded to even counts for mesh grid compatibility) ---

static const gfx_mesh_img_point_t s_dragon_head_pts[] = {
    { 66, 190 }, { 72, 190 }, { 90, 192 }, { 108, 196 }, { 124, 202 }, { 140, 210 }, { 154, 219 }, { 155, 219 },
    { 156, 220 }, { 158, 220 }, { 159, 220 }, { 160, 219 }, { 183, 200 }, { 213, 167 }, { 237, 129 }, { 255, 87 },
    { 265, 43 }, { 267, -17 }, { 248, -98 }, { 207, -167 }, { 148, -220 }, { 74, -254 }, { -9, -264 }, { -87, -250 },
    { -155, -215 }, { -210, -164 }, { -248, -98 }, { -267, -23 }, { -265, 50 }, { -245, 114 }, { -211, 169 }, { -166, 215 },
    { -110, 249 }, { -67, 264 }, { -66, 264 }, { -64, 264 }, { -63, 263 }, { -62, 262 }, { -61, 261 }, { -45, 239 },
    { -24, 220 }, { 0, 205 }, { 26, 195 }, { 56, 191 }, { 66, 190 }, { 66, 190 }
};

static const gfx_mesh_img_point_t s_dragon_body_pts[] = {
    { 41, 116 }, { 33, 99 }, { 9, 56 }, { -18, 21 }, { -48, -8 }, { -81, -30 }, { -115, -47 }, { -117, -48 },
    { -118, -49 }, { -118, -51 }, { -118, -53 }, { -117, -55 }, { -60, -108 }, { -48, -115 }, { -34, -119 }, { -20, -118 },
    { -6, -113 }, { 5, -105 }, { 110, -2 }, { 116, 12 }, { 118, 26 }, { 116, 41 }, { 110, 55 }, { 49, 117 },
    { 47, 118 }, { 46, 119 }, { 44, 118 }, { 42, 118 }, { 41, 116 }, { 41, 116 }
};

static const gfx_mesh_img_point_t s_dragon_tail_pts[] = {
    { -119, -16 }, { -109, -8 }, { -80, 16 }, { -53, 40 }, { -28, 65 }, { -6, 90 }, { 13, 115 }, { 15, 118 },
    { 18, 120 }, { 21, 121 }, { 24, 121 }, { 27, 121 }, { 101, 104 }, { 115, 95 }, { 122, 83 }, { 124, 69 },
    { 121, 54 }, { 113, 39 }, { 89, 8 }, { 62, -22 }, { 33, -51 }, { 3, -78 }, { -28, -104 }, { -48, -118 },
    { -62, -121 }, { -75, -120 }, { -87, -114 }, { -97, -103 }, { -123, -31 }, { -124, -28 }, { -124, -25 }, { -123, -22 },
    { -122, -19 }, { -120, -16 }, { -119, -16 }, { -119, -16 }
};

static const gfx_mesh_img_point_t s_dragon_clawL_pts[] = {
    { 62, -89 }, { 62, -91 }, { 62, -97 }, { 62, -104 }, { 63, -110 }, { 63, -116 }, { 64, -122 }, { 64, -124 },
    { 64, -125 }, { 63, -126 }, { 62, -127 }, { 61, -128 }, { 55, -130 }, { 47, -132 }, { 38, -134 }, { 29, -135 },
    { 20, -136 }, { 0, -135 }, { -39, -125 }, { -73, -104 }, { -99, -75 }, { -117, -39 }, { -123, 1 }, { -122, 18 },
    { -119, 34 }, { -114, 49 }, { -108, 64 }, { -100, 78 }, { -92, 88 }, { -82, 93 }, { -72, 96 }, { -61, 94 },
    { -52, 90 }, { 8, 25 }, { 14, 116 }, { 18, 124 }, { 24, 130 }, { 31, 134 }, { 40, 136 }, { 52, 134 },
    { 68, 128 }, { 84, 120 }, { 98, 110 }, { 111, 99 }, { 122, 87 }, { 123, 85 }, { 123, 84 }, { 123, 83 },
    { 123, 82 }, { 122, 81 }, { 109, 62 }, { 91, 34 }, { 78, 2 }, { 68, -31 }, { 63, -65 }, { 62, -89 }
};

static const gfx_mesh_img_point_t s_dragon_clawR_pts[] = {
    { -28, 0 }, { -111, 0 }, { -117, -1 }, { -123, -4 }, { -127, -9 }, { -130, -14 }, { -130, -21 }, { -124, -45 },
    { -108, -75 }, { -85, -100 }, { -57, -118 }, { -24, -129 }, { 12, -131 }, { 50, -121 }, { 82, -101 }, { 108, -73 },
    { 124, -39 }, { 130, 0 }, { 124, 39 }, { 108, 73 }, { 82, 101 }, { 50, 121 }, { 12, 131 }, { -14, 131 },
    { -33, 127 }, { -51, 121 }, { -68, 113 }, { -84, 102 }, { -95, 92 }, { -98, 87 }, { -99, 81 }, { -99, 75 },
    { -97, 70 }, { -93, 65 }, { -28, 0 }, { -28, 0 }
};

static const gfx_mesh_img_point_t s_dragon_eye_pts[] = {
    { 58, 0 }, { 55, 27 }, { 47, 51 }, { 34, 70 }, { 18, 82 }, { 0, 87 }, { -18, 82 }, { -34, 70 },
    { -47, 51 }, { -55, 27 }, { -58, 0 }, { -55, -27 }, { -47, -51 }, { -34, -70 }, { -18, -82 }, { 0, -87 },
    { 18, -82 }, { 34, -70 }, { 47, -51 }, { 55, -27 }, { 58, 0 }, { 58, 0 }
};

// --- Pose Sequences ---

#define TR(X, Y, R, S) { .x = (X), .y = (Y), .r = (R), .s = (S) }
#define HOME           { .x = 0, .y = 0, .r = 0, .s = 100 }

static const gfx_dragon_emote_pose_t s_dragon_sequence[] = {
    { "Home", "平静", HOME, HOME, HOME, HOME, HOME, HOME, HOME, HOME, HOME, 60 },
    { "High", "高昂", TR(0, -60, -5, 105), TR(0, -30, -2, 100), TR(0, 20, -10, 100), TR(-20, 0, 10, 100), TR(20, 0, -10, 100), TR(0, -20, 15, 110), HOME, HOME, HOME, 30 },
    { "Low", "沉稳", TR(0, 50, 5, 98), TR(0, 30, 2, 100), TR(0, -20, 10, 100), TR(0, 20, 0, 100), TR(0, 20, 0, 100), TR(0, 0, -15, 90), HOME, HOME, HOME, 30 },
    { "Left", "侧望(左)", TR(-60, 0, -10, 100), TR(-20, 0, -5, 100), TR(30, 0, 5, 100), HOME, HOME, TR(-10, 0, -5, 100), TR(-15, 0, 0, 100), TR(-15, 0, 0, 100), HOME, 30 },
    { "Right", "侧望(右)", TR(60, 0, 10, 100), TR(20, 0, 5, 100), TR(-30, 0, -5, 100), HOME, HOME, TR(10, 0, 5, 100), TR(15, 0, 0, 100), TR(15, 0, 0, 100), HOME, 30 },
    { "Alert", "警戒", TR(0, -30, 0, 110), TR(0, 0, 0, 105), HOME, HOME, HOME, TR(0, 0, 40, 140), TR(0, 0, 0, 120), TR(0, 0, 0, 120), TR(0, -60, 15, 100), 30 },
    { "Fear", "畏缩", TR(0, 180, -10, 85), TR(-30, 80, 0, 90), TR(80, 0, -30, 100), TR(40, 30, 0, 100), TR(-40, 30, 0, 100), TR(0, 0, -40, 70), HOME, HOME, HOME, 30 },
    { "Curious", "好奇", TR(90, -20, 12, 100), TR(40, 0, 8, 100), HOME, HOME, HOME, TR(0, 0, 20, 100), TR(10, 0, 0, 120), TR(10, 0, 0, 120), HOME, 30 },
    { "Proud", "傲岸", TR(0, -100, 0, 105), TR(0, -40, 0, 115), TR(0, 30, -15, 100), TR(-80, 50, -15, 100), TR(80, 50, 15, 100), HOME, HOME, HOME, HOME, 30 },
    { "Sneak", "潜伏", TR(50, 140, 20, 100), TR(-20, 60, 0, 80), TR(-50, 0, 40, 100), HOME, HOME, HOME, TR(0, 10, 0, 50), TR(0, 10, 0, 50), HOME, 30 },
    { "Angry", "愤怒", TR(0, 0, 0, 120), HOME, HOME, TR(0, 0, 25, 100), TR(0, 0, -25, 100), TR(0, 0, 60, 150), TR(0, -15, 0, 60), TR(0, -15, 0, 60), TR(0, -90, 10, 130), 30 },
    { "Tired", "困顿", TR(0, 100, -8, 95), TR(0, 40, 0, 92), HOME, HOME, HOME, TR(0, 0, -35, 80), TR(0, 0, 0, 20), TR(0, 0, 0, 20), HOME, 30 },
    { "Happy", "欣喜", TR(0, -40, 5, 108), TR(0, -10, 0, 105), TR(-20, 0, 25, 100), TR(0, -50, 15, 100), TR(0, -50, -15, 100), HOME, HOME, HOME, HOME, 30 },
    { "Think", "深思", TR(-40, 0, -15, 100), TR(20, 0, 10, 100), HOME, TR(80, -120, -45, 100), HOME, TR(0, 0, 12, 100), HOME, HOME, HOME, 30 },
    { "Guard", "后撤", TR(-120, 40, -10, 100), TR(-80, 20, 0, 100), TR(-120, 0, 15, 100), TR(0, 0, 35, 100), TR(0, 0, 15, 100), HOME, HOME, HOME, HOME, 30 }
};

static const gfx_dragon_emote_assets_t s_dragon_assets = {
    .pts_head     = s_dragon_head_pts,
    .pts_body     = s_dragon_body_pts,
    .pts_tail     = s_dragon_tail_pts,
    .pts_clawL    = s_dragon_clawL_pts,
    .pts_clawR    = s_dragon_clawR_pts,
    .pts_antenna  = NULL,
    .pts_eyeL     = s_dragon_eye_pts,
    .pts_eyeR     = s_dragon_eye_pts,
    .pts_dots     = NULL,

    .count_head    = sizeof(s_dragon_head_pts)/sizeof(s_dragon_head_pts[0]),
    .count_body    = sizeof(s_dragon_body_pts)/sizeof(s_dragon_body_pts[0]),
    .count_tail    = sizeof(s_dragon_tail_pts)/sizeof(s_dragon_tail_pts[0]),
    .count_clawL   = sizeof(s_dragon_clawL_pts)/sizeof(s_dragon_clawL_pts[0]),
    .count_clawR   = sizeof(s_dragon_clawR_pts)/sizeof(s_dragon_clawR_pts[0]),
    .count_antenna = 0,
    .count_eyeL    = sizeof(s_dragon_eye_pts)/sizeof(s_dragon_eye_pts[0]),
    .count_eyeR    = sizeof(s_dragon_eye_pts)/sizeof(s_dragon_eye_pts[0]),
    .count_dots    = 0,

    .sequence      = s_dragon_sequence,
    .sequence_count = sizeof(s_dragon_sequence) / sizeof(s_dragon_sequence[0])
};
