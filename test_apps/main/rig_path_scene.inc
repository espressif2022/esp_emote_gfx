/*
 * SPDX-FileCopyrightText: 2026 Espressif Systems (Shanghai) CO LTD
 *
 * SPDX-License-Identifier: Apache-2.0
 *
 * rig_path_scene.inc - generated from scene.json v1 by gui_designer.html
 */

#pragma once

#include "widget/gfx_sm_scene.h"

static const gfx_sm_meta_t s_rig_path_meta = {
    .version   = GFX_SM_SCENE_SCHEMA_VERSION,
    .viewbox_x = 0,
    .viewbox_y = 0,
    .viewbox_w = 390,
    .viewbox_h = 390,
};

static const gfx_sm_layout_t s_rig_path_layout = {
    .stroke_width    = 4,
    .mirror_x        = 0,
    .ground_y        = 330,
    .timer_period_ms = 33,
    .damping_div     = 4,
};

static const char *const s_rig_path_joint_names[] = {
    "shell_left_sh_0_0", /* 0 */
    "shell_left_sh_0_1", /* 1 */
    "shell_left_sh_0_2", /* 2 */
    "shell_left_sh_0_3", /* 3 */
    "shell_left_sh_0_4", /* 4 */
    "shell_left_sh_0_5", /* 5 */
    "shell_left_sh_0_6", /* 6 */
    "shell_left_sh_0_7", /* 7 */
    "shell_left_sh_0_8", /* 8 */
    "shell_left_sh_0_9", /* 9 */
    "shell_left_sh_0_10", /* 10 */
    "shell_left_sh_0_11", /* 11 */
    "shell_left_sh_0_12", /* 12 */
    "shell_left_sh_0_13", /* 13 */
    "shell_left_sh_0_14", /* 14 */
    "shell_left_sh_0_15", /* 15 */
    "shell_left_sh_0_16", /* 16 */
    "shell_left_sh_0_17", /* 17 */
    "shell_left_sh_0_18", /* 18 */
    "shell_left_sh_0_19", /* 19 */
    "shell_left_sh_0_20", /* 20 */
    "shell_left_sh_0_21", /* 21 */
    "shell_left_sh_0_22", /* 22 */
    "shell_left_sh_0_23", /* 23 */
    "shell_left_sh_0_24", /* 24 */
    "shell_left_sh_0_25", /* 25 */
    "shell_left_sh_0_26", /* 26 */
    "shell_left_sh_0_27", /* 27 */
    "shell_left_sh_0_28", /* 28 */
    "shell_left_sh_0_29", /* 29 */
    "shell_left_sh_0_30", /* 30 */
    "abdomen_sh_0_0", /* 31 */
    "abdomen_sh_0_1", /* 32 */
    "abdomen_sh_0_2", /* 33 */
    "abdomen_sh_0_3", /* 34 */
    "abdomen_sh_0_4", /* 35 */
    "abdomen_sh_0_5", /* 36 */
    "abdomen_sh_0_6", /* 37 */
    "abdomen_sh_0_7", /* 38 */
    "abdomen_sh_0_8", /* 39 */
    "abdomen_sh_0_9", /* 40 */
    "abdomen_sh_0_10", /* 41 */
    "abdomen_sh_0_11", /* 42 */
    "abdomen_sh_0_12", /* 43 */
    "abdomen_sh_0_13", /* 44 */
    "abdomen_sh_0_14", /* 45 */
    "abdomen_sh_0_15", /* 46 */
    "abdomen_sh_0_16", /* 47 */
    "abdomen_sh_0_17", /* 48 */
    "abdomen_sh_0_18", /* 49 */
    "abdomen_sh_0_19", /* 50 */
    "abdomen_sh_0_20", /* 51 */
    "abdomen_sh_0_21", /* 52 */
    "abdomen_sh_0_22", /* 53 */
    "abdomen_sh_0_23", /* 54 */
    "abdomen_sh_0_24", /* 55 */
    "abdomen_sh_0_25", /* 56 */
    "abdomen_sh_0_26", /* 57 */
    "abdomen_sh_0_27", /* 58 */
    "abdomen_sh_0_28", /* 59 */
    "abdomen_sh_0_29", /* 60 */
    "abdomen_sh_0_30", /* 61 */
    "head_sh_0_0", /* 62 */
    "head_sh_0_1", /* 63 */
    "head_sh_0_2", /* 64 */
    "head_sh_0_3", /* 65 */
    "head_sh_0_4", /* 66 */
    "head_sh_0_5", /* 67 */
    "head_sh_0_6", /* 68 */
    "head_sh_0_7", /* 69 */
    "head_sh_0_8", /* 70 */
    "head_sh_0_9", /* 71 */
    "head_sh_0_10", /* 72 */
    "head_sh_0_11", /* 73 */
    "head_sh_0_12", /* 74 */
    "head_sh_0_13", /* 75 */
    "head_sh_0_14", /* 76 */
    "head_sh_0_15", /* 77 */
    "head_sh_0_16", /* 78 */
    "head_sh_0_17", /* 79 */
    "head_sh_0_18", /* 80 */
    "head_sh_0_19", /* 81 */
    "head_sh_0_20", /* 82 */
    "head_sh_0_21", /* 83 */
    "head_sh_0_22", /* 84 */
    "head_sh_0_23", /* 85 */
    "head_sh_0_24", /* 86 */
    "head_sh_0_25", /* 87 */
    "head_sh_0_26", /* 88 */
    "head_sh_0_27", /* 89 */
    "head_sh_0_28", /* 90 */
    "head_sh_0_29", /* 91 */
    "head_sh_0_30", /* 92 */
    "head_sh_0_31", /* 93 */
    "head_sh_0_32", /* 94 */
    "head_sh_0_33", /* 95 */
    "head_sh_0_34", /* 96 */
    "head_sh_0_35", /* 97 */
    "head_sh_0_36", /* 98 */
    "wing_outer_sh_0_0", /* 99 */
    "wing_outer_sh_0_1", /* 100 */
    "wing_outer_sh_0_2", /* 101 */
    "wing_outer_sh_0_3", /* 102 */
    "wing_outer_sh_0_4", /* 103 */
    "wing_outer_sh_0_5", /* 104 */
    "wing_outer_sh_0_6", /* 105 */
    "wing_outer_sh_0_7", /* 106 */
    "wing_outer_sh_0_8", /* 107 */
    "wing_outer_sh_0_9", /* 108 */
    "wing_outer_sh_0_10", /* 109 */
    "wing_outer_sh_0_11", /* 110 */
    "wing_outer_sh_0_12", /* 111 */
    "wing_outer_sh_0_13", /* 112 */
    "wing_outer_sh_0_14", /* 113 */
    "wing_outer_sh_0_15", /* 114 */
    "wing_outer_sh_0_16", /* 115 */
    "wing_outer_sh_0_17", /* 116 */
    "wing_outer_sh_0_18", /* 117 */
    "wing_outer_sh_0_19", /* 118 */
    "wing_outer_sh_0_20", /* 119 */
    "wing_outer_sh_0_21", /* 120 */
    "wing_outer_sh_0_22", /* 121 */
    "wing_outer_sh_0_23", /* 122 */
    "wing_outer_sh_0_24", /* 123 */
    "wing_outer_sh_0_25", /* 124 */
    "wing_outer_sh_0_26", /* 125 */
    "wing_outer_sh_0_27", /* 126 */
    "wing_outer_sh_0_28", /* 127 */
    "wing_outer_sh_0_29", /* 128 */
    "wing_outer_sh_0_30", /* 129 */
    "wing_mid_sh_0_0", /* 130 */
    "wing_mid_sh_0_1", /* 131 */
    "wing_mid_sh_0_2", /* 132 */
    "wing_mid_sh_0_3", /* 133 */
    "wing_mid_sh_0_4", /* 134 */
    "wing_mid_sh_0_5", /* 135 */
    "wing_mid_sh_0_6", /* 136 */
    "wing_mid_sh_0_7", /* 137 */
    "wing_mid_sh_0_8", /* 138 */
    "wing_mid_sh_0_9", /* 139 */
    "wing_mid_sh_0_10", /* 140 */
    "wing_mid_sh_0_11", /* 141 */
    "wing_mid_sh_0_12", /* 142 */
    "wing_mid_sh_0_13", /* 143 */
    "wing_mid_sh_0_14", /* 144 */
    "wing_mid_sh_0_15", /* 145 */
    "wing_mid_sh_0_16", /* 146 */
    "wing_mid_sh_0_17", /* 147 */
    "wing_mid_sh_0_18", /* 148 */
    "wing_mid_sh_0_19", /* 149 */
    "wing_mid_sh_0_20", /* 150 */
    "wing_mid_sh_0_21", /* 151 */
    "wing_mid_sh_0_22", /* 152 */
    "wing_mid_sh_0_23", /* 153 */
    "wing_mid_sh_0_24", /* 154 */
    "wing_mid_sh_0_25", /* 155 */
    "wing_mid_sh_0_26", /* 156 */
    "wing_mid_sh_0_27", /* 157 */
    "wing_inner_sh_0_0", /* 158 */
    "wing_inner_sh_0_1", /* 159 */
    "wing_inner_sh_0_2", /* 160 */
    "wing_inner_sh_0_3", /* 161 */
    "wing_inner_sh_0_4", /* 162 */
    "wing_inner_sh_0_5", /* 163 */
    "wing_inner_sh_0_6", /* 164 */
    "wing_inner_sh_0_7", /* 165 */
    "wing_inner_sh_0_8", /* 166 */
    "wing_inner_sh_0_9", /* 167 */
    "wing_inner_sh_0_10", /* 168 */
    "wing_inner_sh_0_11", /* 169 */
    "wing_inner_sh_0_12", /* 170 */
    "wing_inner_sh_0_13", /* 171 */
    "wing_inner_sh_0_14", /* 172 */
    "wing_inner_sh_0_15", /* 173 */
    "wing_inner_sh_0_16", /* 174 */
    "wing_inner_sh_0_17", /* 175 */
    "wing_inner_sh_0_18", /* 176 */
    "wing_inner_sh_0_19", /* 177 */
    "wing_inner_sh_0_20", /* 178 */
    "wing_inner_sh_0_21", /* 179 */
    "wing_inner_sh_0_22", /* 180 */
    "wing_inner_sh_0_23", /* 181 */
    "wing_inner_sh_0_24", /* 182 */
    "wing_inner_sh_0_25", /* 183 */
    "wing_inner_sh_0_26", /* 184 */
    "wing_inner_sh_0_27", /* 185 */
    "wing_inner_sh_0_28", /* 186 */
    "wing_inner_sh_0_29", /* 187 */
    "wing_inner_sh_0_30", /* 188 */
    "antenna_right_sh_0_0", /* 189 */
    "antenna_right_sh_0_1", /* 190 */
    "antenna_right_sh_0_2", /* 191 */
    "antenna_right_sh_0_3", /* 192 */
    "antenna_right_sh_0_4", /* 193 */
    "antenna_right_sh_0_5", /* 194 */
    "antenna_right_sh_0_6", /* 195 */
    "antenna_left_sh_0_0", /* 196 */
    "antenna_left_sh_0_1", /* 197 */
    "antenna_left_sh_0_2", /* 198 */
    "antenna_left_sh_0_3", /* 199 */
    "antenna_left_sh_0_4", /* 200 */
    "antenna_left_sh_0_5", /* 201 */
    "antenna_left_sh_0_6", /* 202 */
    "mouth_right_sh_0_0", /* 203 */
    "mouth_right_sh_0_1", /* 204 */
    "mouth_right_sh_0_2", /* 205 */
    "mouth_right_sh_0_3", /* 206 */
    "mouth_right_sh_0_4", /* 207 */
    "mouth_right_sh_0_5", /* 208 */
    "mouth_right_sh_0_6", /* 209 */
    "mouth_right_sh_0_7", /* 210 */
    "mouth_right_sh_0_8", /* 211 */
    "mouth_right_sh_0_9", /* 212 */
    "mouth_left_sh_0_0", /* 213 */
    "mouth_left_sh_0_1", /* 214 */
    "mouth_left_sh_0_2", /* 215 */
    "mouth_left_sh_0_3", /* 216 */
    "mouth_left_sh_0_4", /* 217 */
    "mouth_left_sh_0_5", /* 218 */
    "mouth_left_sh_0_6", /* 219 */
    "mouth_left_sh_0_7", /* 220 */
    "mouth_left_sh_0_8", /* 221 */
    "mouth_left_sh_0_9", /* 222 */
    "eye_right_sh_0_0", /* 223 */
    "eye_right_sh_0_1", /* 224 */
    "eye_right_sh_0_2", /* 225 */
    "eye_right_sh_0_3", /* 226 */
    "eye_right_sh_0_4", /* 227 */
    "eye_right_sh_0_5", /* 228 */
    "eye_right_sh_0_6", /* 229 */
    "eye_right_sh_0_7", /* 230 */
    "eye_right_sh_0_8", /* 231 */
    "eye_right_sh_0_9", /* 232 */
    "eye_right_sh_0_10", /* 233 */
    "eye_right_sh_0_11", /* 234 */
    "eye_right_sh_0_12", /* 235 */
    "eye_right_sh_0_13", /* 236 */
    "eye_right_sh_0_14", /* 237 */
    "eye_right_sh_0_15", /* 238 */
    "eye_right_sh_0_16", /* 239 */
    "eye_right_sh_0_17", /* 240 */
    "eye_right_sh_0_18", /* 241 */
    "eye_right_sh_0_19", /* 242 */
    "eye_right_sh_0_20", /* 243 */
    "eye_right_sh_0_21", /* 244 */
    "eye_right_sh_0_22", /* 245 */
    "eye_right_sh_0_23", /* 246 */
    "eye_right_sh_0_24", /* 247 */
    "eye_right_sh_0_25", /* 248 */
    "eye_right_sh_0_26", /* 249 */
    "eye_right_sh_0_27", /* 250 */
    "eye_right_sh_0_28", /* 251 */
    "eye_right_sh_0_29", /* 252 */
    "eye_right_sh_0_30", /* 253 */
    "pupil_right_sh_0_0", /* 254 */
    "pupil_right_sh_0_1", /* 255 */
    "pupil_right_sh_0_2", /* 256 */
    "pupil_right_sh_0_3", /* 257 */
    "pupil_right_sh_0_4", /* 258 */
    "pupil_right_sh_0_5", /* 259 */
    "pupil_right_sh_0_6", /* 260 */
    "pupil_right_sh_0_7", /* 261 */
    "pupil_right_sh_0_8", /* 262 */
    "pupil_right_sh_0_9", /* 263 */
    "pupil_right_sh_0_10", /* 264 */
    "pupil_right_sh_0_11", /* 265 */
    "pupil_right_sh_0_12", /* 266 */
    "pupil_right_sh_0_13", /* 267 */
    "pupil_right_sh_0_14", /* 268 */
    "pupil_right_sh_0_15", /* 269 */
    "pupil_right_sh_0_16", /* 270 */
    "pupil_right_sh_0_17", /* 271 */
    "pupil_right_sh_0_18", /* 272 */
    "pupil_right_sh_0_19", /* 273 */
    "pupil_right_sh_0_20", /* 274 */
    "pupil_right_sh_0_21", /* 275 */
    "pupil_right_sh_0_22", /* 276 */
    "pupil_right_sh_0_23", /* 277 */
    "pupil_right_sh_0_24", /* 278 */
    "eye_left_sh_0_0", /* 279 */
    "eye_left_sh_0_1", /* 280 */
    "eye_left_sh_0_2", /* 281 */
    "eye_left_sh_0_3", /* 282 */
    "eye_left_sh_0_4", /* 283 */
    "eye_left_sh_0_5", /* 284 */
    "eye_left_sh_0_6", /* 285 */
    "eye_left_sh_0_7", /* 286 */
    "eye_left_sh_0_8", /* 287 */
    "eye_left_sh_0_9", /* 288 */
    "eye_left_sh_0_10", /* 289 */
    "eye_left_sh_0_11", /* 290 */
    "eye_left_sh_0_12", /* 291 */
    "eye_left_sh_0_13", /* 292 */
    "eye_left_sh_0_14", /* 293 */
    "eye_left_sh_0_15", /* 294 */
    "eye_left_sh_0_16", /* 295 */
    "eye_left_sh_0_17", /* 296 */
    "eye_left_sh_0_18", /* 297 */
    "eye_left_sh_0_19", /* 298 */
    "eye_left_sh_0_20", /* 299 */
    "eye_left_sh_0_21", /* 300 */
    "eye_left_sh_0_22", /* 301 */
    "eye_left_sh_0_23", /* 302 */
    "eye_left_sh_0_24", /* 303 */
    "eye_left_sh_0_25", /* 304 */
    "eye_left_sh_0_26", /* 305 */
    "eye_left_sh_0_27", /* 306 */
    "eye_left_sh_0_28", /* 307 */
    "eye_left_sh_0_29", /* 308 */
    "eye_left_sh_0_30", /* 309 */
    "pupil_left_sh_0_0", /* 310 */
    "pupil_left_sh_0_1", /* 311 */
    "pupil_left_sh_0_2", /* 312 */
    "pupil_left_sh_0_3", /* 313 */
    "pupil_left_sh_0_4", /* 314 */
    "pupil_left_sh_0_5", /* 315 */
    "pupil_left_sh_0_6", /* 316 */
    "pupil_left_sh_0_7", /* 317 */
    "pupil_left_sh_0_8", /* 318 */
    "pupil_left_sh_0_9", /* 319 */
    "pupil_left_sh_0_10", /* 320 */
    "pupil_left_sh_0_11", /* 321 */
    "pupil_left_sh_0_12", /* 322 */
    "pupil_left_sh_0_13", /* 323 */
    "pupil_left_sh_0_14", /* 324 */
    "pupil_left_sh_0_15", /* 325 */
    "pupil_left_sh_0_16", /* 326 */
    "pupil_left_sh_0_17", /* 327 */
    "pupil_left_sh_0_18", /* 328 */
    "pupil_left_sh_0_19", /* 329 */
    "pupil_left_sh_0_20", /* 330 */
    "pupil_left_sh_0_21", /* 331 */
    "pupil_left_sh_0_22", /* 332 */
    "pupil_left_sh_0_23", /* 333 */
    "pupil_left_sh_0_24", /* 334 */
    "foot_1_sh_0_0", /* 335 */
    "foot_1_sh_0_1", /* 336 */
    "foot_1_sh_0_2", /* 337 */
    "foot_1_sh_0_3", /* 338 */
    "foot_1_sh_0_4", /* 339 */
    "foot_1_sh_0_5", /* 340 */
    "foot_1_sh_0_6", /* 341 */
    "foot_1_sh_0_7", /* 342 */
    "foot_1_sh_0_8", /* 343 */
    "foot_1_sh_0_9", /* 344 */
    "foot_1_sh_0_10", /* 345 */
    "foot_1_sh_0_11", /* 346 */
    "foot_1_sh_0_12", /* 347 */
    "foot_1_sh_0_13", /* 348 */
    "foot_1_sh_0_14", /* 349 */
    "foot_1_sh_0_15", /* 350 */
    "foot_1_sh_0_16", /* 351 */
    "foot_1_sh_0_17", /* 352 */
    "foot_1_sh_0_18", /* 353 */
    "foot_1_sh_0_19", /* 354 */
    "foot_1_sh_0_20", /* 355 */
    "foot_1_sh_0_21", /* 356 */
    "foot_1_sh_0_22", /* 357 */
    "foot_1_sh_0_23", /* 358 */
    "foot_1_sh_0_24", /* 359 */
    "foot_2_sh_0_0", /* 360 */
    "foot_2_sh_0_1", /* 361 */
    "foot_2_sh_0_2", /* 362 */
    "foot_2_sh_0_3", /* 363 */
    "foot_2_sh_0_4", /* 364 */
    "foot_2_sh_0_5", /* 365 */
    "foot_2_sh_0_6", /* 366 */
    "foot_2_sh_0_7", /* 367 */
    "foot_2_sh_0_8", /* 368 */
    "foot_2_sh_0_9", /* 369 */
    "foot_2_sh_0_10", /* 370 */
    "foot_2_sh_0_11", /* 371 */
    "foot_2_sh_0_12", /* 372 */
    "foot_2_sh_0_13", /* 373 */
    "foot_2_sh_0_14", /* 374 */
    "foot_2_sh_0_15", /* 375 */
    "foot_2_sh_0_16", /* 376 */
    "foot_2_sh_0_17", /* 377 */
    "foot_2_sh_0_18", /* 378 */
    "foot_2_sh_0_19", /* 379 */
    "foot_2_sh_0_20", /* 380 */
    "foot_2_sh_0_21", /* 381 */
    "foot_2_sh_0_22", /* 382 */
    "foot_2_sh_0_23", /* 383 */
    "foot_2_sh_0_24", /* 384 */
    "foot_3_sh_0_0", /* 385 */
    "foot_3_sh_0_1", /* 386 */
    "foot_3_sh_0_2", /* 387 */
    "foot_3_sh_0_3", /* 388 */
    "foot_3_sh_0_4", /* 389 */
    "foot_3_sh_0_5", /* 390 */
    "foot_3_sh_0_6", /* 391 */
    "foot_3_sh_0_7", /* 392 */
    "foot_3_sh_0_8", /* 393 */
    "foot_3_sh_0_9", /* 394 */
    "foot_3_sh_0_10", /* 395 */
    "foot_3_sh_0_11", /* 396 */
    "foot_3_sh_0_12", /* 397 */
    "foot_3_sh_0_13", /* 398 */
    "foot_3_sh_0_14", /* 399 */
    "foot_3_sh_0_15", /* 400 */
    "foot_3_sh_0_16", /* 401 */
    "foot_3_sh_0_17", /* 402 */
    "foot_3_sh_0_18", /* 403 */
    "foot_3_sh_0_19", /* 404 */
    "foot_3_sh_0_20", /* 405 */
    "foot_3_sh_0_21", /* 406 */
    "foot_3_sh_0_22", /* 407 */
    "foot_3_sh_0_23", /* 408 */
    "foot_3_sh_0_24", /* 409 */
};

static const int16_t s_rig_path_p00[] = { 125, 208, 125, 208, 107, 212, 107, 212, 107, 212, 96, 213, 96, 213, 96, 213, 97, 192, 97, 192, 97, 192, 121, 167, 121, 167, 121, 167, 154, 190, 154, 190, 154, 190, 148, 235, 148, 235, 148, 235, 118, 247, 118, 247, 118, 247, 101, 232, 101, 232, 101, 232, 103, 224, 103, 224, 103, 224, 125, 208, 125, 208, 183, 264, 183, 264, 166, 271, 166, 271, 166, 271, 154, 273, 154, 273, 154, 273, 154, 253, 154, 253, 154, 253, 176, 224, 176, 224, 176, 224, 210, 243, 210, 243, 210, 243, 208, 288, 208, 288, 208, 288, 179, 304, 179, 304, 179, 304, 161, 292, 161, 292, 161, 292, 162, 283, 162, 283, 162, 283, 183, 264, 183, 264, 192, 134, 192, 134, 216, 142, 216, 142, 216, 142, 233, 166, 233, 166, 233, 166, 240, 198, 240, 198, 240, 198, 233, 230, 233, 230, 233, 230, 216, 254, 216, 254, 216, 254, 192, 262, 192, 262, 192, 262, 168, 254, 168, 254, 168, 254, 150, 230, 150, 230, 150, 230, 143, 198, 143, 198, 143, 198, 150, 166, 150, 166, 150, 166, 168, 142, 168, 142, 168, 142, 192, 134, 192, 134, 253, 109, 253, 109, 253, 105, 253, 105, 253, 105, 262, 85, 262, 85, 262, 85, 269, 83, 269, 83, 269, 83, 290, 116, 290, 116, 290, 116, 301, 146, 301, 146, 301, 146, 295, 157, 295, 157, 295, 157, 280, 158, 280, 158, 280, 158, 276, 155, 276, 155, 276, 155, 267, 132, 267, 132, 267, 132, 253, 109, 253, 109, 236, 125, 236, 125, 237, 123, 237, 123, 237, 123, 248, 116, 248, 116, 248, 116, 258, 124, 258, 124, 258, 124, 271, 150, 271, 150, 271, 150, 271, 159, 271, 159, 271, 159, 262, 169, 262, 169, 262, 169, 259, 169, 259, 169, 259, 169, 249, 145, 249, 145, 249, 145, 236, 125, 236, 125, 217, 138, 217, 138, 229, 129, 229, 129, 229, 129, 236, 130, 236, 130, 236, 130, 247, 147, 247, 147, 247, 147, 257, 172, 257, 172, 257, 172, 254, 179, 254, 179, 254, 179, 243, 193, 243, 193, 243, 193, 242, 190, 242, 190, 242, 190, 235, 162, 235, 162, 235, 162, 216, 140, 216, 140, 216, 140, 217, 138, 217, 138, 202, 101, 202, 101, 192, 115, 192, 115, 192, 115, 189, 142, 189, 142, 172, 101, 172, 101, 162, 115, 162, 115, 162, 115, 159, 142, 159, 142, 182, 142, 182, 142, 188, 138, 188, 138, 188, 138, 195, 142, 195, 142, 195, 142, 182, 142, 182, 142, 153, 142, 153, 142, 159, 138, 159, 138, 159, 138, 167, 142, 167, 142, 167, 142, 153, 142, 153, 142, 188, 138, 188, 138, 195, 142, 195, 142, 195, 142, 199, 153, 199, 153, 199, 153, 199, 166, 199, 166, 199, 166, 195, 176, 195, 176, 195, 176, 188, 180, 188, 180, 188, 180, 182, 176, 182, 176, 182, 176, 178, 166, 178, 166, 178, 166, 178, 153, 178, 153, 178, 153, 182, 142, 182, 142, 182, 142, 188, 138, 188, 138, 183, 160, 183, 160, 185, 161, 185, 161, 185, 161, 186, 164, 186, 164, 186, 164, 185, 167, 185, 167, 185, 167, 183, 168, 183, 168, 183, 168, 181, 167, 181, 167, 181, 167, 180, 164, 180, 164, 180, 164, 181, 161, 181, 161, 181, 161, 183, 160, 183, 160, 160, 138, 160, 138, 166, 142, 166, 142, 166, 142, 170, 153, 170, 153, 170, 153, 170, 166, 170, 166, 170, 166, 166, 176, 166, 176, 166, 176, 160, 180, 160, 180, 160, 180, 154, 176, 154, 176, 154, 176, 150, 166, 150, 166, 150, 166, 150, 153, 150, 153, 150, 153, 154, 142, 154, 142, 154, 142, 160, 138, 160, 138, 153, 159, 153, 159, 155, 160, 155, 160, 155, 160, 156, 163, 156, 163, 156, 163, 155, 165, 155, 165, 155, 165, 153, 166, 153, 166, 153, 166, 151, 165, 151, 165, 151, 165, 150, 163, 150, 163, 150, 163, 151, 160, 151, 160, 151, 160, 153, 159, 153, 159, 247, 209, 247, 209, 251, 212, 251, 212, 251, 212, 252, 217, 252, 217, 252, 217, 251, 222, 251, 222, 251, 222, 247, 224, 247, 224, 247, 224, 243, 222, 243, 222, 243, 222, 241, 217, 241, 217, 241, 217, 243, 212, 243, 212, 243, 212, 247, 209, 247, 209, 243, 227, 243, 227, 246, 229, 246, 229, 246, 229, 248, 234, 248, 234, 248, 234, 246, 239, 246, 239, 246, 239, 243, 241, 243, 241, 243, 241, 239, 239, 239, 239, 239, 239, 237, 234, 237, 234, 237, 234, 239, 229, 239, 229, 239, 229, 243, 227, 243, 227, 234, 240, 234, 240, 237, 242, 237, 242, 237, 242, 239, 247, 239, 247, 239, 247, 237, 252, 237, 252, 237, 252, 234, 255, 234, 255, 234, 255, 230, 252, 230, 252, 230, 252, 228, 247, 228, 247, 228, 247, 230, 242, 230, 242, 230, 242, 234, 240, 234, 240 }; /* active_idle */
static const int16_t s_rig_path_p01[] = { 122, 205, 122, 205, 104, 212, 104, 212, 104, 212, 93, 215, 93, 215, 93, 215, 91, 195, 91, 195, 91, 195, 112, 166, 112, 166, 112, 166, 147, 185, 147, 185, 147, 185, 148, 230, 148, 230, 148, 230, 120, 246, 120, 246, 120, 246, 101, 233, 101, 233, 101, 233, 101, 225, 101, 225, 101, 225, 122, 205, 122, 205, 181, 260, 181, 260, 164, 268, 164, 268, 164, 268, 153, 271, 153, 271, 153, 271, 151, 251, 151, 251, 151, 251, 170, 221, 170, 221, 170, 221, 206, 237, 206, 237, 206, 237, 208, 282, 208, 282, 208, 282, 180, 300, 180, 300, 180, 300, 161, 290, 161, 290, 161, 290, 161, 281, 161, 281, 161, 281, 181, 260, 181, 260, 189, 130, 189, 130, 214, 137, 214, 137, 214, 137, 232, 160, 232, 160, 232, 160, 240, 192, 240, 192, 240, 192, 235, 225, 235, 225, 235, 225, 218, 249, 218, 249, 218, 249, 194, 258, 194, 258, 194, 258, 170, 250, 170, 250, 170, 250, 151, 227, 151, 227, 151, 227, 143, 196, 143, 196, 143, 196, 149, 163, 149, 163, 149, 163, 166, 139, 166, 139, 166, 139, 189, 130, 189, 130, 254, 101, 254, 101, 255, 97, 255, 97, 255, 97, 268, 80, 268, 80, 268, 80, 276, 79, 276, 79, 276, 79, 289, 115, 289, 115, 289, 115, 293, 147, 293, 147, 293, 147, 285, 157, 285, 157, 285, 157, 270, 154, 270, 154, 270, 154, 267, 151, 267, 151, 267, 151, 263, 126, 263, 126, 263, 126, 254, 101, 254, 101, 236, 120, 236, 120, 237, 118, 237, 118, 237, 118, 249, 113, 249, 113, 249, 113, 258, 122, 258, 122, 258, 122, 267, 151, 267, 151, 267, 151, 265, 159, 265, 159, 265, 159, 255, 168, 255, 168, 255, 168, 252, 167, 252, 167, 252, 167, 246, 142, 246, 142, 246, 142, 236, 120, 236, 120, 215, 135, 215, 135, 228, 128, 228, 128, 228, 128, 234, 129, 234, 129, 234, 129, 244, 147, 244, 147, 244, 147, 250, 173, 250, 173, 250, 173, 247, 180, 247, 180, 247, 180, 234, 193, 234, 193, 234, 193, 234, 190, 234, 190, 234, 190, 230, 161, 230, 161, 230, 161, 214, 137, 214, 137, 214, 137, 215, 135, 215, 135, 194, 92, 194, 92, 187, 106, 187, 106, 187, 106, 189, 134, 189, 134, 178, 96, 178, 96, 166, 108, 166, 108, 166, 108, 158, 134, 158, 134, 182, 142, 182, 142, 188, 137, 188, 137, 188, 137, 195, 141, 195, 141, 195, 141, 182, 142, 182, 142, 153, 141, 153, 141, 159, 137, 159, 137, 159, 137, 167, 142, 167, 142, 167, 142, 153, 141, 153, 141, 188, 136, 188, 136, 195, 140, 195, 140, 195, 140, 199, 151, 199, 151, 199, 151, 199, 165, 199, 165, 199, 165, 195, 176, 195, 176, 195, 176, 188, 180, 188, 180, 188, 180, 182, 176, 182, 176, 182, 176, 178, 165, 178, 165, 178, 165, 178, 151, 178, 151, 178, 151, 182, 140, 182, 140, 182, 140, 188, 136, 188, 136, 183, 159, 183, 159, 185, 160, 185, 160, 185, 160, 186, 163, 186, 163, 186, 163, 185, 166, 185, 166, 185, 166, 183, 167, 183, 167, 183, 167, 181, 166, 181, 166, 181, 166, 180, 163, 180, 163, 180, 163, 181, 160, 181, 160, 181, 160, 183, 159, 183, 159, 160, 136, 160, 136, 166, 140, 166, 140, 166, 140, 170, 151, 170, 151, 170, 151, 170, 165, 170, 165, 170, 165, 166, 176, 166, 176, 166, 176, 160, 180, 160, 180, 160, 180, 154, 176, 154, 176, 154, 176, 150, 165, 150, 165, 150, 165, 150, 151, 150, 151, 150, 151, 154, 140, 154, 140, 154, 140, 160, 136, 160, 136, 153, 158, 153, 158, 155, 159, 155, 159, 155, 159, 156, 162, 156, 162, 156, 162, 155, 164, 155, 164, 155, 164, 153, 165, 153, 165, 153, 165, 151, 164, 151, 164, 151, 164, 150, 162, 150, 162, 150, 162, 151, 159, 151, 159, 151, 159, 153, 158, 153, 158, 247, 206, 247, 206, 251, 209, 251, 209, 251, 209, 252, 214, 252, 214, 252, 214, 251, 219, 251, 219, 251, 219, 247, 221, 247, 221, 247, 221, 243, 219, 243, 219, 243, 219, 241, 214, 241, 214, 241, 214, 243, 209, 243, 209, 243, 209, 247, 206, 247, 206, 242, 228, 242, 228, 245, 230, 245, 230, 245, 230, 247, 235, 247, 235, 247, 235, 245, 240, 245, 240, 245, 240, 242, 242, 242, 242, 242, 242, 238, 240, 238, 240, 238, 240, 236, 235, 236, 235, 236, 235, 238, 230, 238, 230, 238, 230, 242, 228, 242, 228, 235, 243, 235, 243, 238, 245, 238, 245, 238, 245, 240, 250, 240, 250, 240, 250, 238, 255, 238, 255, 238, 255, 235, 258, 235, 258, 235, 258, 231, 255, 231, 255, 231, 255, 229, 250, 229, 250, 229, 250, 231, 245, 231, 245, 231, 245, 235, 243, 235, 243 }; /* active_open */
static const int16_t s_rig_path_p02[] = { 117, 210, 117, 210, 101, 219, 101, 219, 101, 219, 90, 222, 90, 222, 90, 222, 86, 202, 86, 202, 86, 202, 103, 171, 103, 171, 103, 171, 140, 186, 140, 186, 140, 186, 146, 231, 146, 231, 146, 231, 119, 250, 119, 250, 119, 250, 99, 240, 99, 240, 99, 240, 99, 231, 99, 231, 99, 231, 117, 210, 117, 210, 189, 267, 189, 267, 170, 271, 170, 271, 170, 271, 159, 272, 159, 272, 159, 272, 161, 252, 161, 252, 161, 252, 187, 226, 187, 226, 187, 226, 218, 249, 218, 249, 218, 249, 210, 294, 210, 294, 210, 294, 179, 306, 179, 306, 179, 306, 163, 291, 163, 291, 163, 291, 165, 283, 165, 283, 165, 283, 189, 267, 189, 267, 196, 133, 196, 133, 220, 142, 220, 142, 220, 142, 237, 166, 237, 166, 237, 166, 242, 199, 242, 199, 242, 199, 234, 230, 234, 230, 234, 230, 216, 253, 216, 253, 216, 253, 191, 261, 191, 261, 191, 261, 168, 252, 168, 252, 168, 252, 151, 228, 151, 228, 151, 228, 145, 195, 145, 195, 145, 195, 153, 163, 153, 163, 153, 163, 172, 140, 172, 140, 172, 140, 196, 133, 196, 133, 257, 111, 257, 111, 256, 107, 256, 107, 256, 107, 262, 86, 262, 86, 262, 86, 270, 83, 270, 83, 270, 83, 294, 113, 294, 113, 294, 113, 310, 140, 310, 140, 310, 140, 305, 153, 305, 153, 305, 153, 290, 155, 290, 155, 290, 155, 286, 153, 286, 153, 286, 153, 274, 131, 274, 131, 274, 131, 257, 111, 257, 111, 239, 128, 239, 128, 240, 126, 240, 126, 240, 126, 250, 118, 250, 118, 250, 118, 261, 125, 261, 125, 261, 125, 277, 150, 277, 150, 277, 150, 278, 158, 278, 158, 278, 158, 270, 169, 270, 169, 270, 169, 267, 170, 267, 170, 267, 170, 254, 147, 254, 147, 254, 147, 239, 128, 239, 128, 219, 142, 219, 142, 230, 132, 230, 132, 230, 132, 237, 132, 237, 132, 237, 132, 250, 148, 250, 148, 250, 148, 262, 172, 262, 172, 262, 172, 259, 179, 259, 179, 259, 179, 250, 194, 250, 194, 250, 194, 249, 192, 249, 192, 249, 192, 239, 164, 239, 164, 239, 164, 218, 144, 218, 144, 218, 144, 219, 142, 219, 142, 210, 100, 210, 100, 199, 111, 199, 111, 199, 111, 192, 138, 192, 138, 162, 96, 162, 96, 155, 110, 155, 110, 155, 110, 155, 138, 155, 138, 182, 143, 182, 143, 188, 139, 188, 139, 188, 139, 195, 144, 195, 144, 195, 144, 182, 143, 182, 143, 153, 144, 153, 144, 159, 139, 159, 139, 159, 139, 167, 143, 167, 143, 167, 143, 153, 144, 153, 144, 188, 140, 188, 140, 195, 144, 195, 144, 195, 144, 199, 154, 199, 154, 199, 154, 199, 166, 199, 166, 199, 166, 195, 176, 195, 176, 195, 176, 188, 180, 188, 180, 188, 180, 182, 176, 182, 176, 182, 176, 178, 166, 178, 166, 178, 166, 178, 154, 178, 154, 178, 154, 182, 144, 182, 144, 182, 144, 188, 140, 188, 140, 184, 160, 184, 160, 186, 161, 186, 161, 186, 161, 187, 164, 187, 164, 187, 164, 186, 167, 186, 167, 186, 167, 184, 168, 184, 168, 184, 168, 182, 167, 182, 167, 182, 167, 181, 164, 181, 164, 181, 164, 182, 161, 182, 161, 182, 161, 184, 160, 184, 160, 160, 140, 160, 140, 166, 144, 166, 144, 166, 144, 170, 154, 170, 154, 170, 154, 170, 166, 170, 166, 170, 166, 166, 176, 166, 176, 166, 176, 160, 180, 160, 180, 160, 180, 154, 176, 154, 176, 154, 176, 150, 166, 150, 166, 150, 166, 150, 154, 150, 154, 150, 154, 154, 144, 154, 144, 154, 144, 160, 140, 160, 140, 154, 160, 154, 160, 156, 161, 156, 161, 156, 161, 157, 164, 157, 164, 157, 164, 156, 166, 156, 166, 156, 166, 154, 167, 154, 167, 154, 167, 152, 166, 152, 166, 152, 166, 151, 164, 151, 164, 151, 164, 152, 161, 152, 161, 152, 161, 154, 160, 154, 160, 244, 201, 244, 201, 248, 204, 248, 204, 248, 204, 249, 209, 249, 209, 249, 209, 248, 214, 248, 214, 248, 214, 244, 216, 244, 216, 244, 216, 240, 214, 240, 214, 240, 214, 238, 209, 238, 209, 238, 209, 240, 204, 240, 204, 240, 204, 244, 201, 244, 201, 244, 225, 244, 225, 247, 227, 247, 227, 247, 227, 249, 232, 249, 232, 249, 232, 247, 237, 247, 237, 247, 237, 244, 239, 244, 239, 244, 239, 240, 237, 240, 237, 240, 237, 238, 232, 238, 232, 238, 232, 240, 227, 240, 227, 240, 227, 244, 225, 244, 225, 237, 247, 237, 247, 240, 249, 240, 249, 240, 249, 242, 254, 242, 254, 242, 254, 240, 259, 240, 259, 240, 259, 237, 262, 237, 262, 237, 262, 233, 259, 233, 259, 233, 259, 231, 254, 231, 254, 231, 254, 233, 249, 233, 249, 233, 249, 237, 247, 237, 247 }; /* active_step */
static const int16_t s_rig_path_p03[] = { 123, 208, 123, 208, 106, 213, 106, 213, 106, 213, 94, 215, 94, 215, 94, 215, 94, 195, 94, 195, 94, 195, 116, 167, 116, 167, 116, 167, 150, 188, 150, 188, 150, 188, 149, 233, 149, 233, 149, 233, 119, 248, 119, 248, 119, 248, 101, 234, 101, 234, 101, 234, 102, 226, 102, 226, 102, 226, 123, 208, 123, 208, 185, 265, 185, 265, 167, 271, 167, 271, 167, 271, 155, 273, 155, 273, 155, 273, 155, 253, 155, 253, 155, 253, 178, 225, 178, 225, 178, 225, 212, 245, 212, 245, 212, 245, 209, 290, 209, 290, 209, 290, 179, 305, 179, 305, 179, 305, 161, 292, 161, 292, 161, 292, 162, 284, 162, 284, 162, 284, 185, 265, 185, 265, 194, 135, 194, 135, 218, 144, 218, 144, 218, 144, 235, 167, 235, 167, 235, 167, 241, 200, 241, 200, 241, 200, 234, 232, 234, 232, 234, 232, 216, 255, 216, 255, 216, 255, 192, 263, 192, 263, 192, 263, 168, 254, 168, 254, 168, 254, 150, 230, 150, 230, 150, 230, 144, 198, 144, 198, 144, 198, 151, 166, 151, 166, 151, 166, 170, 143, 170, 143, 170, 143, 194, 135, 194, 135, 251, 107, 251, 107, 251, 103, 251, 103, 251, 103, 262, 84, 262, 84, 262, 84, 269, 82, 269, 82, 269, 82, 287, 116, 287, 116, 287, 116, 296, 147, 296, 147, 296, 147, 290, 158, 290, 158, 290, 158, 275, 157, 275, 157, 275, 157, 271, 154, 271, 154, 271, 154, 263, 131, 263, 131, 263, 131, 251, 107, 251, 107, 235, 124, 235, 124, 236, 122, 236, 122, 236, 122, 248, 116, 248, 116, 248, 116, 257, 124, 257, 124, 257, 124, 268, 152, 268, 152, 268, 152, 268, 161, 268, 161, 268, 161, 258, 170, 258, 170, 258, 170, 255, 170, 255, 170, 255, 170, 246, 145, 246, 145, 246, 145, 235, 124, 235, 124, 217, 137, 217, 137, 230, 129, 230, 129, 230, 129, 236, 130, 236, 130, 236, 130, 246, 147, 246, 147, 246, 147, 255, 173, 255, 173, 255, 173, 252, 179, 252, 179, 252, 179, 240, 193, 240, 193, 240, 193, 239, 191, 239, 191, 239, 191, 234, 162, 234, 162, 234, 162, 216, 139, 216, 139, 216, 139, 217, 137, 217, 137, 200, 99, 200, 99, 191, 112, 191, 112, 191, 112, 190, 140, 190, 140, 174, 100, 174, 100, 163, 113, 163, 113, 163, 113, 158, 140, 158, 140, 182, 144, 182, 144, 188, 139, 188, 139, 188, 139, 195, 143, 195, 143, 195, 143, 182, 144, 182, 144, 153, 143, 153, 143, 159, 139, 159, 139, 159, 139, 167, 144, 167, 144, 167, 144, 153, 143, 153, 143, 188, 138, 188, 138, 195, 142, 195, 142, 195, 142, 199, 153, 199, 153, 199, 153, 199, 166, 199, 166, 199, 166, 195, 177, 195, 177, 195, 177, 188, 181, 188, 181, 188, 181, 182, 177, 182, 177, 182, 177, 178, 166, 178, 166, 178, 166, 178, 153, 178, 153, 178, 153, 182, 142, 182, 142, 182, 142, 188, 138, 188, 138, 183, 161, 183, 161, 185, 162, 185, 162, 185, 162, 186, 165, 186, 165, 186, 165, 185, 168, 185, 168, 185, 168, 183, 169, 183, 169, 183, 169, 181, 168, 181, 168, 181, 168, 180, 165, 180, 165, 180, 165, 181, 162, 181, 162, 181, 162, 183, 161, 183, 161, 160, 138, 160, 138, 166, 142, 166, 142, 166, 142, 170, 153, 170, 153, 170, 153, 170, 166, 170, 166, 170, 166, 166, 177, 166, 177, 166, 177, 160, 181, 160, 181, 160, 181, 154, 177, 154, 177, 154, 177, 150, 166, 150, 166, 150, 166, 150, 153, 150, 153, 150, 153, 154, 142, 154, 142, 154, 142, 160, 138, 160, 138, 153, 160, 153, 160, 155, 161, 155, 161, 155, 161, 156, 164, 156, 164, 156, 164, 155, 166, 155, 166, 155, 166, 153, 167, 153, 167, 153, 167, 151, 166, 151, 166, 151, 166, 150, 164, 150, 164, 150, 164, 151, 161, 151, 161, 151, 161, 153, 160, 153, 160, 248, 210, 248, 210, 252, 213, 252, 213, 252, 213, 253, 218, 253, 218, 253, 218, 252, 223, 252, 223, 252, 223, 248, 225, 248, 225, 248, 225, 244, 223, 244, 223, 244, 223, 242, 218, 242, 218, 242, 218, 244, 213, 244, 213, 244, 213, 248, 210, 248, 210, 244, 228, 244, 228, 247, 230, 247, 230, 247, 230, 249, 235, 249, 235, 249, 235, 247, 240, 247, 240, 247, 240, 244, 242, 244, 242, 244, 242, 240, 240, 240, 240, 240, 240, 238, 235, 238, 235, 238, 235, 240, 230, 240, 230, 240, 230, 244, 228, 244, 228, 234, 242, 234, 242, 237, 244, 237, 244, 237, 244, 239, 249, 239, 249, 239, 249, 237, 254, 237, 254, 237, 254, 234, 257, 234, 257, 234, 257, 230, 254, 230, 254, 230, 254, 228, 249, 228, 249, 228, 249, 230, 244, 230, 244, 230, 244, 234, 242, 234, 242 }; /* offline_alert */
static const int16_t s_rig_path_p04[] = { 129, 216, 129, 216, 112, 219, 112, 219, 112, 219, 100, 218, 100, 218, 100, 218, 103, 199, 103, 199, 103, 199, 128, 175, 128, 175, 128, 175, 158, 201, 158, 201, 158, 201, 150, 244, 150, 244, 150, 244, 119, 254, 119, 254, 119, 254, 104, 238, 104, 238, 104, 238, 106, 230, 106, 230, 106, 230, 129, 216, 129, 216, 192, 275, 192, 275, 174, 278, 174, 278, 174, 278, 163, 278, 163, 278, 163, 278, 166, 259, 166, 259, 166, 259, 192, 236, 192, 236, 192, 236, 221, 260, 221, 260, 221, 260, 211, 302, 211, 302, 211, 302, 181, 311, 181, 311, 181, 311, 166, 297, 166, 297, 166, 297, 168, 289, 168, 289, 168, 289, 192, 275, 192, 275, 203, 147, 203, 147, 226, 158, 226, 158, 226, 158, 241, 182, 241, 182, 241, 182, 244, 213, 244, 213, 244, 213, 234, 243, 234, 243, 234, 243, 215, 263, 215, 263, 215, 263, 190, 269, 190, 269, 190, 269, 168, 258, 168, 258, 168, 258, 153, 234, 153, 234, 153, 234, 150, 203, 150, 203, 150, 203, 159, 173, 159, 173, 159, 173, 179, 153, 179, 153, 179, 153, 203, 147, 203, 147, 247, 119, 247, 119, 249, 115, 249, 115, 249, 115, 264, 102, 264, 102, 264, 102, 272, 103, 272, 103, 272, 103, 277, 140, 277, 140, 277, 140, 275, 170, 275, 170, 275, 170, 265, 178, 265, 178, 265, 178, 252, 172, 252, 172, 252, 172, 249, 168, 249, 168, 249, 168, 250, 144, 250, 144, 250, 144, 247, 119, 247, 119, 232, 133, 232, 133, 233, 131, 233, 131, 233, 131, 246, 128, 246, 128, 246, 128, 253, 138, 253, 138, 253, 138, 258, 166, 258, 166, 258, 166, 256, 174, 256, 174, 256, 174, 245, 181, 245, 181, 245, 181, 242, 180, 242, 180, 242, 180, 239, 155, 239, 155, 239, 155, 232, 133, 232, 133, 212, 144, 212, 144, 226, 139, 226, 139, 226, 139, 232, 141, 232, 141, 232, 141, 238, 159, 238, 159, 238, 159, 242, 185, 242, 185, 242, 185, 238, 191, 238, 191, 238, 191, 224, 202, 224, 202, 224, 202, 224, 199, 224, 199, 224, 199, 223, 170, 223, 170, 223, 170, 211, 145, 211, 145, 211, 145, 212, 144, 212, 144, 217, 115, 217, 115, 204, 124, 204, 124, 204, 124, 193, 148, 193, 148, 154, 107, 154, 107, 148, 122, 148, 122, 148, 122, 153, 148, 153, 148, 184, 146, 184, 146, 190, 143, 190, 143, 190, 143, 197, 149, 197, 149, 197, 149, 184, 146, 184, 146, 152, 149, 152, 149, 158, 143, 158, 143, 158, 143, 166, 146, 166, 146, 166, 146, 152, 149, 152, 149, 192, 150, 192, 150, 198, 154, 198, 154, 198, 154, 201, 162, 201, 162, 201, 162, 200, 171, 200, 171, 200, 171, 195, 178, 195, 178, 195, 178, 188, 180, 188, 180, 188, 180, 182, 176, 182, 176, 182, 176, 179, 168, 179, 168, 179, 168, 181, 159, 181, 159, 181, 159, 186, 152, 186, 152, 186, 152, 192, 150, 192, 150, 185, 167, 185, 167, 187, 168, 187, 168, 187, 168, 188, 171, 188, 171, 188, 171, 187, 174, 187, 174, 187, 174, 185, 175, 185, 175, 185, 175, 183, 174, 183, 174, 183, 174, 182, 171, 182, 171, 182, 171, 183, 168, 183, 168, 183, 168, 185, 167, 185, 167, 162, 150, 162, 150, 168, 154, 168, 154, 168, 154, 172, 161, 172, 161, 172, 161, 171, 171, 171, 171, 171, 171, 166, 178, 166, 178, 166, 178, 160, 180, 160, 180, 160, 180, 154, 177, 154, 177, 154, 177, 150, 169, 150, 169, 150, 169, 151, 160, 151, 160, 151, 160, 156, 152, 156, 152, 156, 152, 162, 150, 162, 150, 154, 166, 154, 166, 156, 167, 156, 167, 156, 167, 157, 170, 157, 170, 157, 170, 156, 172, 156, 172, 156, 172, 154, 173, 154, 173, 154, 173, 152, 172, 152, 172, 152, 172, 151, 170, 151, 170, 151, 170, 152, 167, 152, 167, 152, 167, 154, 166, 154, 166, 241, 218, 241, 218, 245, 221, 245, 221, 245, 221, 246, 226, 246, 226, 246, 226, 245, 231, 245, 231, 245, 231, 241, 233, 241, 233, 241, 233, 237, 231, 237, 231, 237, 231, 235, 226, 235, 226, 235, 226, 237, 221, 237, 221, 237, 221, 241, 218, 241, 218, 238, 236, 238, 236, 241, 238, 241, 238, 241, 238, 243, 243, 243, 243, 243, 243, 241, 248, 241, 248, 241, 248, 238, 250, 238, 250, 238, 250, 234, 248, 234, 248, 234, 248, 232, 243, 232, 243, 232, 243, 234, 238, 234, 238, 234, 238, 238, 236, 238, 236, 230, 251, 230, 251, 233, 253, 233, 253, 233, 253, 235, 258, 235, 258, 235, 258, 233, 263, 233, 263, 233, 263, 230, 266, 230, 266, 230, 266, 226, 263, 226, 263, 226, 263, 224, 258, 224, 258, 224, 258, 226, 253, 226, 253, 226, 253, 230, 251, 230, 251 }; /* offline_drop */
static const int16_t s_rig_path_p05[] = { 134, 219, 134, 219, 117, 220, 117, 220, 117, 220, 106, 219, 106, 219, 106, 219, 110, 200, 110, 200, 110, 200, 137, 180, 137, 180, 137, 180, 163, 208, 163, 208, 163, 208, 151, 249, 151, 249, 151, 249, 120, 255, 120, 255, 120, 255, 107, 238, 107, 238, 107, 238, 110, 231, 110, 231, 110, 231, 134, 219, 134, 219, 197, 278, 197, 278, 179, 280, 179, 280, 179, 280, 168, 279, 168, 279, 168, 279, 173, 261, 173, 261, 173, 261, 200, 241, 200, 241, 200, 241, 226, 267, 226, 267, 226, 267, 213, 306, 213, 306, 213, 306, 183, 313, 183, 313, 183, 313, 169, 297, 169, 297, 169, 297, 172, 290, 172, 290, 172, 290, 197, 278, 197, 278, 209, 154, 209, 154, 231, 166, 231, 166, 231, 166, 244, 190, 244, 190, 244, 190, 245, 220, 245, 220, 245, 220, 235, 248, 235, 248, 235, 248, 215, 267, 215, 267, 215, 267, 190, 271, 190, 271, 190, 271, 169, 260, 169, 260, 169, 260, 155, 236, 155, 236, 155, 236, 154, 206, 154, 206, 154, 206, 165, 177, 165, 177, 165, 177, 185, 159, 185, 159, 185, 159, 209, 154, 209, 154, 245, 123, 245, 123, 247, 120, 247, 120, 247, 120, 264, 108, 264, 108, 264, 108, 271, 110, 271, 110, 271, 110, 272, 146, 272, 146, 272, 146, 267, 175, 267, 175, 267, 175, 257, 182, 257, 182, 257, 182, 244, 175, 244, 175, 244, 175, 242, 171, 242, 171, 242, 171, 246, 148, 246, 148, 246, 148, 245, 123, 245, 123, 230, 136, 230, 136, 231, 134, 231, 134, 231, 134, 244, 132, 244, 132, 244, 132, 250, 142, 250, 142, 250, 142, 253, 170, 253, 170, 253, 170, 250, 178, 250, 178, 250, 178, 239, 184, 239, 184, 239, 184, 236, 183, 236, 183, 236, 183, 235, 158, 235, 158, 235, 158, 230, 136, 230, 136, 210, 148, 210, 148, 224, 144, 224, 144, 224, 144, 229, 146, 229, 146, 229, 146, 235, 165, 235, 165, 235, 165, 236, 190, 236, 190, 236, 190, 232, 196, 232, 196, 232, 196, 218, 206, 218, 206, 218, 206, 218, 203, 218, 203, 218, 203, 219, 175, 219, 175, 219, 175, 209, 149, 209, 149, 209, 149, 210, 148, 210, 148, 224, 125, 224, 125, 210, 131, 210, 131, 210, 131, 196, 152, 196, 152, 144, 113, 144, 113, 141, 128, 141, 128, 141, 128, 150, 152, 150, 152, 185, 147, 185, 147, 192, 145, 192, 145, 192, 145, 198, 152, 198, 152, 198, 152, 185, 147, 185, 147, 152, 151, 152, 151, 156, 145, 156, 145, 156, 145, 165, 147, 165, 147, 165, 147, 152, 151, 152, 151, 194, 155, 194, 155, 199, 158, 199, 158, 199, 158, 202, 165, 202, 165, 202, 165, 201, 173, 201, 173, 201, 173, 196, 178, 196, 178, 196, 178, 189, 180, 189, 180, 189, 180, 183, 176, 183, 176, 183, 176, 180, 169, 180, 169, 180, 169, 182, 162, 182, 162, 182, 162, 187, 156, 187, 156, 187, 156, 194, 155, 194, 155, 187, 170, 187, 170, 189, 171, 189, 171, 189, 171, 190, 174, 190, 174, 190, 174, 189, 177, 189, 177, 189, 177, 187, 178, 187, 178, 187, 178, 185, 177, 185, 177, 185, 177, 184, 174, 184, 174, 184, 174, 185, 171, 185, 171, 185, 171, 187, 170, 187, 170, 164, 155, 164, 155, 170, 158, 170, 158, 170, 158, 173, 165, 173, 165, 173, 165, 172, 172, 172, 172, 172, 172, 167, 178, 167, 178, 167, 178, 161, 180, 161, 180, 161, 180, 154, 177, 154, 177, 154, 177, 151, 170, 151, 170, 151, 170, 152, 162, 152, 162, 152, 162, 157, 156, 157, 156, 157, 156, 164, 155, 164, 155, 155, 169, 155, 169, 157, 170, 157, 170, 157, 170, 158, 173, 158, 173, 158, 173, 157, 175, 157, 175, 157, 175, 155, 176, 155, 176, 155, 176, 153, 175, 153, 175, 153, 175, 152, 173, 152, 173, 152, 173, 153, 170, 153, 170, 153, 170, 155, 169, 155, 169, 239, 222, 239, 222, 243, 225, 243, 225, 243, 225, 244, 230, 244, 230, 244, 230, 243, 235, 243, 235, 243, 235, 239, 237, 239, 237, 239, 237, 235, 235, 235, 235, 235, 235, 233, 230, 233, 230, 233, 230, 235, 225, 235, 225, 235, 225, 239, 222, 239, 222, 237, 240, 237, 240, 240, 242, 240, 242, 240, 242, 242, 247, 242, 247, 242, 247, 240, 252, 240, 252, 240, 252, 237, 254, 237, 254, 237, 254, 233, 252, 233, 252, 233, 252, 231, 247, 231, 247, 231, 247, 233, 242, 233, 242, 233, 242, 237, 240, 237, 240, 228, 255, 228, 255, 231, 257, 231, 257, 231, 257, 233, 262, 233, 262, 233, 262, 231, 267, 231, 267, 231, 267, 228, 270, 228, 270, 228, 270, 224, 267, 224, 267, 224, 267, 222, 262, 222, 262, 222, 262, 224, 257, 224, 257, 224, 257, 228, 255, 228, 255 }; /* offline_hold */

#define S_RIG_PATH_POSE(arr) { .coords = (arr) }

static const gfx_sm_pose_t s_rig_path_poses[] = {
    S_RIG_PATH_POSE(s_rig_path_p00),  S_RIG_PATH_POSE(s_rig_path_p01),  S_RIG_PATH_POSE(s_rig_path_p02),
    S_RIG_PATH_POSE(s_rig_path_p03),  S_RIG_PATH_POSE(s_rig_path_p04),  S_RIG_PATH_POSE(s_rig_path_p05),
};

static const gfx_sm_segment_t s_rig_path_segments[] = {
    /* shell_left_sh_0 */ { .kind = GFX_SM_SEG_BEZIER_LOOP, .joint_a = 0, .joint_count = 31, .stroke_width = 4 },
    /* abdomen_sh_0 */ { .kind = GFX_SM_SEG_BEZIER_LOOP, .joint_a = 31, .joint_count = 31, .stroke_width = 4 },
    /* head_sh_0 */ { .kind = GFX_SM_SEG_BEZIER_LOOP, .joint_a = 62, .joint_count = 37, .stroke_width = 4 },
    /* wing_outer_sh_0 */ { .kind = GFX_SM_SEG_BEZIER_LOOP, .joint_a = 99, .joint_count = 31, .stroke_width = 4 },
    /* wing_mid_sh_0 */ { .kind = GFX_SM_SEG_BEZIER_LOOP, .joint_a = 130, .joint_count = 28, .stroke_width = 4 },
    /* wing_inner_sh_0 */ { .kind = GFX_SM_SEG_BEZIER_LOOP, .joint_a = 158, .joint_count = 31, .stroke_width = 4 },
    /* antenna_right_sh_0 */ { .kind = GFX_SM_SEG_BEZIER_STRIP, .joint_a = 189, .joint_count = 7, .stroke_width = 3 },
    /* antenna_left_sh_0 */ { .kind = GFX_SM_SEG_BEZIER_STRIP, .joint_a = 196, .joint_count = 7, .stroke_width = 3 },
    /* mouth_right_sh_0 */ { .kind = GFX_SM_SEG_BEZIER_LOOP, .joint_a = 203, .joint_count = 10, .stroke_width = 3 },
    /* mouth_left_sh_0 */ { .kind = GFX_SM_SEG_BEZIER_LOOP, .joint_a = 213, .joint_count = 10, .stroke_width = 3 },
    /* eye_right_sh_0 */ { .kind = GFX_SM_SEG_BEZIER_LOOP, .joint_a = 223, .joint_count = 31, .stroke_width = 2 },
    /* pupil_right_sh_0 */ { .kind = GFX_SM_SEG_BEZIER_LOOP, .joint_a = 254, .joint_count = 25, .stroke_width = 2 },
    /* eye_left_sh_0 */ { .kind = GFX_SM_SEG_BEZIER_LOOP, .joint_a = 279, .joint_count = 31, .stroke_width = 2 },
    /* pupil_left_sh_0 */ { .kind = GFX_SM_SEG_BEZIER_LOOP, .joint_a = 310, .joint_count = 25, .stroke_width = 2 },
    /* foot_1_sh_0 */ { .kind = GFX_SM_SEG_BEZIER_LOOP, .joint_a = 335, .joint_count = 25, .stroke_width = 3 },
    /* foot_2_sh_0 */ { .kind = GFX_SM_SEG_BEZIER_LOOP, .joint_a = 360, .joint_count = 25, .stroke_width = 3 },
    /* foot_3_sh_0 */ { .kind = GFX_SM_SEG_BEZIER_LOOP, .joint_a = 385, .joint_count = 25, .stroke_width = 3 },
};

#define STEP(p, h, f, i) { .pose_index = (p), .hold_ticks = (h), .interp = (i), .facing = (f) }

static const gfx_sm_clip_step_t s_rig_path_steps_active_idle[] = {
    STEP(0, 20, 1, GFX_SM_INTERP_DAMPED),
};
static const gfx_sm_clip_step_t s_rig_path_steps_active_open[] = {
    STEP(1, 20, 1, GFX_SM_INTERP_DAMPED),
};
static const gfx_sm_clip_step_t s_rig_path_steps_active_step[] = {
    STEP(2, 20, 1, GFX_SM_INTERP_DAMPED),
};
static const gfx_sm_clip_step_t s_rig_path_steps_offline_alert[] = {
    STEP(3, 20, 1, GFX_SM_INTERP_DAMPED),
};
static const gfx_sm_clip_step_t s_rig_path_steps_offline_drop[] = {
    STEP(4, 20, 1, GFX_SM_INTERP_DAMPED),
};
static const gfx_sm_clip_step_t s_rig_path_steps_offline_hold[] = {
    STEP(5, 20, 1, GFX_SM_INTERP_DAMPED),
};

#define CLIP(arr, lp) { .steps = (arr), .step_count = (uint8_t)(sizeof(arr) / sizeof((arr)[0])), .loop = (lp) }

static const gfx_sm_clip_t s_rig_path_clips[] = {
    CLIP(s_rig_path_steps_active_idle, true),
    CLIP(s_rig_path_steps_active_open, true),
    CLIP(s_rig_path_steps_active_step, true),
    CLIP(s_rig_path_steps_offline_alert, true),
    CLIP(s_rig_path_steps_offline_drop, true),
    CLIP(s_rig_path_steps_offline_hold, true),
};

static const uint16_t s_rig_path_sequence[] = { 0, 1, 2, 3, 4, 5 };

static const gfx_sm_asset_t s_rig_path_scene_asset = {
    .meta           = &s_rig_path_meta,
    .joint_names    = s_rig_path_joint_names,
    .joint_count    = (uint16_t)(sizeof(s_rig_path_joint_names) / sizeof(s_rig_path_joint_names[0])),
    .segments       = s_rig_path_segments,
    .segment_count  = (uint8_t)(sizeof(s_rig_path_segments) / sizeof(s_rig_path_segments[0])),
    .poses          = s_rig_path_poses,
    .pose_count     = (uint16_t)(sizeof(s_rig_path_poses) / sizeof(s_rig_path_poses[0])),
    .clips          = s_rig_path_clips,
    .clip_count     = (uint16_t)(sizeof(s_rig_path_clips) / sizeof(s_rig_path_clips[0])),
    .sequence       = s_rig_path_sequence,
    .sequence_count = (uint16_t)(sizeof(s_rig_path_sequence) / sizeof(s_rig_path_sequence[0])),
    .layout         = &s_rig_path_layout,
};