/*
 * SPDX-FileCopyrightText: 2026 Espressif Systems (Shanghai) CO LTD
 *
 * SPDX-License-Identifier: Apache-2.0
 *
 * face_eye_tex.inc — 32x32 RGB565A8 eye texture for face emote resource test.
 * Generated: sclera (off-white), iris (blue), pupil (near-black).
 */
#pragma once

#include "widget/gfx_img.h"

static const uint8_t s_face_eye_tex_map[] = {
    0x00, 0x00, 0x00, 0x00, 0x00, 0x00, 0x00, 0x00, 0x00, 0x00, 0x00, 0x00, 0x00, 0x00, 0x00, 0x00,
    0x00, 0x00, 0x00, 0x00, 0x00, 0x00, 0x00, 0x00, 0x00, 0x00, 0x00, 0x00, 0x00, 0x00, 0x00, 0x00,
    0x00, 0x00, 0x00, 0x00, 0x00, 0x00, 0x00, 0x00, 0x00, 0x00, 0x00, 0x00, 0x00, 0x00, 0x00, 0x00,
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    0x00, 0x00, 0x00, 0x00, 0x00, 0x00, 0x00, 0x00, 0x00, 0x00, 0x00, 0x00, 0x00, 0x00, 0x00, 0x00,
};

static const gfx_image_dsc_t s_face_eye_tex = {
    .header.cf     = GFX_COLOR_FORMAT_RGB565A8,
    .header.magic  = C_ARRAY_HEADER_MAGIC,
    .header.w      = 32,
    .header.h      = 32,
    .header.stride = 64,
    .data_size     = 3072,
    .data          = s_face_eye_tex_map,
};
